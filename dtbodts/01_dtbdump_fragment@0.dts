/dts-v1/;

/ {

	__fixups__ {
		accdet = "/fragment@23:target:0";
		auxadc = "/fragment@28/__overlay__:io-channels:0", "/fragment@31/__overlay__:io-channels:0", "/fragment@31/__overlay__:io-channels:8", "/fragment@31/__overlay__:io-channels:16", "/fragment@43:target:0", "/fragment@44/__overlay__:io-channels:0";
		bat_gm30 = "/fragment@28:target:0";
		charger = "/fragment@31:target:0";
		chosen = "/fragment@1:target:0";
		dispsys_config = "/fragment@26:target:0";
		dsi0 = "/fragment@27:target:0";
		dsi_te = "/fragment@64:target:0";
		goodix_fp = "/fragment@13:target:0";
		gpio = "/fragment@57:target:0";
		gpio_usage_mapping = "/fragment@56:target:0";
		gps = "/fragment@17:target:0";
		i2c0 = "/fragment@46:target:0";
		i2c1 = "/fragment@47:target:0";
		i2c2 = "/fragment@20:target:0", "/fragment@35:target:0", "/fragment@48:target:0";
		i2c3 = "/fragment@8:target:0", "/fragment@49:target:0";
		i2c4 = "/fragment@39:target:0", "/fragment@50:target:0";
		i2c5 = "/fragment@51:target:0";
		i2c6 = "/fragment@32:target:0", "/fragment@52:target:0";
		i2c7 = "/fragment@53:target:0";
		i2c8 = "/fragment@38:target:0", "/fragment@54:target:0";
		i2c9 = "/fragment@55:target:0";
		irq_nfc = "/fragment@61:target:0";
		kd_camera_hw1 = "/fragment@37:target:0";
		keypad = "/fragment@21:target:0", "/fragment@66:target:0";
		lk_charger = "/fragment@4:target:0";
		md1_sim1_hot_plug_eint = "/fragment@65:target:0";
		md_auxadc = "/fragment@44:target:0";
		mrdump_ext_rst = "/fragment@58:target:0";
		mt6370_pmu = "/fragment@18:target:0";
		mt6370_typec = "/fragment@19:target:0";
		mtk_lpm = "/fragment@2:target:0";
		mtkfb = "/fragment@25:target:0";
		odm = "/fragment@5:target:0";
		oplus_fp_common = "/fragment@15:target:0";
		pio = "/fragment@5/__overlay__/oplus_devinfo/main-sub:aboard-gpio0:0", "/fragment@5/__overlay__/kpd_volume_up:interrupt-parent:0", "/fragment@5/__overlay__/kpd_volume_down:interrupt-parent:0", "/fragment@5/__overlay__/oplus_sim_detect:Hw,sim_det:0", "/fragment@6:target:0", "/fragment@7:target:0", "/fragment@8/__overlay__/nfc_nxp@2a:nxp,pn544-irq:0", "/fragment@8/__overlay__/nfc_nxp@2a:nxp,pn544-ven:0", "/fragment@8/__overlay__/nfc_nxp@2a:nxp,pn544-fw-dwnld:0", "/fragment@8/__overlay__/nfc_nxp@2a:interrupt-parent:0", "/fragment@10:target:0", "/fragment@11/__overlay__:sil,silead_irq:0", "/fragment@12:target:0", "/fragment@13/__overlay__:interrupt-parent:0", "/fragment@13/__overlay__:goodix,gpio_irq:0", "/fragment@13/__overlay__:goodix,gpio_reset:0", "/fragment@14:target:0", "/fragment@15/__overlay__:oplus,fp_gpio_0:0", "/fragment@16:target:0", "/fragment@18/__overlay__:mt6370,intr_gpio:0", "/fragment@19/__overlay__:mt6370pd,intr_gpio:0", "/fragment@20/__overlay__/bq25601d-charger@6b:interrupt-parent:0", "/fragment@20/__overlay__/bq25601d-charger@6b:chg-irq-gpio:0", "/fragment@20/__overlay__/bq25601d-charger@6b:qcom,slave-chg-en-gpio:0", "/fragment@21/__overlay__:keypad,volume-up:0", "/fragment@21/__overlay__:keypad,volume-down:0", "/fragment@22:target:0", "/fragment@24:target:0", "/fragment@27/__overlay__/panel1@0:reset-gpios:0", "/fragment@27/__overlay__/panel2@0:reset-gpios:0", "/fragment@27/__overlay__/panel3@0:reset-gpios:0", "/fragment@28/__overlay__:qcom,batid-gpio:0", "/fragment@28/__overlay__:qcom,linktem-gpio:0", "/fragment@28/__overlay__:qcom,linkbustem-gpio:0", "/fragment@29/__overlay__/touchscreen@0:interrupt-parent:0", "/fragment@29/__overlay__/touchscreen@0:irq-gpio:0", "/fragment@29/__overlay__/touchscreen@0:reset-gpio:0", "/fragment@30:target:0", "/fragment@31/__overlay__:qcom,chargerid_switch-gpio:0", "/fragment@31/__overlay__:qcom,dischg-gpio:0", "/fragment@31/__overlay__:qcom,chgvin:0", "/fragment@31/__overlay__:qcom,batid-gpio:0", "/fragment@32/__overlay__/c8547-charger@6F:qcom,switch_voocphy_irq_gpio:0", "/fragment@32/__overlay__/c8547-charger@6F:interrupt-parent:0", "/fragment@32/__overlay__/c8547-charger@6F:qcom,charging_switch1-gpio:0", "/fragment@33:target:0", "/fragment@34:target:0", "/fragment@36:target:0", "/fragment@40/__overlay__/novatek@0:novatek,reset-gpio:0", "/fragment@40/__overlay__/novatek@0:novatek,irq-gpio:0", "/fragment@41/__overlay__:interrupt-parent:0", "/fragment@42:target:0", "/fragment@56/__overlay__:GPIO_SIM1_HOT_PLUG:0", "/fragment@56/__overlay__:GPIO_SIM1_SCLK:0", "/fragment@56/__overlay__:GPIO_SIM1_SRST:0", "/fragment@56/__overlay__:GPIO_SIM1_SIO:0", "/fragment@56/__overlay__:GPIO_SIM2_SCLK:0", "/fragment@56/__overlay__:GPIO_SIM2_SRST:0", "/fragment@56/__overlay__:GPIO_SIM2_SIO:0", "/fragment@56/__overlay__:GPIO_FDD_BAND_SUPPORT_DETECT_1ST_PIN:0", "/fragment@56/__overlay__:GPIO_FDD_BAND_SUPPORT_DETECT_2ND_PIN:0", "/fragment@56/__overlay__:GPIO_FDD_BAND_SUPPORT_DETECT_3RD_PIN:0", "/fragment@58/__overlay__:interrupt-parent:0", "/fragment@59/__overlay__:interrupt-parent:0", "/fragment@60/__overlay__:interrupt-parent:0", "/fragment@61/__overlay__:interrupt-parent:0", "/fragment@62/__overlay__:interrupt-parent:0", "/fragment@63/__overlay__:interrupt-parent:0", "/fragment@63/__overlay__:deb-gpios:0", "/fragment@64/__overlay__:interrupt-parent:0";
		pmic_clock_buffer_ctrl = "/fragment@45:target:0";
		reserved_memory = "/fragment@0:target:0";
		silead_fp = "/fragment@11:target:0", "/fragment@59:target:0";
		spi4 = "/fragment@29:target:0", "/fragment@40:target:0";
		spi5 = "/fragment@9:target:0";
		subpmic_pmu_eint = "/fragment@60:target:0";
		swtp = "/fragment@63:target:0";
		topckgen = "/fragment@3:target:0";
		touch = "/fragment@41:target:0", "/fragment@62:target:0";
	};

	__local_fixups__ {

		fragment@11 {

			__overlay__ {
				pinctrl-0 = <0x0>;
				pinctrl-1 = <0x0>;
				pinctrl-2 = <0x0>;
				pinctrl-3 = <0x0>;
			};
		};

		fragment@13 {

			__overlay__ {
				pinctrl-0 = <0x0>;
				pinctrl-1 = <0x0>;
				pinctrl-2 = <0x0>;
			};
		};

		fragment@15 {

			__overlay__ {
				pinctrl-0 = <0x0>;
				pinctrl-1 = <0x0>;
				pinctrl-2 = <0x0>;
			};
		};

		fragment@17 {

			__overlay__ {
				pinctrl-0 = <0x0>;
				pinctrl-1 = <0x0>;
				pinctrl-2 = <0x0>;
				pinctrl-3 = <0x0>;
				pinctrl-4 = <0x0>;
				pinctrl-5 = <0x0>;
				pinctrl-6 = <0x0>;
			};
		};

		fragment@20 {

			__overlay__ {

				bq25601d-charger@6b {
					pinctrl-0 = <0x0>;
					pinctrl-1 = <0x0>;
				};
			};
		};

		fragment@21 {

			__overlay__ {
				pinctrl-0 = <0x0>;
				pinctrl-1 = <0x0>;
			};
		};

		fragment@25 {

			__overlay__ {
				pinctrl-0 = <0x0>;
				pinctrl-1 = <0x0>;
				pinctrl-2 = <0x0>;
			};
		};

		fragment@26 {

			__overlay__ {
				pinctrl-0 = <0x0>;
				pinctrl-1 = <0x0>;
				pinctrl-2 = <0x0>;
			};
		};

		fragment@27 {

			__overlay__ {

				panel1@0 {

					port {

						endpoint {
							remote-endpoint = <0x0>;
						};
					};
				};

				panel2@0 {

					port {

						endpoint {
							remote-endpoint = <0x0>;
						};
					};
				};

				panel3@0 {

					port {

						endpoint {
							remote-endpoint = <0x0>;
						};
					};
				};

				ports {

					port {

						endpoint {
							remote-endpoint = <0x0>;
						};
					};
				};
			};
		};

		fragment@28 {

			__overlay__ {
				pinctrl-0 = <0x0>;
				pinctrl-1 = <0x0>;
				pinctrl-2 = <0x0>;
				pinctrl-3 = <0x0>;
				pinctrl-4 = <0x0>;
				pinctrl-5 = <0x0>;
			};
		};

		fragment@29 {

			__overlay__ {

				touchscreen@0 {
					pinctrl-0 = <0x0>;
				};
			};
		};

		fragment@31 {

			__overlay__ {
				pinctrl-0 = <0x0>;
				pinctrl-1 = <0x0>;
				pinctrl-2 = <0x0>;
				pinctrl-3 = <0x0>;
				pinctrl-4 = <0x0>;
				pinctrl-5 = <0x0>;
				pinctrl-6 = <0x0>;
				pinctrl-7 = <0x0>;
				pinctrl-8 = <0x0>;
			};
		};

		fragment@32 {

			__overlay__ {

				c8547-charger@6F {
					pinctrl-0 = <0x0>;
					pinctrl-1 = <0x0>;
					pinctrl-2 = <0x0>;
					pinctrl-3 = <0x0>;
				};
			};
		};

		fragment@37 {

			__overlay__ {
				pinctrl-0 = <0x0>;
				pinctrl-1 = <0x0>;
				pinctrl-10 = <0x0>;
				pinctrl-11 = <0x0>;
				pinctrl-12 = <0x0>;
				pinctrl-13 = <0x0>;
				pinctrl-14 = <0x0>;
				pinctrl-15 = <0x0>;
				pinctrl-16 = <0x0>;
				pinctrl-17 = <0x0>;
				pinctrl-18 = <0x0>;
				pinctrl-19 = <0x0>;
				pinctrl-2 = <0x0>;
				pinctrl-20 = <0x0>;
				pinctrl-21 = <0x0>;
				pinctrl-22 = <0x0>;
				pinctrl-23 = <0x0>;
				pinctrl-24 = <0x0>;
				pinctrl-25 = <0x0>;
				pinctrl-26 = <0x0>;
				pinctrl-27 = <0x0>;
				pinctrl-28 = <0x0>;
				pinctrl-3 = <0x0>;
				pinctrl-4 = <0x0>;
				pinctrl-5 = <0x0>;
				pinctrl-6 = <0x0>;
				pinctrl-7 = <0x0>;
				pinctrl-8 = <0x0>;
				pinctrl-9 = <0x0>;
			};
		};

		fragment@41 {

			__overlay__ {
				pinctrl-0 = <0x0>;
				pinctrl-1 = <0x0>;
				pinctrl-2 = <0x0>;
				pinctrl-3 = <0x0>;
				pinctrl-4 = <0x0>;
				pinctrl-5 = <0x0>;
				pinctrl-6 = <0x0>;
			};
		};

		fragment@5 {

			__overlay__ {

				oplus_devinfo {

					main-sub {
						pinctrl-0 = <0x0>;
						pinctrl-1 = <0x0>;
						pinctrl-2 = <0x0>;
					};
				};
			};
		};
	};

	__symbols__ {
		aboard_gpio0d_active = "/fragment@6/__overlay__/aboard_gpio0d_active";
		aboard_gpio0d_idle = "/fragment@6/__overlay__/aboard_gpio0d_idle";
		aboard_gpio0d_sleep = "/fragment@6/__overlay__/aboard_gpio0d_sleep";
		batid_disable = "/fragment@33/__overlay__/batid_disable";
		batid_enable = "/fragment@33/__overlay__/batid_enable";
		camera0_mclk_2ma = "/fragment@36/__overlay__/camera0_mclk_2ma@gpio141";
		camera0_mclk_4ma = "/fragment@36/__overlay__/camera0_mclk_4ma@gpio141";
		camera0_mclk_6ma = "/fragment@36/__overlay__/camera0_mclk_6ma@gpio141";
		camera0_mclk_8ma = "/fragment@36/__overlay__/camera0_mclk_8ma@gpio141";
		camera0_mclk_off = "/fragment@36/__overlay__/camera0_mclk_gpio_mode@gpio141";
		camera0_rst_high = "/fragment@36/__overlay__/camera0_rst_output_high@gpio20";
		camera0_rst_low = "/fragment@36/__overlay__/camera0_rst_output_low@gpio20";
		camera1_mclk_2ma = "/fragment@36/__overlay__/camera1_mclk_2ma@gpio140";
		camera1_mclk_4ma = "/fragment@36/__overlay__/camera1_mclk_4ma@gpio140";
		camera1_mclk_6ma = "/fragment@36/__overlay__/camera1_mclk_6ma@gpio140";
		camera1_mclk_8ma = "/fragment@36/__overlay__/camera1_mclk_8ma@gpio140";
		camera1_mclk_off = "/fragment@36/__overlay__/camera1_mclk_gpio_mode@gpio140";
		camera1_rst_high = "/fragment@36/__overlay__/camera1_rst_output_high@gpio18";
		camera1_rst_low = "/fragment@36/__overlay__/camera1_rst_output_low@gpio18";
		camera2_mclk_2ma = "/fragment@36/__overlay__/camera2_mclk_2ma@gpio142";
		camera2_mclk_4ma = "/fragment@36/__overlay__/camera2_mclk_4ma@gpio142";
		camera2_mclk_6ma = "/fragment@36/__overlay__/camera2_mclk_6ma@gpio142";
		camera2_mclk_8ma = "/fragment@36/__overlay__/camera2_mclk_8ma@gpio142";
		camera2_mclk_off = "/fragment@36/__overlay__/camera2_mclk_gpio_mode@gpio142";
		camera2_rst_high = "/fragment@36/__overlay__/camera2_rst_output_high@gpio22";
		camera2_rst_low = "/fragment@36/__overlay__/camera2_rst_output_low@gpio22";
		camera3_mclk_2ma = "/fragment@36/__overlay__/camera3_mclk_2ma@gpio60";
		camera3_mclk_4ma = "/fragment@36/__overlay__/camera3_mclk_4ma@gpio60";
		camera3_mclk_6ma = "/fragment@36/__overlay__/camera3_mclk_6ma@gpio60";
		camera3_mclk_8ma = "/fragment@36/__overlay__/camera3_mclk_8ma@gpio60";
		camera3_mclk_off = "/fragment@36/__overlay__/camera3_mclk_gpio_mode@gpio60";
		camera3_rst_high = "/fragment@36/__overlay__/camera3_rst_output_high@gpio26";
		camera3_rst_low = "/fragment@36/__overlay__/camera3_rst_output_low@gpio26";
		camera_main_af_mtk = "/fragment@50/__overlay__/camera_main_af@0c";
		camera_main_mtk = "/fragment@50/__overlay__/camera_main@36";
		camera_main_three_af_mtk = "/fragment@48/__overlay__/camera_main_three_af@0c";
		camera_main_three_eeprom_mtk = "/fragment@48/__overlay__/camera_main_three_eeprom@51";
		camera_main_three_mtk = "/fragment@48/__overlay__/camera_main_three@10";
		camera_main_two_af_mtk = "/fragment@54/__overlay__/camera_main_two_af@0c";
		camera_main_two_mtk = "/fragment@54/__overlay__/camera_main_two@6e";
		camera_pins_default = "/fragment@36/__overlay__/camdefault";
		camera_sub_mtk = "/fragment@54/__overlay__/camera_sub@1a";
		camera_sub_two_mtk = "/fragment@55/__overlay__/camera_sub_two@1a";
		charger_pins_default = "/fragment@33/__overlay__/eint0default";
		charger_pins_eint_output0 = "/fragment@33/__overlay__/charger_gpio_as_output_low";
		charger_pins_eint_output1 = "/fragment@33/__overlay__/charger_gpio_as_output_high";
		charging_data_active = "/fragment@34/__overlay__/charging_data_active";
		charging_data_sleep = "/fragment@34/__overlay__/charging_data_sleep";
		charging_inter_active = "/fragment@34/__overlay__/charging_inter_active";
		charging_inter_sleep = "/fragment@34/__overlay__/charging_inter_sleep";
		charging_reset_active = "/fragment@34/__overlay__/charging_reset_active";
		charging_reset_sleep = "/fragment@34/__overlay__/charging_reset_sleep";
		charging_switch1_active = "/fragment@34/__overlay__/charging_switch1_active";
		charging_switch1_ctr1_active = "/fragment@34/__overlay__/charging_switch1_ctr1_active";
		charging_switch1_ctr1_sleep = "/fragment@34/__overlay__/charging_switch1_ctr1_sleep";
		charging_switch1_sleep = "/fragment@34/__overlay__/charging_switch1_sleep";
		chgvin_disable = "/fragment@33/__overlay__/chgvin_disable";
		chgvin_enable = "/fragment@33/__overlay__/chgvin_enable";
		ctp_novatek_spi_mode = "/fragment@30/__overlay__/ctp_novatek_spi_mode";
		ctp_pins_default = "/fragment@42/__overlay__/pins_default";
		ctp_pins_eint_as_int = "/fragment@42/__overlay__/eint@0";
		ctp_pins_eint_output0 = "/fragment@42/__overlay__/eintoutput0";
		ctp_pins_eint_output1 = "/fragment@42/__overlay__/eintoutput1";
		ctp_pins_rst_output0 = "/fragment@42/__overlay__/rstoutput0";
		ctp_pins_rst_output1 = "/fragment@42/__overlay__/rstoutput1";
		ctp_pins_spi_mode = "/fragment@42/__overlay__/spimode_default";
		dischg_disable = "/fragment@33/__overlay__/dischg_disable";
		dischg_enable = "/fragment@33/__overlay__/dischg_enable";
		dsi_out = "/fragment@27/__overlay__/ports/port/endpoint";
		goodix_irq_no_pull = "/fragment@12/__overlay__/goodix_irq_no_pull";
		goodix_irq_out_low = "/fragment@12/__overlay__/goodix_irq_out_low";
		goodix_reset_default = "/fragment@12/__overlay__/goodix_reset_default";
		gpio_id0_default = "/fragment@14/__overlay__/gpio_id0_default";
		gpio_id0_pull_down = "/fragment@14/__overlay__/gpio_id0_pull_down";
		gpio_id0_pull_up = "/fragment@14/__overlay__/gpio_id0_pull_up";
		gps_l1_lna_pins_dsp_ctrl = "/fragment@16/__overlay__/gps_l1_lna@1";
		gps_l1_lna_pins_oh = "/fragment@16/__overlay__/gps_l1_lna@2";
		gps_l1_lna_pins_ol = "/fragment@16/__overlay__/gps_l1_lna@0";
		gps_l5_lna_pins_dsp_ctrl = "/fragment@16/__overlay__/gps_l5_lna@1";
		gps_l5_lna_pins_oh = "/fragment@16/__overlay__/gps_l5_lna@2";
		gps_l5_lna_pins_ol = "/fragment@16/__overlay__/gps_l5_lna@0";
		gps_pins_default = "/fragment@16/__overlay__/gps_default";
		kpd_volume_down = "/fragment@5/__overlay__/kpd_volume_down";
		kpd_volume_up = "/fragment@5/__overlay__/kpd_volume_up";
		led0 = "/fragment@5/__overlay__/led@0";
		led1 = "/fragment@5/__overlay__/led@1";
		led2 = "/fragment@5/__overlay__/led@2";
		led3 = "/fragment@5/__overlay__/led@3";
		led4 = "/fragment@5/__overlay__/led@4";
		led5 = "/fragment@5/__overlay__/led@5";
		led6 = "/fragment@5/__overlay__/led@6";
		linkbustem_disable = "/fragment@33/__overlay__/linkbustem_disable";
		linkbustem_enable = "/fragment@33/__overlay__/linkbustem_enable";
		linktem_disable = "/fragment@33/__overlay__/linktem_disable";
		linktem_enable = "/fragment@33/__overlay__/linktem_enable";
		mtk_camera_eeprom0 = "/fragment@39/__overlay__/camera_eeprom0@50";
		mtk_camera_eeprom1 = "/fragment@38/__overlay__/camera_eeprom1@55";
		mtk_camera_eeprom2 = "/fragment@38/__overlay__/camera_eeprom2@51";
		mtkfb_pins_lcm_dsi_te = "/fragment@24/__overlay__/lcm_dsi_te";
		mtkfb_pins_lcm_rst_out0_gpio = "/fragment@24/__overlay__/lcm_rst_out0_gpio";
		mtkfb_pins_lcm_rst_out1_gpio = "/fragment@24/__overlay__/lcm_rst_out1_gpio";
		nfc_chipset = "/fragment@5/__overlay__/nfc_chipset";
		nfc_default = "/fragment@7/__overlay__/nfc_default";
		nfc_dwn_high = "/fragment@7/__overlay__/nfc_dwn_high";
		nfc_dwn_low = "/fragment@7/__overlay__/nfc_dwn_low";
		nfc_eint_as_int = "/fragment@7/__overlay__/nfc_eint_as_int";
		nfc_mtk = "/fragment@49/__overlay__/nfc@08";
		nfc_ven_high = "/fragment@7/__overlay__/nfc_ven_high";
		nfc_ven_low = "/fragment@7/__overlay__/nfc_ven_low";
		oplus_devinfo = "/fragment@5/__overlay__/oplus_devinfo";
		oplus_project = "/fragment@5/__overlay__/oplus_project";
		panel_in1 = "/fragment@27/__overlay__/panel1@0/port/endpoint";
		panel_in2 = "/fragment@27/__overlay__/panel2@0/port/endpoint";
		panel_in3 = "/fragment@27/__overlay__/panel3@0/port/endpoint";
		silfp_default = "/fragment@10/__overlay__/silfpdefault";
		silfp_irq = "/fragment@10/__overlay__/fp_eint@8";
		silfp_rst_high = "/fragment@10/__overlay__/state_reset_high";
		silfp_rst_low = "/fragment@10/__overlay__/state_reset_low";
		slave_charger_disable = "/fragment@33/__overlay__/slave_charger_disable";
		slave_charger_enable = "/fragment@33/__overlay__/slave_charger_enable";
		subpmic_pmu_mtk = "/fragment@51/__overlay__/subpmic_pmu@34";
		uart0_rx_output0 = "/fragment@33/__overlay__/uart0_rx_gpio@gpio32";
		uart0_tx_output0 = "/fragment@33/__overlay__/uart0_tx_gpio@gpio33";
		usb_c_pinctrl = "/fragment@5/__overlay__/usb_c_pinctrl";
		usb_type_c_mtk = "/fragment@51/__overlay__/usb_type_c@4e";
		vibrator0 = "/fragment@5/__overlay__/vibrator@0";
		volume_down_gpio_eint = "/fragment@22/__overlay__/volume_down@0";
		volume_up_gpio_eint = "/fragment@22/__overlay__/volume_up@0";
		vooc_asic_id_active = "/fragment@34/__overlay__/vooc_asic_id_active";
		vooc_asic_id_sleep = "/fragment@34/__overlay__/vooc_asic_id_sleep";
	};

	fragment@0 {
		target = <0xffffffff>;

		__overlay__ {
		};
	};

	fragment@1 {
		target = <0xffffffff>;

		__overlay__ {
			atag,videolfb-fb_base_h = <0x0>;
			atag,videolfb-fb_base_l = "~`P";
			atag,videolfb-fps = <0x1770>;
			atag,videolfb-islcm_inited = <0x0>;
			atag,videolfb-islcmfound = <0x1>;
			atag,videolfb-lcmname = "nt35695_fhd_dsi_cmd_truly_rt5081_drv";
			atag,videolfb-vramSize = <0x17e8000>;
		};
	};

	fragment@10 {
		target = <0xffffffff>;

		__overlay__ {

			fp_eint@8 {
				phandle = <0x7>;

				pins_cmd_dat {
					bias-disable;
					pinmux = <0x100>;
					slew-rate = <0x0>;
				};
			};

			silfpdefault {
				phandle = <0x4>;
			};

			state_reset_high {
				phandle = <0x6>;

				pins_cmd_dat {
					output-high;
					pinmux = <0xad00>;
					slew-rate = <0x1>;
				};
			};

			state_reset_low {
				phandle = <0x5>;

				pins_cmd_dat {
					output-low;
					pinmux = <0xad00>;
					slew-rate = <0x1>;
				};
			};
		};
	};

	fragment@11 {
		target = <0xffffffff>;

		__overlay__ {
			pinctrl-0 = <0x4>;
			pinctrl-1 = <0x5>;
			pinctrl-2 = <0x6>;
			pinctrl-3 = <0x7>;
			pinctrl-names = "default", "rst-low", "rst-high", "irq-init";
			sil,ldo_disable = <0x0>;
			sil,silead_irq = <0xffffffff 0x1 0x0>;
			sil,vmch_enable = <0x2>;
			status = "okay";
		};
	};

	fragment@12 {
		target = <0xffffffff>;

		__overlay__ {

			goodix_irq_no_pull {
				phandle = <0xa>;

				pins_cmd_dat {
					bias-disable;
					pinmux = <0x100>;
					slew-rate = <0x0>;
				};
			};

			goodix_irq_out_low {
				phandle = <0x9>;

				pins_cmd_dat {
					output-low;
					pinmux = <0x100>;
					slew-rate = <0x1>;
				};
			};

			goodix_reset_default {
				phandle = <0x8>;

				pins_cmd_dat {
					output-low;
					pinmux = <0xad00>;
					slew-rate = <0x1>;
				};
			};
		};
	};

	fragment@13 {
		target = <0xffffffff>;

		__overlay__ {
			gf,cs_gpio_disable = <0x1>;
			goodix,gpio_irq = <0xffffffff 0x1 0x0>;
			goodix,gpio_reset = <0xffffffff 0xad 0x0>;
			interrupt-parent = <0xffffffff>;
			interrupts = <0x1 0x0>;
			pinctrl-0 = <0x8>;
			pinctrl-1 = <0x9>;
			pinctrl-2 = <0xa>;
			pinctrl-names = "goodix_reset_default", "goodix_irq_out_low", "goodix_irq_no_pull";
			spi-max-frequency = <0x7a1200>;
			status = "okay";
		};
	};

	fragment@14 {
		target = <0xffffffff>;

		__overlay__ {

			gpio_id0_default {
				phandle = <0xb>;

				pins_cmd_dat {
					bias-pull-up = <0x0>;
					pinmux = <0xaa00>;
					slew-rate = <0x0>;
				};
			};

			gpio_id0_pull_down {
				phandle = <0xd>;

				pins_cmd_dat {
					bias-pull-down = <0x0>;
					pinmux = <0xaa00>;
					slew-rate = <0x0>;
				};
			};

			gpio_id0_pull_up {
				phandle = <0xc>;

				pins_cmd_dat {
					bias-pull-up = <0x0>;
					pinmux = <0xaa00>;
					slew-rate = <0x0>;
				};
			};
		};
	};

	fragment@15 {
		target = <0xffffffff>;

		__overlay__ {
			compatible = "oplus,fp_common";
			oplus,fp_gpio_0 = <0xffffffff 0xaa 0x0>;
			oplus,fp_gpio_num = <0x1>;
			pinctrl-0 = <0xb>;
			pinctrl-1 = <0xc>;
			pinctrl-2 = <0xd>;
			pinctrl-names = "gpio_id0_default", "gpio_id0_pull_up", "gpio_id0_pull_down";

			gf_3956 {
				chip-name = "G_3956";
				eng-menu = "-1,-1";
				oplus,fp-id = <0x1>;
				vendor-chip = <0x14>;
			};

			silead_6159 {
				chip-name = "S_gsl6159";
				eng-menu = "-1,-1";
				oplus,fp-id = <0x0>;
				vendor-chip = <0x13>;
			};
		};
	};

	fragment@16 {
		target = <0xffffffff>;

		__overlay__ {

			gps_default {
				phandle = <0xe>;
			};

			gps_l1_lna@0 {
				phandle = <0xf>;

				pins_cmd_dat {
					output-low;
					pinmux = <0xac00>;
				};
			};

			gps_l1_lna@1 {
				phandle = <0x10>;

				pins_cmd_dat {
					pinmux = <0xac02>;
				};
			};

			gps_l1_lna@2 {
				phandle = <0x11>;

				pins_cmd_dat {
					output-high;
					pinmux = <0xac00>;
				};
			};

			gps_l5_lna@0 {
				phandle = <0x12>;

				pins_cmd_dat {
					output-low;
					pinmux = <0xad00>;
				};
			};

			gps_l5_lna@1 {
				phandle = <0x13>;

				pins_cmd_dat {
					pinmux = <0xad02>;
				};
			};

			gps_l5_lna@2 {
				phandle = <0x14>;

				pins_cmd_dat {
					output-high;
					pinmux = <0xad00>;
				};
			};
		};
	};

	fragment@17 {
		target = <0xffffffff>;

		__overlay__ {
			pinctrl-0 = <0xe>;
			pinctrl-1 = <0xf>;
			pinctrl-2 = <0x10>;
			pinctrl-3 = <0x11>;
			pinctrl-4 = <0x12>;
			pinctrl-5 = <0x13>;
			pinctrl-6 = <0x14>;
			pinctrl-names = "default", "gps_l1_lna_disable", "gps_l1_lna_dsp_ctrl", "gps_l1_lna_enable", "gps_l5_lna_disable", "gps_l5_lna_dsp_ctrl", "gps_l5_lna_enable";
			status = "okay";
		};
	};

	fragment@18 {
		target = <0xffffffff>;

		__overlay__ {
			mt6370,intr_gpio = <0xffffffff 0x4 0x0>;
			mt6370,intr_gpio_num = <0x4>;
		};
	};

	fragment@19 {
		target = <0xffffffff>;

		__overlay__ {
			mt6370pd,intr_gpio = <0xffffffff 0x53 0x0>;
			mt6370pd,intr_gpio_num = <0x53>;
		};
	};

	fragment@2 {
		target = <0xffffffff>;

		__overlay__ {
		};
	};

	fragment@20 {
		target = <0xffffffff>;

		__overlay__ {
			clock-frequency = <0x61a80>;

			bq25601d-charger@6b {
				chg-irq-gpio = <0xffffffff 0x2a 0x2002>;
				chip-name = "BQ25601D";
				compatible = "oplus,bq25601d-charger";
				interrupt-parent = <0xffffffff>;
				interrupts = <0x2a 0x2 0x2a 0x0>;
				pinctrl-0 = <0x15>;
				pinctrl-1 = <0x16>;
				pinctrl-names = "slave_charger_enable", "slave_charger_disable";
				qcom,slave-chg-en-gpio = <0xffffffff 0x6 0x0>;
				reg = <0x6b>;
				status = "okay";
			};

			mtk-usb@60 {
				compatible = "mediatek,mtk-usb";
				reg = <0x60>;
				status = "okay";
			};
		};
	};

	fragment@21 {
		target = <0xffffffff>;

		__overlay__ {
			keypad,volume-down = <0xffffffff 0x51 0x0>;
			keypad,volume-up = <0xffffffff 0x50 0x0>;
			pinctrl-0 = <0x17>;
			pinctrl-1 = <0x18>;
			pinctrl-names = "volume_up_as_int", "volume_down_as_int";
			status = "okay";
		};
	};

	fragment@22 {
		target = <0xffffffff>;

		__overlay__ {

			volume_down@0 {
				phandle = <0x18>;

				pins_cmd_dat {
					bias-pull-up = <0x1>;
					input-enable;
					pinmux = <0x5100>;
					slew-rate = <0x0>;
				};
			};

			volume_up@0 {
				phandle = <0x17>;

				pins_cmd_dat {
					bias-pull-up = <0x0>;
					input-enable;
					pinmux = <0x5000>;
					slew-rate = <0x0>;
				};
			};
		};
	};

	fragment@23 {
		target = <0xffffffff>;

		__overlay__ {
			accdet-mic-mode = <0x1>;
			accdet-mic-vol = <0x7>;
			accdet-plugout-debounce = <0x1>;
			headset-eint-level-pol = <0x8>;
			headset-four-key-threshold = <0x0 0x3a 0x79 0xc0 0x190>;
			headset-mode-setting = <0x500 0x500 0x1 0x1f0 0x800 0x800 0x20 0x44>;
			headset-three-key-threshold = <0x0 0x50 0xdc 0x190>;
			headset-three-key-threshold-CDD = <0x0 0x79 0xc0 0x258>;
			status = "okay";
		};
	};

	fragment@24 {
		target = <0xffffffff>;

		__overlay__ {

			lcm_dsi_te {
				phandle = <0x1b>;

				pins_cmd_dat {
					pinmux = <0x6101>;
				};
			};

			lcm_rst_out0_gpio {
				phandle = <0x1a>;

				pins_cmd_dat {
					output-low;
					pinmux = <0x6300>;
					slew-rate = <0x1>;
				};
			};

			lcm_rst_out1_gpio {
				phandle = <0x19>;

				pins_cmd_dat {
					output-high;
					pinmux = <0x6300>;
					slew-rate = <0x1>;
				};
			};
		};
	};

	fragment@25 {
		target = <0xffffffff>;

		__overlay__ {
			pinctrl-0 = <0x19>;
			pinctrl-1 = <0x1a>;
			pinctrl-2 = <0x1b>;
			pinctrl-names = "lcm_rst_out1_gpio", "lcm_rst_out0_gpio", "mode_te_te";
			status = "okay";
		};
	};

	fragment@26 {
		target = <0xffffffff>;

		__overlay__ {
			pinctrl-0 = <0x19>;
			pinctrl-1 = <0x1a>;
			pinctrl-2 = <0x1b>;
			pinctrl-names = "lcm_rst_out1_gpio", "lcm_rst_out0_gpio", "mode_te_te";
			status = "okay";
		};
	};

	fragment@27 {
		target = <0xffffffff>;

		__overlay__ {
			#address-cells = <0x1>;
			#size-cells = <0x0>;
			status = "okay";

			panel1@0 {
				compatible = "boe,boe,ili7807s,vdo";
				pinctrl-names = "default";
				reg = <0x0>;
				reset-gpios = <0xffffffff 0x63 0x0>;

				port {

					endpoint {
						phandle = <0x1d>;
						remote-endpoint = <0x1c>;
					};
				};
			};

			panel2@0 {
				compatible = "boe,ili7807s,60hz,vdo";
				pinctrl-names = "default";
				reg = <0x1>;
				reset-gpios = <0xffffffff 0x63 0x0>;

				port {

					endpoint {
						phandle = <0x6a>;
						remote-endpoint = <0x1c>;
					};
				};
			};

			panel3@0 {
				compatible = "tm,nt36672c,,60hz,vdo";
				pinctrl-names = "default";
				reg = <0x2>;
				reset-gpios = <0xffffffff 0x63 0x0>;

				port {

					endpoint {
						phandle = <0x6b>;
						remote-endpoint = <0x1c>;
					};
				};
			};

			ports {

				port {

					endpoint {
						phandle = <0x1c>;
						remote-endpoint = <0x1d>;
					};
				};
			};
		};
	};

	fragment@28 {
		target = <0xffffffff>;

		__overlay__ {
			FUELGAGUE_APPLY = <0x1>;
			R_FG_VALUE = <0x5>;
			battery0_profile_t0 = <0x0 0xacaa 0x3d4 0x3a3 0x1ef 0xac3c 0x3d6 0x3a5 0x3de 0xabd9 0x3e2 0x3b0 0x5cd 0xab7a 0x3ee 0x3bc 0x7bc 0xab1a 0x3ec 0x3ba 0x9ab 0xaab7 0x3eb 0x3b9 0xb9a 0xaa52 0x3f3 0x3c1 0xd89 0xa9e9 0x3f3 0x3c1 0xf78 0xa97c 0x3f3 0x3c1 0x1167 0xa90e 0x3f3 0x3c1 0x1356 0xa8a0 0x3fe 0x3cb 0x1545 0xa82f 0x401 0x3cd 0x1733 0xa7bc 0x409 0x3d5 0x1922 0xa745 0x400 0x3cd 0x1b11 0xa6cd 0x3f7 0x3c4 0x1d00 0xa653 0x3fd 0x3ca 0x1eef 0xa5d5 0x3f3 0x3c1 0x20de 0xa55d 0x401 0x3cd 0x22cd 0xa4e4 0x3ff 0x3cb 0x24bc 0xa46c 0x40b 0x3d7 0x26ab 0xa3ef 0x403 0x3d0 0x289a 0xa375 0x407 0x3d3 0x2a89 0xa2fd 0x40e 0x3da 0x2c78 0xa286 0x412 0x3de 0x2e67 0xa211 0x41b 0x3e7 0x3056 0xa19a 0x41b 0x3e7 0x3245 0xa127 0x41b 0x3e7 0x3434 0xa0b4 0x429 0x3f3 0x3623 0xa040 0x429 0x3f4 0x3812 0x9fd1 0x429 0x3f3 0x3a01 0x9f6a 0x43e 0x408 0x3bf0 0x9f03 0x453 0x408 0x3ddf 0x9e97 0x457 0x3e8 0x3fce 0x9e2f 0x45e 0x3e6 0x41bc 0x9dc6 0x454 0x3dc 0x43ab 0x9d5e 0x460 0x3b9 0x459a 0x9cfb 0x46d 0x3ce 0x4789 0x9c9d 0x483 0x3d4 0x4978 0x9c3c 0x493 0x3ce 0x4b67 0x9bda 0x4a5 0x3c5 0x4d56 0x9b77 0x4bc 0x3bd 0x4f45 0x9b0d 0x4c5 0x3b8 0x5134 0x9a8b 0x49b 0x3bf 0x5323 0x99e7 0x447 0x3b6 0x5512 0x995d 0x415 0x3d0 0x5701 0x98f1 0x404 0x3b6 0x58f0 0x9894 0x3f8 0x3ac 0x5adf 0x9846 0x3f2 0x3ac 0x5cce 0x97fc 0x3f1 0x3b4 0x5ebd 0x97b5 0x3f5 0x3bd 0x60ac 0x9777 0x3fe 0x3b6 0x629b 0x9731 0x3f4 0x3b7 0x648a 0x96fb 0x400 0x3bf 0x6679 0x96be 0x3ff 0x3c0 0x6868 0x9686 0x3fe 0x3b2 0x6a57 0x964c 0x3f6 0x3b2 0x6c45 0x9615 0x3f1 0x3ba 0x6e34 0x95e6 0x3fb 0x3c8 0x7023 0x95b9 0x40e 0x3da 0x7212 0x9589 0x410 0x3d7 0x7401 0x955c 0x41b 0x3c0 0x75f0 0x952c 0x40f 0x3b7 0x77df 0x9504 0x418 0x3b6 0x79ce 0x94de 0x42f 0x3bd 0x7bbd 0x94bb 0x440 0x3c0 0x7dac 0x9495 0x440 0x3bc 0x7f9b 0x946c 0x441 0x3b6 0x818a 0x944a 0x453 0x3b6 0x8379 0x9423 0x452 0x3b5 0x8568 0x93f8 0x446 0x3ac 0x8757 0x93b1 0x422 0x3a4 0x8946 0x935d 0x3fe 0x3b8 0x8b35 0x9315 0x3f3 0x3c1 0x8d24 0x92df 0x400 0x3cd 0x8f13 0x92b1 0x40e 0x3da 0x9102 0x927e 0x40a 0x3d7 0x92f1 0x9249 0x403 0x3cf 0x94e0 0x921c 0x40e 0x3d9 0x96ce 0x91f1 0x41a 0x3c2 0x98bd 0x91c5 0x411 0x3b8 0x9aac 0x919a 0x40e 0x3b6 0x9c9b 0x9163 0x40e 0x3b6 0x9e8a 0x9124 0x408 0x3b2 0xa079 0x90e4 0x401 0x3ac 0xa268 0x90a8 0x403 0x3b6 0xa457 0x9069 0x40a 0x3d6 0xa646 0x9011 0x3e4 0x3b2 0xa835 0x8fd9 0x3cc 0x39c 0xaa24 0x8fc8 0x3e9 0x3b7 0xac13 0x8fbd 0x404 0x3d1 0xae02 0x8faf 0x41c 0x3e7 0xaff1 0x8fa1 0x44b 0x414 0xb1e0 0x8f8a 0x491 0x457 0xb3cf 0x8f36 0x4b0 0x474 0xb5be 0x8e42 0x453 0x41c 0xb7ad 0x8c7c 0x453 0x41c 0xb99c 0x8a1d 0x474 0x43b 0xbb8b 0x86cb 0x4ca 0x48c 0xbd7a 0x8149 0x637 0x5e7 0xbf69 0x7e3c 0x2e63 0x2c11>;
			battery0_profile_t0_col = <0x4>;
			battery0_profile_t0_num = <0x64>;
			battery0_profile_t1 = <0x0 0xac53 0x514 0x44c 0x1ef 0xabf1 0x515 0x44c 0x3de 0xab93 0x520 0x44c 0x5cd 0xab36 0x523 0x44c 0x7bc 0xaad6 0x523 0x44c 0x9ab 0xaa71 0x523 0x44c 0xb9a 0xaa09 0x527 0x44c 0xd89 0xa9a1 0x532 0x44c 0xf78 0xa939 0x530 0x44c 0x1167 0xa8c6 0x532 0x44c 0x1356 0xa84e 0x531 0x44c 0x1545 0xa7d5 0x530 0x44c 0x1733 0xa75d 0x530 0x44c 0x1922 0xa6e2 0x530 0x44c 0x1b11 0xa666 0x535 0x45d 0x1d00 0xa5ec 0x53e 0x47f 0x1eef 0xa56f 0x541 0x480 0x20de 0xa4f7 0x54b 0x47f 0x22cd 0xa479 0x54d 0x480 0x24bc 0xa400 0x54b 0x481 0x26ab 0xa388 0x542 0x481 0x289a 0xa313 0x54d 0x482 0x2a89 0xa29d 0x55a 0x482 0x2c78 0xa225 0x55d 0x483 0x2e67 0xa1ae 0x56a 0x483 0x3056 0xa13b 0x575 0x484 0x3245 0xa0c9 0x577 0x484 0x3434 0xa055 0x581 0x485 0x3623 0x9feb 0x58e 0x485 0x3812 0x9f80 0x59a 0x4a1 0x3a01 0x9f13 0x59a 0x4b5 0x3bf0 0x9ea7 0x59c 0x4ba 0x3ddf 0x9e3f 0x5b0 0x4c8 0x3fce 0x9dd8 0x5bd 0x4d9 0x41bc 0x9d75 0x5d5 0x4c2 0x43ab 0x9d13 0x5ef 0x4e3 0x459a 0x9cb0 0x5fc 0x4f3 0x4789 0x9c4a 0x608 0x4ff 0x4978 0x9be5 0x61c 0x511 0x4b67 0x9b79 0x61e 0x527 0x4d56 0x9af6 0x5ee 0x53a 0x4f45 0x9a5c 0x58b 0x545 0x5134 0x99bf 0x51f 0x541 0x5323 0x9941 0x4e2 0x4fa 0x5512 0x98e7 0x4de 0x4a1 0x5701 0x988f 0x4de 0x47c 0x58f0 0x9842 0x4de 0x464 0x5adf 0x97fb 0x4de 0x45f 0x5cce 0x97b7 0x4de 0x45e 0x5ebd 0x9775 0x4de 0x44f 0x60ac 0x9735 0x4de 0x457 0x629b 0x96fe 0x4de 0x44c 0x648a 0x96c2 0x4eb 0x457 0x6679 0x968b 0x4ed 0x44f 0x6868 0x9654 0x4e3 0x454 0x6a57 0x9620 0x4ec 0x452 0x6c45 0x95f1 0x4ff 0x451 0x6e34 0x95c3 0x502 0x45c 0x7023 0x9593 0x4ff 0x465 0x7212 0x9568 0x524 0x466 0x7401 0x9541 0x53b 0x47f 0x75f0 0x9516 0x54a 0x489 0x77df 0x94f4 0x556 0x48d 0x79ce 0x94cf 0x562 0x495 0x7bbd 0x94ab 0x56e 0x4a0 0x7dac 0x9489 0x576 0x4a7 0x7f9b 0x9464 0x574 0x4a4 0x818a 0x9442 0x568 0x49d 0x8379 0x941c 0x568 0x4a6 0x8568 0x93eb 0x551 0x4b2 0x8757 0x93b9 0x538 0x4b3 0x8946 0x938c 0x532 0x4a5 0x8b35 0x935d 0x531 0x495 0x8d24 0x932c 0x52b 0x488 0x8f13 0x92fb 0x51f 0x47d 0x9102 0x92ca 0x517 0x476 0x92f1 0x929f 0x523 0x48d 0x94e0 0x9279 0x523 0x480 0x96ce 0x925c 0x538 0x476 0x98bd 0x9230 0x53e 0x47b 0x9aac 0x91ff 0x546 0x48e 0x9c9b 0x91c8 0x54c 0x49a 0x9e8a 0x918c 0x550 0x49a 0xa079 0x9150 0x55b 0x49a 0xa268 0x9111 0x55b 0x499 0xa457 0x90bf 0x55b 0x48e 0xa646 0x907d 0x544 0x498 0xa835 0x9060 0x54a 0x4a3 0xaa24 0x9052 0x55e 0x48e 0xac13 0x9047 0x57d 0x47f 0xae02 0x9037 0x5a2 0x484 0xaff1 0x901c 0x5d5 0x498 0xb1e0 0x8fdc 0x612 0x4b7 0xb3cf 0x8f14 0x5d7 0x4d1 0xb5be 0x8d64 0x5bd 0x4ff 0xb7ad 0x8b1f 0x607 0x536 0xb99c 0x87e3 0x65d 0x4fd 0xbb8b 0x8278 0x794 0x4ea 0xbd7a 0x7f3a 0x30ed 0x5b9 0xbf69 0x7f3a 0x30ed 0x5b9>;
			battery0_profile_t1_col = <0x4>;
			battery0_profile_t1_num = <0x64>;
			battery0_profile_t2 = <0x0 0xaca4 0x834 0x5af 0x1ef 0xac37 0x838 0x5af 0x3de 0xabd7 0x86e 0x5af 0x5cd 0xab76 0x87e 0x5af 0x7bc 0xab16 0x7bc 0x5af 0x9ab 0xaab9 0x77a 0x5af 0xb9a 0xaa57 0x81b 0x5af 0xd89 0xa9ec 0x851 0x5af 0xf78 0xa97a 0x831 0x5af 0x1167 0xa912 0x748 0x5af 0x1356 0xa89f 0x7b5 0x5af 0x1545 0xa828 0x812 0x5af 0x1733 0xa7af 0x7f7 0x5af 0x1922 0xa733 0x790 0x5af 0x1b11 0xa6b7 0x77e 0x5af 0x1d00 0xa63c 0x7d9 0x5af 0x1eef 0xa5bf 0x7ea 0x5af 0x20de 0xa545 0x776 0x5af 0x22cd 0xa4c1 0x790 0x5af 0x24bc 0xa448 0x759 0x5af 0x26ab 0xa3cb 0x7c1 0x5af 0x289a 0xa357 0x7a7 0x5af 0x2a89 0xa2e4 0x797 0x5f5 0x2c78 0xa26b 0x7ac 0x657 0x2e67 0xa1f2 0x7b8 0x661 0x3056 0xa17a 0x816 0x60e 0x3245 0xa107 0x7a2 0x61d 0x3434 0xa094 0x811 0x676 0x3623 0xa021 0x7cf 0x69e 0x3812 0x9fb6 0x808 0x613 0x3a01 0x9f4a 0x7dd 0x61e 0x3bf0 0x9edc 0x7f8 0x68d 0x3ddf 0x9e70 0x854 0x6dc 0x3fce 0x9e06 0x84e 0x6ce 0x41bc 0x9d99 0x884 0x63b 0x43ab 0x9d31 0x7d8 0x6d8 0x459a 0x9cc3 0x899 0x71a 0x4789 0x9c59 0x85e 0x6cc 0x4978 0x9bf5 0x86a 0x6aa 0x4b67 0x9b85 0x81d 0x6d5 0x4d56 0x9b04 0x7da 0x70d 0x4f45 0x9a7f 0x7cf 0x6eb 0x5134 0x99ff 0x779 0x66e 0x5323 0x997c 0x73d 0x656 0x5512 0x9903 0x69d 0x628 0x5701 0x98a0 0x6e0 0x612 0x58f0 0x9846 0x6ec 0x53e 0x5adf 0x97fa 0x6c9 0x55f 0x5cce 0x97b2 0x66c 0x59c 0x5ebd 0x976d 0x66b 0x5af 0x60ac 0x972c 0x6e4 0x5a4 0x629b 0x96ec 0x6f7 0x551 0x648a 0x96b5 0x65a 0x59b 0x6679 0x9678 0x5e9 0x58e 0x6868 0x9640 0x690 0x5c2 0x6a57 0x960e 0x704 0x5cd 0x6c45 0x95dd 0x6c7 0x5be 0x6e34 0x95ae 0x6ac 0x5b4 0x7023 0x9580 0x6ea 0x5b4 0x7212 0x954e 0x719 0x5b8 0x7401 0x9520 0x713 0x5c0 0x75f0 0x94fe 0x6b7 0x5c1 0x77df 0x94d8 0x6e8 0x5aa 0x79ce 0x94ac 0x718 0x594 0x7bbd 0x9489 0x740 0x5c4 0x7dac 0x9468 0x6ec 0x5f1 0x7f9b 0x944a 0x6c8 0x5be 0x818a 0x942b 0x70a 0x579 0x8379 0x9406 0x749 0x59d 0x8568 0x93e4 0x751 0x5f6 0x8757 0x93c4 0x6c1 0x5ff 0x8946 0x93ad 0x6a8 0x58d 0x8b35 0x938e 0x708 0x596 0x8d24 0x935c 0x72c 0x5c6 0x8f13 0x9333 0x6dc 0x5d3 0x9102 0x930d 0x6cb 0x595 0x92f1 0x92e1 0x715 0x558 0x94e0 0x92b2 0x72c 0x57d 0x96ce 0x927f 0x702 0x5be 0x98bd 0x9269 0x656 0x59b 0x9aac 0x923d 0x6f2 0x52c 0x9c9b 0x9207 0x746 0x561 0x9e8a 0x91b4 0x73f 0x5bf 0xa079 0x9175 0x6b2 0x5be 0xa268 0x9149 0x69e 0x56b 0xa457 0x910c 0x73d 0x54c 0xa646 0x90ad 0x78c 0x5ae 0xa835 0x9054 0x759 0x5fb 0xaa24 0x9054 0x627 0x5aa 0xac13 0x904e 0x6d8 0x545 0xae02 0x9044 0x7a8 0x581 0xaff1 0x9021 0x821 0x5f2 0xb1e0 0x8ffc 0x7d2 0x612 0xb3cf 0x8fa1 0x751 0x5dd 0xb5be 0x8ea3 0x77c 0x5d0 0xb7ad 0x8cb4 0x860 0x64b 0xb99c 0x89fc 0x91c 0x6bb 0xbb8b 0x863f 0x8b9 0x68e 0xbd7a 0x7f1a 0xbe9 0x661 0xbf69 0x7dba 0x2d4e 0x740>;
			battery0_profile_t2_col = <0x4>;
			battery0_profile_t2_num = <0x64>;
			battery0_profile_t3 = <0x0 0xac03 0x10ea 0xe9e 0x1ef 0xab7b 0x10ea 0xe9e 0x3de 0xab06 0x1120 0xecd 0x5cd 0xaa96 0x1126 0xed3 0x7bc 0xaa29 0x110b 0xeba 0x9ab 0xa9bc 0x10ec 0xea0 0xb9a 0xa94d 0x10d4 0xe8b 0xd89 0xa8dc 0x10bc 0xe77 0xf78 0xa86f 0x10a4 0xe62 0x1167 0xa7f7 0x1081 0xe44 0x1356 0xa785 0x1073 0xe37 0x1545 0xa70a 0x104a 0xe15 0x1733 0xa690 0x1028 0xdf6 0x1922 0xa618 0x1011 0xde3 0x1b11 0xa5a0 0xffe 0xdd2 0x1d00 0xa528 0xff1 0xdc8 0x1eef 0xa4b0 0xfe3 0xdbb 0x20de 0xa439 0xfcc 0xda7 0x22cd 0xa3c1 0xfb4 0xd93 0x24bc 0xa345 0xf9c 0xd7d 0x26ab 0xa2cf 0xf93 0xd75 0x289a 0xa25c 0xf94 0xd76 0x2a89 0xa1e8 0xf8b 0xd70 0x2c78 0xa172 0xf7b 0xd61 0x2e67 0xa104 0xf84 0xd69 0x3056 0xa08d 0xf79 0xd5f 0x3245 0xa01a 0xf78 0xd5e 0x3434 0x9fac 0xf6e 0xd56 0x3623 0x9f3f 0xf6b 0xd53 0x3812 0x9ed2 0xf70 0xd57 0x3a01 0x9e62 0xf7b 0xd61 0x3bf0 0x9ded 0xf82 0xd67 0x3ddf 0x9d70 0xf72 0xd59 0x3fce 0x9ced 0xf41 0xd2f 0x41bc 0x9c6f 0xf10 0xd05 0x43ab 0x9bf2 0xee1 0xcdc 0x459a 0x9b79 0xe9f 0xca3 0x4789 0x9b01 0xe56 0xc64 0x4978 0x9a8c 0xe18 0xc2f 0x4b67 0x9a19 0xde8 0xc05 0x4d56 0x99a7 0xdb9 0xbdc 0x4f45 0x993a 0xd94 0xbbc 0x5134 0x98d9 0xd7d 0xba8 0x5323 0x9877 0xd65 0xb94 0x5512 0x9821 0xd57 0xb88 0x5701 0x97cf 0xd4a 0xb7c 0x58f0 0x9780 0xd43 0xb76 0x5adf 0x9735 0xd3f 0xb73 0x5cce 0x96f0 0xd3a 0xb6e 0x5ebd 0x96ae 0xd43 0xb76 0x60ac 0x966d 0xd45 0xb77 0x629b 0x9636 0xd5a 0xb8b 0x648a 0x95fb 0xd73 0xba0 0x6679 0x95c6 0xd7b 0xba7 0x6868 0x9592 0xd81 0xbac 0x6a57 0x955e 0xd92 0xbbb 0x6c45 0x952d 0xda7 0xbcd 0x6e34 0x94fc 0xdb4 0xbd8 0x7023 0x94d1 0xdcd 0xbee 0x7212 0x94a5 0xdda 0xbf8 0x7401 0x947e 0xdef 0xc0b 0x75f0 0x9458 0xdfe 0xc18 0x77df 0x9432 0xe11 0xc29 0x79ce 0x940e 0xe2a 0xc3e 0x7bbd 0x93ed 0xe3f 0xc50 0x7dac 0x93cd 0xe4d 0xc5c 0x7f9b 0x93ab 0xe63 0xc6f 0x818a 0x9390 0xe70 0xc7b 0x8379 0x937a 0xe92 0xc97 0x8568 0x9368 0xec8 0xcc6 0x8757 0x9351 0xeef 0xce8 0x8946 0x9336 0xf16 0xd0a 0x8b35 0x931b 0xf53 0xd3e 0x8d24 0x92ff 0xf91 0xd74 0x8f13 0x92de 0xfd9 0xdb3 0x9102 0x92b7 0x1021 0xdf1 0x92f1 0x928d 0x1080 0xe42 0x94e0 0x925d 0x10f2 0xea6 0x96ce 0x922c 0x116b 0xf0e 0x98bd 0x91f3 0x11ea 0xf7c 0x9aac 0x91b2 0x127a 0xff9 0x9c9b 0x916f 0x1326 0x108d 0x9e8a 0x9129 0x13dd 0x112a 0xa079 0x90dc 0x14a9 0x11dc 0xa268 0x9095 0x1576 0x128c 0xa457 0x904e 0x166a 0x135f 0xa646 0x900e 0x1777 0x1448 0xa835 0x8fdd 0x18ab 0x1552 0xaa24 0x8fb9 0x1a18 0x168e 0xac13 0x8f92 0x1bc4 0x17ff 0xae02 0x8f54 0x1db4 0x19ac 0xaff1 0x8efc 0x2027 0x1bca 0xb1e0 0x8e6c 0x231a 0x1e57 0xb3cf 0x8d50 0x266b 0x2135 0xb5be 0x8b7d 0x2aef 0x251c 0xb7ad 0x88d8 0x31af 0x2af2 0xb99c 0x86fa 0x3cad 0x3471 0xbb8b 0x86fa 0x4176 0x3894 0xbd7a 0x86fa 0x4176 0x3894 0xbf69 0x86fa 0x4176 0x3894>;
			battery0_profile_t3_col = <0x4>;
			battery0_profile_t3_num = <0x64>;
			battery0_profile_t4 = <0x0 0xac85 0x2418 0x1fd6 0x1ef 0xabc6 0x2418 0x1fd5 0x3de 0xab24 0x248a 0x203a 0x5cd 0xaa89 0x24bf 0x2069 0x7bc 0xa9f1 0x24b4 0x2060 0x9ab 0xa95b 0x2480 0x2031 0xb9a 0xa8cb 0x2454 0x200b 0xd89 0xa841 0x242e 0x1fe9 0xf78 0xa7af 0x22ed 0x1ece 0x1167 0xa721 0x23a3 0x1f6e 0x1356 0xa698 0x238c 0x1f5a 0x1545 0xa641 0x23b6 0x1f7f 0x1733 0xa5dc 0x1fa1 0x1be6 0x1922 0xa557 0x1e0d 0x1a81 0x1b11 0xa4ca 0x20d7 0x1cf7 0x1d00 0xa448 0x2101 0x1d1c 0x1eef 0xa3c5 0x20dc 0x1cfb 0x20de 0xa347 0x20ab 0x1cd0 0x22cd 0xa2c5 0x206e 0x1c9a 0x24bc 0xa24b 0x2045 0x1c76 0x26ab 0xa1d4 0x200a 0x1c42 0x289a 0xa15c 0x1fd9 0x1c17 0x2a89 0xa0e4 0x1fca 0x1c0a 0x2c78 0xa06d 0x1fc9 0x1c09 0x2e67 0x9ffc 0x1fbb 0x1bfc 0x3056 0x9f8f 0x1f96 0x1bdc 0x3245 0x9f22 0x1f94 0x1bda 0x3434 0x9eac 0x1f94 0x1bda 0x3623 0x9e28 0x1f7b 0x1bc4 0x3812 0x9da0 0x1f49 0x1b98 0x3a01 0x9d18 0x1f12 0x1b67 0x3bf0 0x9c91 0x1ee1 0x1b3c 0x3ddf 0x9c10 0x1eba 0x1b1a 0x3fce 0x9b98 0x1ed3 0x1b30 0x41bc 0x9b2b 0x1eb1 0x1b12 0x43ab 0x9acc 0x1c23 0x18d1 0x459a 0x9a7f 0x1dee 0x1a66 0x4789 0x9a16 0x1def 0x1a67 0x4978 0x999a 0x1d9b 0x1a1d 0x4b67 0x992b 0x1fba 0x1bfc 0x4d56 0x98c4 0x1fff 0x1c39 0x4f45 0x985c 0x1ff5 0x1c30 0x5134 0x980b 0x203d 0x1c6f 0x5323 0x97b0 0x2066 0x1c94 0x5512 0x9767 0x1778 0x14b3 0x5701 0x9715 0x1a4b 0x1730 0x58f0 0x96be 0x2150 0x1d62 0x5adf 0x9672 0x21ce 0x1dd1 0x5cce 0x9630 0x2203 0x1e00 0x5ebd 0x95e9 0x221f 0x1e18 0x60ac 0x95ad 0x228c 0x1e78 0x629b 0x9572 0x22d9 0x1ebc 0x648a 0x9535 0x2317 0x1ef3 0x6679 0x9504 0x235b 0x1f2f 0x6868 0x94d8 0x23b0 0x1f7a 0x6a57 0x94ad 0x2408 0x1fc7 0x6c45 0x9485 0x2457 0x200d 0x6e34 0x946a 0x24b7 0x2062 0x7023 0x944f 0x2524 0x20c2 0x7212 0x9433 0x25a7 0x2136 0x7401 0x941c 0x262c 0x21ab 0x75f0 0x9406 0x26c9 0x2235 0x77df 0x93f0 0x2772 0x22cb 0x79ce 0x93dd 0x2820 0x2364 0x7bbd 0x93ca 0x28d6 0x2404 0x7dac 0x93b0 0x2989 0x24a3 0x7f9b 0x939a 0x2a33 0x2538 0x818a 0x9384 0x2b15 0x2600 0x8379 0x9369 0x2c05 0x26d3 0x8568 0x934a 0x2cf8 0x27a9 0x8757 0x932d 0x2dfe 0x2890 0x8946 0x9312 0x2f22 0x2992 0x8b35 0x92f3 0x3051 0x2a9d 0x8d24 0x92d0 0x3153 0x2b81 0x8f13 0x92c0 0x31e4 0x2c01 0x9102 0x928e 0x31e4 0x2c01 0x92f1 0x9262 0x3371 0x2d5f 0x94e0 0x9232 0x348c 0x2e59 0x96ce 0x9205 0x3549 0x2f00 0x98bd 0x91d7 0x35e8 0x2f8c 0x9aac 0x91a4 0x3672 0x3006 0x9c9b 0x916c 0x36eb 0x3070 0x9e8a 0x9131 0x3762 0x30d9 0xa079 0x90f5 0x37aa 0x3118 0xa268 0x90b8 0x3807 0x316b 0xa457 0x9079 0x388d 0x31e1 0xa646 0x903b 0x3943 0x3282 0xa835 0x8fff 0x39e8 0x3313 0xaa24 0x8fcb 0x3a87 0x339f 0xac13 0x8fa4 0x3b76 0x3472 0xae02 0x8f7e 0x3c94 0x356e 0xaff1 0x8f58 0x3e15 0x36c2 0xb1e0 0x8f1d 0x3fe7 0x385d 0xb3cf 0x8ebf 0x426a 0x3a94 0xb5be 0x8e02 0x45aa 0x3d71 0xb7ad 0x8d91 0x4c42 0x4342 0xb99c 0x8d91 0x5013 0x46a0 0xbb8b 0x8d91 0x5013 0x46a0 0xbd7a 0x8d91 0x5013 0x46a0 0xbf69 0x8d91 0x5013 0x46a0>;
			battery0_profile_t4_col = <0x4>;
			battery0_profile_t4_num = <0x64>;
			battery1_profile_t0 = <0x0 0xace2 0x3b6 0x387 0x1fd 0xac72 0x3b7 0x386 0x3fa 0xac06 0x3ac 0x393 0x5f8 0xaba5 0x3b3 0x395 0x7f5 0xab45 0x3b7 0x398 0x9f2 0xaae6 0x3b7 0x3a1 0xbef 0xaa84 0x3bd 0x3a7 0xded 0xaa1c 0x3bf 0x3a7 0xfea 0xa9b2 0x3b9 0x3a7 0x11e7 0xa948 0x3c6 0x3a8 0x13e4 0xa8dc 0x3d1 0x3af 0x15e1 0xa867 0x3c5 0x3a8 0x17df 0xa7f0 0x3c4 0x3a2 0x19dc 0xa776 0x3ba 0x3ac 0x1bd9 0xa6ff 0x3c0 0x3b3 0x1dd6 0xa685 0x3c4 0x3b1 0x1fd3 0xa607 0x3be 0x3b0 0x21d1 0xa588 0x3b6 0x3b1 0x23ce 0xa50c 0x3b9 0x3b3 0x25cb 0xa492 0x3c7 0x3b2 0x27c8 0xa41c 0x3d2 0x3bc 0x29c6 0xa3a0 0x3d2 0x3ba 0x2bc3 0xa325 0x3d2 0x3c2 0x2dc0 0xa2aa 0x3d4 0x3c3 0x2fbd 0xa22e 0x3c9 0x3c7 0x31ba 0xa1b6 0x3cd 0x3c9 0x33b8 0xa141 0x3d2 0x3c9 0x35b5 0xa0ce 0x3d9 0x3cc 0x37b2 0xa05b 0x3e1 0x3d2 0x39af 0x9fe9 0x3e5 0x3d9 0x3bad 0x9f7e 0x3ef 0x3e1 0x3daa 0x9f13 0x3ef 0x3dc 0x3fa7 0x9ea2 0x3ef 0x3dc 0x41a4 0x9e37 0x3ef 0x3f8 0x43a1 0x9dd1 0x403 0x3fd 0x459f 0x9d68 0x400 0x3fc 0x479c 0x9d05 0x40c 0x40c 0x4999 0x9ca6 0x425 0x41e 0x4b96 0x9c46 0x433 0x42f 0x4d93 0x9be6 0x436 0x43f 0x4f91 0x9b89 0x44a 0x444 0x518e 0x9b2e 0x46e 0x43b 0x538b 0x9ac7 0x485 0x3e8 0x5588 0x9a30 0x453 0x3b8 0x5786 0x9975 0x3e7 0x3b6 0x5983 0x98f1 0x3c8 0x3b1 0x5b80 0x988f 0x3bc 0x3b0 0x5d7d 0x9839 0x3b7 0x3af 0x5f7a 0x97ea 0x3b7 0x3ae 0x6178 0x97a3 0x3b7 0x3ae 0x6375 0x9760 0x3b7 0x3b0 0x6572 0x971d 0x3b7 0x3b0 0x676f 0x96df 0x3b7 0x3af 0x696d 0x96a2 0x3b7 0x3aa 0x6b6a 0x966a 0x3b7 0x3b4 0x6d67 0x9632 0x3b7 0x3b6 0x6f64 0x95fe 0x3b7 0x3b5 0x7161 0x95ce 0x3bf 0x3b9 0x735f 0x959b 0x3c4 0x3bc 0x755c 0x9568 0x3c4 0x3bb 0x7759 0x953d 0x3cd 0x3bf 0x7956 0x9513 0x3d9 0x3cc 0x7b53 0x94e4 0x3c6 0x3d6 0x7d51 0x94c1 0x3d2 0x3d6 0x7f4e 0x949a 0x3de 0x3dc 0x814b 0x9473 0x3e1 0x3ee 0x8348 0x9450 0x3e0 0x3eb 0x8546 0x942e 0x3e9 0x3f6 0x8743 0x9410 0x405 0x3e8 0x8940 0x93e9 0x40b 0x3c1 0x8b3d 0x93ab 0x3e9 0x3a7 0x8d3a 0x935b 0x3bf 0x3ab 0x8f38 0x930b 0x3ae 0x3b3 0x9135 0x92ce 0x3c4 0x3ae 0x9332 0x92a2 0x3c4 0x3b6 0x952f 0x9275 0x3c4 0x3b6 0x972d 0x923e 0x3c4 0x3bb 0x992a 0x920e 0x3ba 0x3bc 0x9b27 0x91e5 0x3c6 0x3c4 0x9d24 0x91be 0x3d3 0x3cc 0x9f21 0x9197 0x3d9 0x3c8 0xa11f 0x9169 0x3e3 0x3bc 0xa31c 0x912d 0x3e7 0x3bd 0xa519 0x90e6 0x3d2 0x3c9 0xa716 0x90a2 0x3c5 0x3c6 0xa913 0x9064 0x3d1 0x39d 0xab11 0x900d 0x3bb 0x3a0 0xad0e 0x8fd3 0x3a2 0x3ba 0xaf0b 0x8fbd 0x3a4 0x3d3 0xb108 0x8fb2 0x3c7 0x3fd 0xb306 0x8fa6 0x3f3 0x43b 0xb503 0x8f97 0x423 0x449 0xb700 0x8f78 0x461 0x40b 0xb8fd 0x8f20 0x47b 0x3f2 0xbafa 0x8e1b 0x408 0x416 0xbcf8 0x8c49 0x3fc 0x451 0xbef5 0x89e1 0x42e 0x525 0xc0f2 0x8685 0x46b 0x29ec 0xc2ef 0x8118 0x572 0x3338 0xc4ed 0x7f26 0x3036 0x3338>;
			battery1_profile_t0_col = <0x4>;
			battery1_profile_t0_num = <0x64>;
			battery1_profile_t1 = <0x0 0xac85 0x492 0x44e 0x1fd 0xac26 0x495 0x44c 0x3fa 0xabd0 0x4ab 0x44c 0x5f8 0xab73 0x4a5 0x455 0x7f5 0xab13 0x4aa 0x459 0x9f2 0xaab3 0x4af 0x452 0xbef 0xaa51 0x4b5 0x44c 0xded 0xa9e7 0x4b4 0x450 0xfea 0xa978 0x4a6 0x459 0x11e7 0xa90c 0x4b2 0x459 0x13e4 0xa89b 0x4bc 0x457 0x15e1 0xa81f 0x4ae 0x44a 0x17df 0xa7a8 0x4ba 0x44c 0x19dc 0xa72e 0x4bd 0x44c 0x1bd9 0xa6b2 0x4c5 0x455 0x1dd6 0xa632 0x4c2 0x460 0x1fd3 0xa5b4 0x4bc 0x465 0x21d1 0xa538 0x4bc 0x466 0x23ce 0xa4bd 0x4c2 0x467 0x25cb 0xa440 0x4c7 0x465 0x27c8 0xa3c0 0x4bf 0x463 0x29c6 0xa34a 0x4cb 0x459 0x2bc3 0xa2d4 0x4d8 0x465 0x2dc0 0xa258 0x4d8 0x465 0x2fbd 0xa1e1 0x4e2 0x479 0x31ba 0xa16b 0x4e5 0x489 0x33b8 0xa0f5 0x4df 0x486 0x35b5 0xa07e 0x4d9 0x47a 0x37b2 0xa00d 0x4e4 0x474 0x39af 0x9fa1 0x4f5 0x47c 0x3bad 0x9f32 0x4f8 0x491 0x3daa 0x9ec8 0x506 0x49c 0x3fa7 0x9e62 0x51c 0x49a 0x41a4 0x9df1 0x504 0x49a 0x43a1 0x9d8b 0x524 0x4b1 0x459f 0x9d22 0x536 0x4bf 0x479c 0x9cb7 0x543 0x4ca 0x4999 0x9c53 0x556 0x4dd 0x4b96 0x9bf9 0x56e 0x4ee 0x4d93 0x9b9e 0x582 0x4ff 0x4f91 0x9b36 0x58c 0x510 0x518e 0x9abc 0x57c 0x506 0x538b 0x9a1d 0x52d 0x4d0 0x5588 0x9974 0x4cb 0x465 0x5786 0x98f9 0x4b2 0x443 0x5983 0x9896 0x498 0x43d 0x5b80 0x9845 0x49e 0x43d 0x5d7d 0x97f6 0x490 0x42f 0x5f7a 0x97ae 0x48d 0x432 0x6178 0x976a 0x48d 0x432 0x6375 0x9729 0x48a 0x42d 0x6572 0x96ec 0x490 0x43c 0x676f 0x96af 0x488 0x433 0x696d 0x9677 0x492 0x433 0x6b6a 0x963f 0x486 0x43f 0x6d67 0x960c 0x492 0x43f 0x6f64 0x95de 0x49e 0x43f 0x7161 0x95ac 0x4a0 0x447 0x735f 0x957e 0x4b2 0x44b 0x755c 0x9554 0x4c3 0x459 0x7759 0x952a 0x4c9 0x46b 0x7956 0x94ff 0x4cf 0x473 0x7b53 0x94d8 0x4db 0x478 0x7d51 0x94b7 0x4e5 0x48d 0x7f4e 0x9495 0x4e5 0x48d 0x814b 0x946e 0x4db 0x48d 0x8348 0x944b 0x4e4 0x48d 0x8546 0x942e 0x4f0 0x4a1 0x8743 0x940e 0x4f3 0x4a7 0x8940 0x93e5 0x4e4 0x498 0x8b3d 0x93b6 0x4d3 0x481 0x8d3a 0x9383 0x4c5 0x46f 0x8f38 0x9352 0x4b9 0x45f 0x9135 0x9326 0x4b4 0x451 0x9332 0x92fe 0x4c9 0x465 0x952f 0x92d0 0x4bb 0x467 0x972d 0x929f 0x4b1 0x45a 0x992a 0x927b 0x4b9 0x46e 0x9b27 0x925e 0x4d1 0x472 0x9d24 0x923a 0x4d8 0x47c 0x9f21 0x9208 0x4d8 0x479 0xa11f 0x91c9 0x4d8 0x474 0xa31c 0x9188 0x4d3 0x46e 0xa519 0x914a 0x4cf 0x470 0xa716 0x9109 0x4db 0x489 0xa913 0x90b9 0x4e1 0x47f 0xab11 0x9066 0x4bb 0x474 0xad0e 0x904a 0x4bb 0x466 0xaf0b 0x903d 0x4c8 0x465 0xb108 0x9031 0x4e8 0x479 0xb306 0x9022 0x505 0x487 0xb503 0x900e 0x52e 0x4a2 0xb700 0x8fdb 0x566 0x4d3 0xb8fd 0x8f23 0x562 0x4da 0xbafa 0x8d92 0x524 0x4ae 0xbcf8 0x8b55 0x541 0x4c7 0xbef5 0x8853 0x57c 0x4f1 0xc0f2 0x83e2 0x605 0x551 0xc2ef 0x7828 0x188e 0x85e 0xc4ed 0x76de 0x1e14 0x656>;
			battery1_profile_t1_col = <0x4>;
			battery1_profile_t1_num = <0x64>;
			battery1_profile_t2 = <0x0 0xacbd 0x6b8 0x5af 0x1fd 0xac51 0x6ba 0x5af 0x3fa 0xabef 0x701 0x5af 0x5f8 0xab8e 0x70d 0x5af 0x7f5 0xab35 0x65c 0x5af 0x9f2 0xaad9 0x67a 0x5af 0xbef 0xaa75 0x6ec 0x5af 0xded 0xaa0b 0x701 0x5af 0xfea 0xa99f 0x6bc 0x5af 0x11e7 0xa92f 0x676 0x5af 0x13e4 0xa8b6 0x6d0 0x5af 0x15e1 0xa83a 0x6de 0x5af 0x17df 0xa7c2 0x641 0x5af 0x19dc 0xa74a 0x657 0x5af 0x1bd9 0xa6c8 0x6b9 0x5af 0x1dd6 0xa644 0x6dd 0x5af 0x1fd3 0xa5ca 0x646 0x5af 0x21d1 0xa54a 0x642 0x5af 0x23ce 0xa4ca 0x6ab 0x5af 0x25cb 0xa44a 0x6ea 0x5af 0x27c8 0xa3cc 0x69a 0x5af 0x29c6 0xa356 0x64b 0x5dc 0x2bc3 0xa2e1 0x6d7 0x64e 0x2dc0 0xa264 0x6fa 0x66e 0x2fbd 0xa1e6 0x691 0x60d 0x31ba 0xa16f 0x69f 0x61b 0x33b8 0xa0f7 0x702 0x675 0x35b5 0xa080 0x72f 0x69f 0x37b2 0xa011 0x689 0x605 0x39af 0x9fa1 0x6b2 0x62b 0x3bad 0x9f36 0x72c 0x69c 0x3daa 0x9ecc 0x77b 0x6e4 0x3fa7 0x9e62 0x734 0x6a2 0x41a4 0x9df5 0x6ef 0x664 0x43a1 0x9d7e 0x783 0x6ec 0x459f 0x9d08 0x7a8 0x70e 0x479c 0x9c9c 0x743 0x6b1 0x4999 0x9c30 0x739 0x6a7 0x4b96 0x9bc9 0x791 0x6f9 0x4d93 0x9b5d 0x7b9 0x71d 0x4f91 0x9aff 0x729 0x69a 0x518e 0x9a74 0x6ec 0x661 0x538b 0x99d6 0x6c2 0x63b 0x5588 0x9948 0x69f 0x61a 0x5786 0x98cd 0x607 0x58e 0x5983 0x9867 0x5a6 0x534 0x5b80 0x9811 0x616 0x59c 0x5d7d 0x97c1 0x621 0x5a6 0x5f7a 0x9780 0x637 0x5ba 0x6178 0x9737 0x5b9 0x546 0x6375 0x96f9 0x613 0x59a 0x6572 0x96b4 0x608 0x58f 0x676f 0x967e 0x63e 0x5c0 0x696d 0x9646 0x64b 0x5cd 0x6b6a 0x960d 0x63a 0x5bd 0x6d67 0x95dc 0x630 0x5b4 0x6f64 0x95ab 0x630 0x5b4 0x7161 0x957a 0x636 0x5b9 0x735f 0x954d 0x63f 0x5c1 0x755c 0x9521 0x639 0x5bc 0x7759 0x94f9 0x61f 0x5a3 0x7956 0x94d1 0x610 0x596 0x7b53 0x94aa 0x65b 0x5dc 0x7d51 0x9487 0x680 0x5fe 0x7f4e 0x946a 0x602 0x589 0x814b 0x9449 0x5f6 0x57f 0x8348 0x9427 0x64f 0x5d0 0x8546 0x9405 0x67f 0x5fd 0x8743 0x93ec 0x63b 0x5be 0x8940 0x93d2 0x606 0x58d 0x8b3d 0x93ae 0x62f 0x5b3 0x8d3a 0x9386 0x656 0x5d7 0x8f38 0x935f 0x62f 0x5b3 0x9135 0x933c 0x5c7 0x553 0x9332 0x930e 0x5e3 0x56c 0x952f 0x92e1 0x63d 0x5bf 0x972d 0x92ad 0x61b 0x5a0 0x992a 0x9284 0x5a7 0x536 0x9b27 0x926a 0x5d1 0x55d 0x9d24 0x9243 0x63c 0x5bf 0x9f21 0x91f9 0x63a 0x5bc 0xa11f 0x91b0 0x5da 0x564 0xa31c 0x917e 0x5ca 0x556 0xa519 0x9148 0x638 0x5bb 0xa716 0x90f0 0x66d 0x5ec 0xa913 0x908b 0x60f 0x596 0xab11 0x9066 0x5b0 0x53e 0xad0e 0x9060 0x616 0x59c 0xaf0b 0x904f 0x69f 0x61a 0xb108 0x9029 0x689 0x605 0xb306 0x901d 0x63a 0x5be 0xb503 0x9003 0x68a 0x606 0xb700 0x8f79 0x714 0x686 0xb8fd 0x8e07 0x735 0x6a3 0xbafa 0x8bcb 0x702 0x675 0xbcf8 0x88d0 0x73b 0x6a9 0xbef5 0x8413 0x93c 0x885 0xc0f2 0x7e51 0x1d85 0x1b38 0xc2ef 0x7e54 0x2e64 0x2ac0 0xc4ed 0x7e54 0x2e64 0x2ac0>;
			battery1_profile_t2_col = <0x4>;
			battery1_profile_t2_num = <0x64>;
			battery1_profile_t3 = <0x0 0xac34 0xa3c 0x8b7 0x1fd 0xabc4 0xa3a 0x8b7 0x3fa 0xab5e 0xa51 0x8b7 0x5f8 0xab06 0xa60 0x8b7 0x7f5 0xaaa6 0xa4a 0x8b7 0x9f2 0xaa45 0xa3a 0x8b7 0xbef 0xa9e0 0xa2e 0x8b7 0xded 0xa975 0xa1f 0x8b7 0xfea 0xa907 0xa18 0x8b7 0x11e7 0xa891 0x9fe 0x8b7 0x13e4 0xa815 0x9e5 0x8b7 0x15e1 0xa79f 0x9e7 0x8b7 0x17df 0xa724 0x9dc 0x8b7 0x19dc 0xa6a8 0x9e3 0x8b7 0x1bd9 0xa62d 0x9de 0x8b7 0x1dd6 0xa5b2 0x9da 0x8b7 0x1fd3 0xa536 0x9d3 0x8b7 0x21d1 0xa4b8 0x9c6 0x8b7 0x23ce 0xa439 0x9bf 0x8b7 0x25cb 0xa3bd 0x9bd 0x8b7 0x27c8 0xa343 0x9c0 0x8b7 0x29c6 0xa2cd 0x9da 0x8b7 0x2bc3 0xa257 0x9d8 0x8b7 0x2dc0 0xa1e1 0x9e5 0x90e 0x2fbd 0xa167 0x9e8 0x921 0x31ba 0xa0f3 0x9f0 0x928 0x33b8 0xa07c 0x9f5 0x92c 0x35b5 0xa003 0x9f5 0x92c 0x37b2 0x9f91 0xa03 0x93a 0x39af 0x9f28 0xa21 0x955 0x3bad 0x9ec3 0xa31 0x964 0x3daa 0x9e57 0xa48 0x97a 0x3fa7 0x9de1 0xa56 0x987 0x41a4 0x9d66 0xa55 0x985 0x43a1 0x9cea 0xa61 0x990 0x459f 0x9c73 0xa5b 0x98a 0x479c 0x9bf9 0xa3e 0x96f 0x4999 0x9b81 0xa1e 0x952 0x4b96 0x9b09 0x9f4 0x92c 0x4d93 0x9a8d 0x9bb 0x8f7 0x4f91 0x9a11 0x985 0x8c6 0x518e 0x9998 0x94b 0x890 0x538b 0x9928 0x924 0x86c 0x5588 0x98b7 0x8e6 0x833 0x5786 0x9851 0x8b3 0x804 0x5983 0x97f5 0x8a0 0x7f2 0x5b80 0x97a0 0x88b 0x7e0 0x5d7d 0x9756 0x889 0x7de 0x5f7a 0x9710 0x889 0x7de 0x6178 0x96c9 0x882 0x7d7 0x6375 0x9689 0x885 0x7da 0x6572 0x9650 0x88f 0x7e4 0x676f 0x9613 0x891 0x7e6 0x696d 0x95e1 0x8ac 0x7fe 0x6b6a 0x95a9 0x8a0 0x7f3 0x6d67 0x9575 0x8a9 0x7fb 0x6f64 0x954b 0x8bd 0x80d 0x7161 0x951d 0x8be 0x80e 0x735f 0x94ed 0x8c0 0x810 0x755c 0x94c0 0x8c6 0x815 0x7759 0x9497 0x8d2 0x821 0x7956 0x9474 0x8ef 0x83c 0x7b53 0x944d 0x8f1 0x83d 0x7d51 0x9426 0x8f0 0x83c 0x7f4e 0x940a 0x908 0x852 0x814b 0x93ee 0x909 0x854 0x8348 0x93cd 0x915 0x85f 0x8546 0x93af 0x919 0x862 0x8743 0x9397 0x920 0x869 0x8940 0x9381 0x92e 0x875 0x8b3d 0x9368 0x936 0x87d 0x8d3a 0x934e 0x93a 0x880 0x8f38 0x9337 0x943 0x889 0x9135 0x9320 0x944 0x88a 0x9332 0x9304 0x950 0x895 0x952f 0x92dd 0x95d 0x8a1 0x972d 0x92b5 0x95e 0x8a2 0x992a 0x928e 0x972 0x8b5 0x9b27 0x9263 0x982 0x8c3 0x9d24 0x9233 0x99c 0x8db 0x9f21 0x91f8 0x9b6 0x8f2 0xa11f 0x91b3 0x9cc 0x907 0xa31c 0x916e 0x9f8 0x930 0xa519 0x9133 0xa37 0x96a 0xa716 0x90e9 0xa73 0x9a2 0xa913 0x9089 0xa98 0x9c3 0xab11 0x904a 0xad5 0x9fb 0xad0e 0x9025 0xb29 0xa4a 0xaf0b 0x9007 0xb8b 0xaa3 0xb108 0x8fef 0xc16 0xb23 0xb306 0x8fd5 0xce0 0xbdd 0xb503 0x8fad 0xdfd 0xce4 0xb700 0x8f50 0xf87 0xe4f 0xb8fd 0x8e68 0x1187 0x1027 0xbafa 0x8c88 0x144d 0x12b7 0xbcf8 0x89e7 0x1a76 0x1863 0xbef5 0x8611 0x2c40 0x28ca 0xc0f2 0x85b6 0x3ecc 0x39de 0xc2ef 0x85b6 0x3ecc 0x39de 0xc4ed 0x85b6 0x3ecc 0x39de>;
			battery1_profile_t3_col = <0x4>;
			battery1_profile_t3_num = <0x64>;
			battery1_profile_t4 = <0x0 0xac91 0x14b4 0x1213 0x1fd 0xac05 0x14b8 0x1217 0x3fa 0xab88 0x14b8 0x1217 0x5f8 0xab23 0x14c4 0x1220 0x7f5 0xaabc 0x14b6 0x1215 0x9f2 0xaa51 0x1495 0x11f8 0xbef 0xa9e6 0x147b 0x11e1 0xded 0xa979 0x143d 0x11aa 0xfea 0xa909 0x13ec 0x1164 0x11e7 0xa898 0x1445 0x11b3 0x13e4 0xa823 0x142e 0x119e 0x15e1 0xa7b8 0x1422 0x1193 0x17df 0xa74e 0xfe0 0xddd 0x19dc 0xa6d1 0x1204 0xfba 0x1bd9 0xa64f 0x12e4 0x107e 0x1dd6 0xa5d2 0x12dd 0x1078 0x1fd3 0xa554 0x12cb 0x1068 0x21d1 0xa4d5 0x12b1 0x1052 0x23ce 0xa45a 0x1299 0x103c 0x25cb 0xa3df 0x127c 0x1023 0x27c8 0xa369 0x1259 0x1004 0x29c6 0xa2ee 0x124f 0xffb 0x2bc3 0xa277 0x1259 0x1004 0x2dc0 0xa202 0x1271 0x101a 0x2fbd 0xa188 0x1264 0x100e 0x31ba 0xa114 0x126d 0x1016 0x33b8 0xa09a 0x1268 0x1011 0x35b5 0xa01e 0x125a 0x1005 0x37b2 0x9fab 0x125f 0x100a 0x39af 0x9f3a 0x126d 0x1016 0x3bad 0x9eca 0x127c 0x1023 0x3daa 0x9e59 0x129f 0x1042 0x3fa7 0x9ddd 0x12ab 0x104c 0x41a4 0x9d58 0x12a2 0x1044 0x43a1 0x9cd1 0x117a 0xf42 0x459f 0x9c4f 0x1244 0xff2 0x479c 0x9bbf 0x119b 0xf5e 0x4999 0x9b31 0x119b 0xf5f 0x4b96 0x9aaf 0x12a5 0x1046 0x4d93 0x9a37 0x12a2 0x1044 0x4f91 0x99c8 0x1284 0x102a 0x518e 0x995e 0x1284 0x102a 0x538b 0x98f3 0x1282 0x1028 0x5588 0x98a4 0xce9 0xb46 0x5786 0x983c 0x1183 0xf4a 0x5983 0x97e3 0x1312 0x10a6 0x5b80 0x978f 0x133e 0x10cc 0x5d7d 0x973f 0x134b 0x10d8 0x5f7a 0x96f6 0x136b 0x10f3 0x6178 0x96b0 0x1394 0x1118 0x6375 0x9669 0x13aa 0x112a 0x6572 0x9627 0x13bc 0x113b 0x676f 0x95ef 0x13f9 0x116f 0x696d 0x95b1 0x1413 0x1186 0x6b6a 0x957e 0x144f 0x11bb 0x6d67 0x9547 0x146d 0x11d5 0x6f64 0x9513 0x1485 0x11ea 0x7161 0x94e1 0x14af 0x120f 0x735f 0x94b4 0x14e8 0x1240 0x755c 0x948d 0x1520 0x1271 0x7759 0x9464 0x1552 0x129d 0x7956 0x9439 0x157f 0x12c4 0x7b53 0x9417 0x159a 0x12dc 0x7d51 0x93f6 0x15cc 0x1307 0x7f4e 0x93df 0x15fe 0x1333 0x814b 0x93c4 0x1619 0x134a 0x8348 0x93b0 0x1650 0x137a 0x8546 0x939c 0x1687 0x13aa 0x8743 0x9389 0x16c7 0x13e3 0x8940 0x9378 0x1716 0x1427 0x8b3d 0x9363 0x1769 0x146f 0x8d3a 0x934b 0x17ab 0x14a9 0x8f38 0x933e 0x17b9 0x14b6 0x9135 0x9321 0x175d 0x1466 0x9332 0x9300 0x1862 0x154a 0x952f 0x92de 0x18f3 0x15c8 0x972d 0x92bc 0x1985 0x1647 0x992a 0x9292 0x1a12 0x16c2 0x9b27 0x9262 0x1aac 0x1749 0x9d24 0x922f 0x1b62 0x17e8 0x9f21 0x91f8 0x1c29 0x1896 0xa11f 0x91ba 0x1cf8 0x194a 0xa31c 0x917c 0x1dde 0x1a13 0xa519 0x9137 0x1edc 0x1af1 0xa716 0x90e8 0x2014 0x1c01 0xa913 0x90a0 0x2159 0x1d1e 0xab11 0x9056 0x22bd 0x1e54 0xad0e 0x901b 0x246b 0x1fcc 0xaf0b 0x8fe6 0x2693 0x21ad 0xb108 0x8fbe 0x295d 0x241d 0xb306 0x8f97 0x2ce6 0x2733 0xb503 0x8f6a 0x316f 0x2b29 0xb700 0x8f30 0x3764 0x305d 0xb8fd 0x8ec0 0x3f09 0x370b 0xbafa 0x8e00 0x4860 0x3f32 0xbcf8 0x8dfe 0x5133 0x46e3 0xbef5 0x8dfe 0x5133 0x46e3 0xc0f2 0x8dfe 0x5133 0x46e3 0xc2ef 0x8dfe 0x5133 0x46e3 0xc4ed 0x8dfe 0x5133 0x46e3>;
			battery1_profile_t4_col = <0x4>;
			battery1_profile_t4_num = <0x64>;
			g_FG_PSEUDO100 = <0x61 0x61 0x64 0x64 0x5f 0x5f 0x64 0x64 0x5e 0x5e 0x64 0x64 0x55 0x55 0x64 0x64 0x5a 0x5a 0x64 0x64 0x64 0x64 0x64 0x64 0x64 0x64 0x64 0x64 0x64 0x64 0x64 0x64 0x64 0x64 0x64 0x64 0x64 0x64 0x64 0x64>;
			g_FG_PSEUDO100_col = <0xa>;
			g_FG_PSEUDO100_row = <0x4>;
			g_PMIC_MIN_VOL = <0x80e8 0x80e8 0x80e8 0x80e8 0x80e8 0x80e8 0x80e8 0x80e8 0x7fbc 0x7fbc 0x7fbc 0x7fbc 0x84d0 0x81b0 0x7dc8 0x7dc8 0x84d0 0x80e8 0x7918 0x7918 0x7918 0x7918 0x7918 0x7918 0x7918 0x7918 0x7918 0x7918 0x7918 0x7918 0x7918 0x7918 0x7918 0x7918 0x7918 0x7918 0x7918 0x7918 0x7918 0x79e0>;
			g_PMIC_MIN_VOL_col = <0xa>;
			g_PMIC_MIN_VOL_row = <0x4>;
			g_PON_SYS_IBOOT = <0x1388 0x1388 0x1388 0x1388 0x1388 0x1388 0x1388 0x1388 0x1388 0x1388 0x1388 0x1388 0x1388 0x1388 0x1388 0x1388 0x1388 0x1388 0x1388 0x1388 0x1388 0x1388 0x1388 0x1388 0x1388 0x1388 0x1388 0x1388 0x1388 0x1388 0x1388 0x1388 0x1388 0x1388 0x1388 0x1388 0x1388 0x1388 0x1388 0x1388>;
			g_PON_SYS_IBOOT_col = <0xa>;
			g_PON_SYS_IBOOT_row = <0x4>;
			g_QMAX_SYS_VOL = <0x82dc 0x8340 0x82dc 0x82dc 0x82dc 0x8340 0x82dc 0x82dc 0x8598 0x84d0 0x82dc 0x82dc 0x7d00 0x7d00 0x7d00 0x7d00 0x7c9c 0x7c9c 0x7c9c 0x7c9c 0x8020 0x8020 0x8020 0x8020 0x8020 0x8020 0x8020 0x8020 0x8020 0x8020 0x8020 0x8020 0x8020 0x8020 0x8020 0x8020 0x8020 0x8020 0x8020 0x8020>;
			g_QMAX_SYS_VOL_col = <0xa>;
			g_QMAX_SYS_VOL_row = <0x4>;
			io-channel-names = "auxadc2-batt_id_v";
			io-channels = <0xffffffff 0x2>;
			pinctrl-0 = <0x1e>;
			pinctrl-1 = <0x1f>;
			pinctrl-2 = <0x20>;
			pinctrl-3 = <0x21>;
			pinctrl-4 = <0x22>;
			pinctrl-5 = <0x23>;
			pinctrl-names = "batid_disable", "batid_enable", "linktem_disable", "linktem_enable", "linkbustem_disable", "linkbustem_enable";
			qcom,batid-gpio = <0xffffffff 0x33 0x0>;
			qcom,linkbustem-gpio = <0xffffffff 0x31 0x0>;
			qcom,linktem-gpio = <0xffffffff 0x29 0x0>;
		};
	};

	fragment@29 {
		target = <0xffffffff>;

		__overlay__ {
			status = "okay";

			touchscreen@0 {
				black_gesture_support;
				black_gesture_test_support;
				charger_pump_support;
				chip-name = "NF_ILI7807S";
				compatible = "oplus,tp_noflash";
				esd_handle_support;
				fw_edge_limit_support;
				fw_update_app_support;
				game_switch_support;
				headset_pump_support;
				health_monitor_v2_support;
				incell_screen;
				interrupt-parent = <0xffffffff>;
				interrupts = <0xc 0x2 0xc 0x0>;
				irq-gpio = <0xffffffff 0xc 0x2002>;
				irq_need_dev_resume_ok;
				lcd_trigger_load_tp_fw_support;
				noflash_support;
				pinctrl-0 = <0x24>;
				pinctrl-names = "default", "pin_set_low", "pin_set_high";
				platform_support_project = <0x54b4 0x54b5 0x54b6 0x54b7 0x54ba 0x54bb 0x54bc>;
				platform_support_project_commandline = "default_commandline", "default_commandline", "default_commandline", "default_commandline", "default_commandline", "default_commandline", "default_commandline";
				platform_support_project_dir = <0x54b4 0x54b5 0x54b6 0x54b7 0x54ba 0x54bb 0x54bc>;
				pressure_report_support;
				prevention,condition_area_width = <0x3c 0x3c 0xa0 0xa0>;
				prevention,dead_area_width = <0x14 0x14>;
				prevention,eli_area_width = <0xf0 0x3e8 0x4b0 0xf0>;
				reg = <0x0>;
				reset-gpio = <0xffffffff 0x79 0x0>;
				smart_gesture_support;
				spi-max-frequency = <0x927c00>;
				status = "okay";
				touchpanel,button-type = <0x4>;
				touchpanel,display-coords = <0x438 0x96c>;
				touchpanel,max-num-support = <0xa>;
				touchpanel,panel-coords = <0x438 0x96c>;
				touchpanel,touchmajor-limit = <0x0 0x36>;
				touchpanel,tx-rx-num = <0x12 0x24>;
			};
		};
	};

	fragment@3 {
		target = <0xffffffff>;

		__overlay__ {
		};
	};

	fragment@30 {
		target = <0xffffffff>;

		__overlay__ {

			ctp_novatek_spi_mode {
				phandle = <0x24>;

				pins_cmd_dat {
					drive-strength = <0x4>;
					pinmux = <0xe02 0xd02 0x9002 0x9102>;
				};
			};
		};
	};

	fragment@31 {
		target = <0xffffffff>;

		__overlay__ {
			io-channel-names = "auxadc3-usb_temp_v_l", "auxadc4-flashlight_temp", "auxadc5-usb_temp_v_r";
			io-channels = <0xffffffff 0x3 0xffffffff 0x4 0xffffffff 0x5>;
			pinctrl-0 = <0x25>;
			pinctrl-1 = <0x26>;
			pinctrl-2 = <0x27>;
			pinctrl-3 = <0x28>;
			pinctrl-4 = <0x29>;
			pinctrl-5 = <0x2a>;
			pinctrl-6 = <0x2b>;
			pinctrl-7 = <0x2c>;
			pinctrl-8 = <0x2d>;
			pinctrl-names = "default", "charger_gpio_as_output_low", "charger_gpio_as_output_high", "dischg_enable", "dischg_disable", "chgvin_enable", "chgvin_disable", "state_uart0_rx_output0", "state_uart0_tx_output0";
			qcom,batid-gpio = <0xffffffff 0x33 0x0>;
			qcom,batt_capacity_mah = <0x1388>;
			qcom,charger_hv_thr = <0x16a8>;
			qcom,charger_lv_thr = <0xd48>;
			qcom,chargerid_switch-gpio = <0xffffffff 0x24 0x0>;
			qcom,chargerid_vol_disable;
			qcom,check_batt_full_by_sw;
			qcom,chg_ctrl_by_calling;
			qcom,chg_ctrl_by_camera;
			qcom,chg_ctrl_by_lcd;
			qcom,chgvin = <0xffffffff 0x3 0x0>;
			qcom,cold_bat_decidegc = <0x14>;
			qcom,cold_vfloat_over_sw_limit = <0xf96>;
			qcom,cold_vfloat_sw_limit = <0xf5a>;
			qcom,cool_bat_decidegc = <0x32>;
			qcom,cool_vfloat_over_sw_limit = <0x115d>;
			qcom,cool_vfloat_sw_limit = <0x1121>;
			qcom,default_iterm_ma = <0x10e>;
			qcom,default_little_cool_vfloat_over_sw_limit = <0x115d>;
			qcom,default_little_cool_vfloat_sw_limit = <0x1121>;
			qcom,default_normal_vfloat_over_sw_limit = <0x115d>;
			qcom,default_normal_vfloat_sw_limit = <0x1121>;
			qcom,default_temp_little_cool_fastchg_current_ma = <0x898>;
			qcom,default_temp_little_cool_vfloat_mv = <0x1153>;
			qcom,default_temp_normal_fastchg_current_ma = <0x898>;
			qcom,default_temp_normal_vfloat_mv = <0x1153>;
			qcom,dischg-gpio = <0xffffffff 0xf 0x0>;
			qcom,external_gauge;
			qcom,ff1_exit_step_ma = <0x258>;
			qcom,ff1_normal_fastchg_ma = <0x5dc>;
			qcom,ff1_warm_exit_step_ma = <0x1f4>;
			qcom,ffc2_exit_step_ma = <0x96>;
			qcom,ffc2_normal_fastchg_ma = <0x4b0>;
			qcom,ffc2_temp_high_decidegc = <0x190>;
			qcom,ffc2_temp_low_decidegc = <0x78>;
			qcom,ffc2_temp_warm_decidegc = <0x15e>;
			qcom,ffc2_warm_fastchg_ma = <0x514>;
			qcom,ffc_normal_vfloat_over_sw_limit = <0x11c6>;
			qcom,ffc_normal_vfloat_sw_limit = <0x117b>;
			qcom,ffc_support;
			qcom,ffc_temp_normal_vfloat_mv = <0x11c6>;
			qcom,fg_error_check;
			qcom,hot_bat_decidegc = <0x212>;
			qcom,hv_flashled_support;
			qcom,input_current_calling_ma = <0x5dc>;
			qcom,input_current_camera_ma = <0x4b0>;
			qcom,input_current_cdp_ma = <0x708>;
			qcom,input_current_charger_ma = <0x898>;
			qcom,input_current_led_ma = <0x4b0>;
			qcom,input_current_led_ma_forcmcc = <0x1f4>;
			qcom,input_current_led_ma_high = <0x4b0>;
			qcom,input_current_led_ma_normal = <0xd16>;
			qcom,input_current_led_ma_warm = <0x5dc>;
			qcom,input_current_usb_ma = <0x28a>;
			qcom,iterm_disabled = <0x0>;
			qcom,iterm_ma = <0x10e>;
			qcom,led_high_bat_decidegc = <0x172>;
			qcom,led_warm_bat_decidegc = <0x15e>;
			qcom,little_cold_bat_decidegc = <0x0>;
			qcom,little_cold_vfloat_over_sw_limit = <0x115d>;
			qcom,little_cold_vfloat_sw_limit = <0x1121>;
			qcom,little_cool_bat_decidegc = <0x78>;
			qcom,little_cool_vfloat_over_sw_limit = <0x115d>;
			qcom,little_cool_vfloat_sw_limit = <0x1121>;
			qcom,max_chg_time_sec = <0xe54c>;
			qcom,non_normal_vterm_hw_inc = <0x12>;
			qcom,non_standard_fastchg_current_ma = <0x200>;
			qcom,non_standard_vfloat_mv = <0xf8c>;
			qcom,non_standard_vfloat_over_sw_limit = <0xf96>;
			qcom,non_standard_vfloat_sw_limit = <0xf5a>;
			qcom,normal_bat_decidegc = <0xa0>;
			qcom,normal_phase1_bat_decidegc = <0xa0>;
			qcom,normal_phase2_bat_decidegc = <0xdc>;
			qcom,normal_phase3_bat_decidegc = <0x154>;
			qcom,normal_phase4_bat_decidegc = <0x172>;
			qcom,normal_phase5_bat_decidegc = <0x190>;
			qcom,normal_phase6_bat_decidegc = <0x1a4>;
			qcom,normal_vfloat_over_sw_limit = <0x115d>;
			qcom,normal_vfloat_sw_limit = <0x1121>;
			qcom,normal_vterm_hw_inc = <0x12>;
			qcom,overtemp_bat_decidegc = <0x15e>;
			qcom,pd_input_current_charger_ma = <0xd16>;
			qcom,pd_temp_cool_fastchg_current_ma_high = <0x8fc>;
			qcom,pd_temp_cool_fastchg_current_ma_low = <0x8fc>;
			qcom,pd_temp_little_cold_fastchg_current_ma_high = <0x92e>;
			qcom,pd_temp_little_cold_fastchg_current_ma_low = <0x578>;
			qcom,pd_temp_little_cool_fastchg_current_ma = <0xd16>;
			qcom,pd_temp_little_cool_fastchg_current_ma_low = <0x8fc>;
			qcom,pd_temp_normal_fastchg_current_ma = <0xd16>;
			qcom,pd_temp_warm_fastchg_current_ma = <0x578>;
			qcom,qc_input_current_charger_ma = <0x7d0>;
			qcom,qc_temp_cool_fastchg_current_ma_high = <0x8fc>;
			qcom,qc_temp_cool_fastchg_current_ma_low = <0x8fc>;
			qcom,qc_temp_little_cold_fastchg_current_ma_high = <0x92e>;
			qcom,qc_temp_little_cold_fastchg_current_ma_low = <0x578>;
			qcom,qc_temp_little_cool_fastchg_current_ma = <0xd16>;
			qcom,qc_temp_little_cool_fastchg_current_ma_high = <0xd16>;
			qcom,qc_temp_little_cool_fastchg_current_ma_low = <0x8fc>;
			qcom,qc_temp_normal_fastchg_current_ma = <0xd16>;
			qcom,qc_temp_warm_fastchg_current_ma = <0x578>;
			qcom,recharge-mv = <0x64>;
			qcom,removed_bat_decidegc = <0xbe>;
			qcom,short_c_bat_cv_mv = <0x10ea>;
			qcom,short_c_bat_fastchg_current_ma = <0x200>;
			qcom,short_c_bat_vfloat_mv = <0xed8>;
			qcom,short_c_bat_vfloat_sw_limit = <0xea6>;
			qcom,slave_chg_disable_ma = <0x2bc>;
			qcom,slave_chg_enable_ma = <0x3e8>;
			qcom,slave_pct = <0x1e>;
			qcom,support_ntc_01c_precision;
			qcom,sw_vfloat_over_protect_enable;
			qcom,temp_cold_fastchg_current_ma = <0x168>;
			qcom,temp_cold_vfloat_mv = <0xf8c>;
			qcom,temp_cool_fastchg_current_ma_high = <0x898>;
			qcom,temp_cool_fastchg_current_ma_low = <0x898>;
			qcom,temp_cool_vfloat_mv = <0x1153>;
			qcom,temp_little_cold_fastchg_current_ma = <0x578>;
			qcom,temp_little_cold_fastchg_current_ma_high = <0x898>;
			qcom,temp_little_cold_fastchg_current_ma_low = <0x578>;
			qcom,temp_little_cold_vfloat_mv = <0x1153>;
			qcom,temp_little_cool_fastchg_current_ma = <0x898>;
			qcom,temp_little_cool_fastchg_current_ma_low = <0x6a4>;
			qcom,temp_little_cool_vfloat_mv = <0x1153>;
			qcom,temp_normal_fastchg_current_ma = <0x898>;
			qcom,temp_normal_phase1_fastchg_current_ma = <0xd16>;
			qcom,temp_normal_phase1_vfloat_mv = <0x1153>;
			qcom,temp_normal_phase2_fastchg_current_ma_high = <0xd16>;
			qcom,temp_normal_phase2_fastchg_current_ma_low = <0xd16>;
			qcom,temp_normal_phase2_vfloat_mv = <0x1153>;
			qcom,temp_normal_phase3_fastchg_current_ma_high = <0xb22>;
			qcom,temp_normal_phase3_fastchg_current_ma_low = <0xb22>;
			qcom,temp_normal_phase3_vfloat_mv = <0x1153>;
			qcom,temp_normal_phase4_fastchg_current_ma_high = <0xa28>;
			qcom,temp_normal_phase4_fastchg_current_ma_low = <0xa28>;
			qcom,temp_normal_phase4_vfloat_mv = <0x1153>;
			qcom,temp_normal_phase5_fastchg_current_ma = <0x8fc>;
			qcom,temp_normal_phase5_vfloat_mv = <0x1153>;
			qcom,temp_normal_phase6_fastchg_current_ma = <0x578>;
			qcom,temp_normal_phase6_vfloat_mv = <0x1153>;
			qcom,temp_normal_vfloat_mv = <0x1153>;
			qcom,temp_warm_fastchg_current_ma = <0x578>;
			qcom,temp_warm_fastchg_current_ma_led_on = <0x1f4>;
			qcom,temp_warm_vfloat_mv = <0x1022>;
			qcom,ui_soc_decimal_speedmin = <0x14>;
			qcom,usb_high_than_bat_decidegc = <0xa8>;
			qcom,vbatt_full_thr = <0x1130>;
			qcom,vbatt_hv_thr = <0x11c6>;
			qcom,vbatt_num = <0x1>;
			qcom,vbatt_pdqc_to_5v_thr = <0x1004>;
			qcom,vbatt_pdqc_to_9v_thr = <0x1068>;
			qcom,vbatt_power_off = <0xce4>;
			qcom,vbatt_soc_1 = <0xd52>;
			qcom,vfloat_step_mv = <0x5>;
			qcom,vooc_project = <0x1>;
			qcom,voocphy_support;
			qcom,warm_bat_decidegc = <0x1c2>;
			qcom,warm_vfloat_over_sw_limit = <0x102c>;
			qcom,warm_vfloat_sw_limit = <0xff0>;
			sw_full_count = <0x19>;
		};
	};

	fragment@32 {
		target = <0xffffffff>;

		__overlay__ {

			c8547-charger@6F {
				compatible = "sc,sc8547-standalone";
				interrupt-parent = <0xffffffff>;
				interrupts = <0x7 0x0>;
				pinctrl-0 = <0x2e>;
				pinctrl-1 = <0x2f>;
				pinctrl-2 = <0x30>;
				pinctrl-3 = <0x31>;
				pinctrl-names = "switch1_act_switch2_act", "switch1_sleep_switch2_sleep", "charging_inter_active", "charging_inter_sleep";
				qcom,charging_switch1-gpio = <0xffffffff 0x25 0x0>;
				qcom,switch_voocphy_irq_gpio = <0xffffffff 0x7 0x0>;
				reg = <0x6f 0x0>;
				sc,sc8547,ac-ovp-threshold = <0x32c8>;
				sc,sc8547,bat-ocp-threshold = <0x1b58>;
				sc,sc8547,bat-ovp-disale = <0x1>;
				sc,sc8547,bat-ovp-threshold = <0x11ad>;
				sc,sc8547,bus-ocp-disale = <0x1>;
				sc,sc8547,bus-ocp-threshold = <0xdac>;
				sc,sc8547,bus-ovp-disale = <0x1>;
				sc,sc8547,bus-ovp-threshold = <0x2af8>;
				sc,sc8547,bus-ucp-disale = <0x1>;
				sc,sc8547,sense-resistor-mohm = <0x5>;
				sc,sc8547,vdrop-ovp-disale = <0x1>;
				status = "okay";
			};
		};
	};

	fragment@33 {
		target = <0xffffffff>;

		__overlay__ {

			batid_disable {
				phandle = <0x1e>;

				pins_cmd_dat {
					bias-pull-up = <0x0>;
					output-low;
					pinmux = <0x3300>;
					slew-rate = <0x1>;
				};
			};

			batid_enable {
				phandle = <0x1f>;

				pins_cmd_dat {
					bias-pull-down = <0x0>;
					output-high;
					pinmux = <0x3300>;
					slew-rate = <0x1>;
				};
			};

			charger_gpio_as_output_high {
				phandle = <0x27>;

				pins_cmd_dat {
					output-high;
					pinmux = <0x2400>;
					slew-rate = <0x1>;
				};
			};

			charger_gpio_as_output_low {
				phandle = <0x26>;

				pins_cmd_dat {
					output-low;
					pinmux = <0x2400>;
					slew-rate = <0x1>;
				};
			};

			chgvin_disable {
				phandle = <0x2b>;

				pins_cmd_dat {
					bias-pull-down = <0x0>;
					output-high;
					pinmux = <0x300>;
					slew-rate = <0x1>;
				};
			};

			chgvin_enable {
				phandle = <0x2a>;

				pins_cmd_dat {
					bias-pull-up = <0x0>;
					output-low;
					pinmux = <0x300>;
					slew-rate = <0x1>;
				};
			};

			dischg_disable {
				phandle = <0x29>;

				pins_cmd_dat {
					bias-pull-down = <0x0>;
					output-low;
					pinmux = <0xf00>;
					slew-rate = <0x1>;
				};
			};

			dischg_enable {
				phandle = <0x28>;

				pins_cmd_dat {
					bias-pull-up = <0x0>;
					output-high;
					pinmux = <0xf00>;
					slew-rate = <0x1>;
				};
			};

			eint0default {
				phandle = <0x25>;
			};

			linkbustem_disable {
				phandle = <0x22>;

				pins_cmd_dat {
					bias-pull-up = <0x0>;
					output-low;
					pinmux = <0x3100>;
					slew-rate = <0x1>;
				};
			};

			linkbustem_enable {
				phandle = <0x23>;

				pins_cmd_dat {
					bias-pull-down = <0x0>;
					output-high;
					pinmux = <0x3100>;
					slew-rate = <0x1>;
				};
			};

			linktem_disable {
				phandle = <0x20>;

				pins_cmd_dat {
					bias-pull-up = <0x0>;
					output-low;
					pinmux = <0x2900>;
					slew-rate = <0x1>;
				};
			};

			linktem_enable {
				phandle = <0x21>;

				pins_cmd_dat {
					bias-pull-down = <0x0>;
					output-high;
					pinmux = <0x2900>;
					slew-rate = <0x1>;
				};
			};

			slave_charger_disable {
				phandle = <0x16>;

				pins_cmd_dat {
					bias-pull-up = <0x0>;
					output-low;
					pinmux = <0x600>;
					slew-rate = <0x1>;
				};
			};

			slave_charger_enable {
				phandle = <0x15>;

				pins_cmd_dat {
					bias-pull-down = <0x0>;
					output-high;
					pinmux = <0x600>;
					slew-rate = <0x1>;
				};
			};

			uart0_rx_gpio@gpio32 {
				phandle = <0x2c>;

				pins_cmd_dat {
					output-low;
					pinmux = <0x2000>;
					slew-rate = <0x1>;
				};
			};

			uart0_tx_gpio@gpio33 {
				phandle = <0x2d>;

				pins_cmd_dat {
					output-low;
					pinmux = <0x2100>;
					slew-rate = <0x1>;
				};
			};
		};
	};

	fragment@34 {
		target = <0xffffffff>;

		__overlay__ {

			charging_data_active {
				phandle = <0x6e>;

				pins_cmd_dat {
					bias-pull-up = <0x0>;
					pinmux = <0xe00>;
					slew-rate = <0x0>;
				};
			};

			charging_data_sleep {
				phandle = <0x6f>;

				pins_cmd_dat {
					bias-pull-down = <0x0>;
					pinmux = <0xe00>;
					slew-rate = <0x0>;
				};
			};

			charging_inter_active {
				phandle = <0x30>;

				pins_cmd_dat {
					bias-pull-up = <0x0>;
					pinmux = <0x700>;
					slew-rate = <0x0>;
				};
			};

			charging_inter_sleep {
				phandle = <0x31>;

				pins_cmd_dat {
					bias-pull-up = <0x0>;
					pinmux = <0x700>;
					slew-rate = <0x0>;
				};
			};

			charging_reset_active {
				phandle = <0x70>;

				pins_cmd_dat {
					output-high;
					pinmux = <0x1500>;
					slew-rate = <0x1>;
				};
			};

			charging_reset_sleep {
				phandle = <0x71>;

				pins_cmd_dat {
					output-low;
					pinmux = <0x1500>;
					slew-rate = <0x1>;
				};
			};

			charging_switch1_active {
				phandle = <0x2e>;

				pins_cmd_dat {
					output-high;
					pinmux = <0x2500>;
					slew-rate = <0x1>;
				};
			};

			charging_switch1_ctr1_active {
				phandle = <0x6c>;

				pins_cmd_dat {
					output-high;
					pinmux = <0x9400>;
					slew-rate = <0x1>;
				};
			};

			charging_switch1_ctr1_sleep {
				phandle = <0x6d>;

				pins_cmd_dat {
					output-low;
					pinmux = <0x9400>;
					slew-rate = <0x1>;
				};
			};

			charging_switch1_sleep {
				phandle = <0x2f>;

				pins_cmd_dat {
					output-low;
					pinmux = <0x2500>;
					slew-rate = <0x1>;
				};
			};

			vooc_asic_id_active {
				phandle = <0x72>;

				pins_cmd_dat {
					bias-pull-up;
					input-enable;
					pinmux = <0x4900>;
					slew-rate = <0x0>;
				};
			};

			vooc_asic_id_sleep {
				phandle = <0x73>;

				pins_cmd_dat {
					bias-pull-down;
					input-enable;
					pinmux = <0x4900>;
					slew-rate = <0x0>;
				};
			};
		};
	};

	fragment@35 {
		target = <0xffffffff>;

		__overlay__ {
			#address-cells = <0x1>;
			#size-cells = <0x0>;
			clock-frequency = <0x61a80>;

			i2c_camera_ldo@29 {
				compatible = "mediatek,i2c_camera_ldo";
				reg = <0x29>;
				status = "okay";
			};
		};
	};

	fragment@36 {
		target = <0xffffffff>;

		__overlay__ {

			camdefault {
				phandle = <0x32>;
			};

			camera0_mclk_2ma@gpio141 {
				phandle = <0x36>;

				pins_cmd_dat {
					drive-strength = <0x0>;
					pinmux = <0x8d01>;
				};
			};

			camera0_mclk_4ma@gpio141 {
				phandle = <0x37>;

				pins_cmd_dat {
					drive-strength = <0x1>;
					pinmux = <0x8d01>;
				};
			};

			camera0_mclk_6ma@gpio141 {
				phandle = <0x38>;

				pins_cmd_dat {
					drive-strength = <0x2>;
					pinmux = <0x8d01>;
				};
			};

			camera0_mclk_8ma@gpio141 {
				phandle = <0x39>;

				pins_cmd_dat {
					drive-strength = <0x3>;
					pinmux = <0x8d01>;
				};
			};

			camera0_mclk_gpio_mode@gpio141 {
				phandle = <0x35>;

				pins_cmd_dat {
					drive-strength = <0x1>;
					pinmux = <0x8d00>;
				};
			};

			camera0_rst_output_high@gpio20 {
				phandle = <0x34>;

				pins_cmd_dat {
					output-high;
					pinmux = <0x1400>;
				};
			};

			camera0_rst_output_low@gpio20 {
				phandle = <0x33>;

				pins_cmd_dat {
					output-low;
					pinmux = <0x1400>;
				};
			};

			camera1_mclk_2ma@gpio140 {
				phandle = <0x3c>;

				pins_cmd_dat {
					drive-strength = <0x0>;
					pinmux = <0x8c01>;
				};
			};

			camera1_mclk_4ma@gpio140 {
				phandle = <0x3d>;

				pins_cmd_dat {
					drive-strength = <0x1>;
					pinmux = <0x8c01>;
				};
			};

			camera1_mclk_6ma@gpio140 {
				phandle = <0x3e>;

				pins_cmd_dat {
					drive-strength = <0x2>;
					pinmux = <0x8c01>;
				};
			};

			camera1_mclk_8ma@gpio140 {
				phandle = <0x3f>;

				pins_cmd_dat {
					drive-strength = <0x3>;
					pinmux = <0x8c01>;
				};
			};

			camera1_mclk_gpio_mode@gpio140 {
				phandle = <0x40>;

				pins_cmd_dat {
					drive-strength = <0x1>;
					pinmux = <0x8c00>;
				};
			};

			camera1_rst_output_high@gpio18 {
				phandle = <0x3b>;

				pins_cmd_dat {
					output-high;
					pinmux = <0x1200>;
				};
			};

			camera1_rst_output_low@gpio18 {
				phandle = <0x3a>;

				pins_cmd_dat {
					output-low;
					pinmux = <0x1200>;
				};
			};

			camera2_mclk_2ma@gpio142 {
				phandle = <0x42>;

				pins_cmd_dat {
					drive-strength = <0x0>;
					pinmux = <0x8e01>;
				};
			};

			camera2_mclk_4ma@gpio142 {
				phandle = <0x43>;

				pins_cmd_dat {
					drive-strength = <0x1>;
					pinmux = <0x8e01>;
				};
			};

			camera2_mclk_6ma@gpio142 {
				phandle = <0x44>;

				pins_cmd_dat {
					drive-strength = <0x2>;
					pinmux = <0x8e01>;
				};
			};

			camera2_mclk_8ma@gpio142 {
				phandle = <0x45>;

				pins_cmd_dat {
					drive-strength = <0x3>;
					pinmux = <0x8e01>;
				};
			};

			camera2_mclk_gpio_mode@gpio142 {
				phandle = <0x41>;

				pins_cmd_dat {
					drive-strength = <0x1>;
					pinmux = <0x8e00>;
				};
			};

			camera2_rst_output_high@gpio22 {
				phandle = <0x47>;

				pins_cmd_dat {
					output-high;
					pinmux = <0x1600>;
				};
			};

			camera2_rst_output_low@gpio22 {
				phandle = <0x46>;

				pins_cmd_dat {
					output-low;
					pinmux = <0x1600>;
				};
			};

			camera3_mclk_2ma@gpio60 {
				phandle = <0x4b>;

				pins_cmd_dat {
					drive-strength = <0x0>;
					pinmux = <0x3c03>;
				};
			};

			camera3_mclk_4ma@gpio60 {
				phandle = <0x4c>;

				pins_cmd_dat {
					drive-strength = <0x1>;
					pinmux = <0x3c03>;
				};
			};

			camera3_mclk_6ma@gpio60 {
				phandle = <0x4d>;

				pins_cmd_dat {
					drive-strength = <0x2>;
					pinmux = <0x3c03>;
				};
			};

			camera3_mclk_8ma@gpio60 {
				phandle = <0x4e>;

				pins_cmd_dat {
					drive-strength = <0x3>;
					pinmux = <0x3c03>;
				};
			};

			camera3_mclk_gpio_mode@gpio60 {
				phandle = <0x4a>;

				pins_cmd_dat {
					drive-strength = <0x1>;
					pinmux = <0x3c00>;
				};
			};

			camera3_rst_output_high@gpio26 {
				phandle = <0x49>;

				pins_cmd_dat {
					output-high;
					pinmux = <0x1a00>;
				};
			};

			camera3_rst_output_low@gpio26 {
				phandle = <0x48>;

				pins_cmd_dat {
					output-low;
					pinmux = <0x1a00>;
				};
			};
		};
	};

	fragment@37 {
		target = <0xffffffff>;

		__overlay__ {
			cam0_enable_sensor = "s5kjn1_mipi_raw ov64b40_mipi_raw";
			cam1_enable_sensor = "hi1634q_mipi_raw";
			cam2_enable_sensor = "gc02m1hlt_mipi_raw";
			cam3_enable_sensor = "ov02b1b_mipi_mono";
			pinctrl-0 = <0x32>;
			pinctrl-1 = <0x33>;
			pinctrl-10 = <0x3c>;
			pinctrl-11 = <0x3d>;
			pinctrl-12 = <0x3e>;
			pinctrl-13 = <0x3f>;
			pinctrl-14 = <0x40>;
			pinctrl-15 = <0x41>;
			pinctrl-16 = <0x42>;
			pinctrl-17 = <0x43>;
			pinctrl-18 = <0x44>;
			pinctrl-19 = <0x45>;
			pinctrl-2 = <0x34>;
			pinctrl-20 = <0x46>;
			pinctrl-21 = <0x47>;
			pinctrl-22 = <0x48>;
			pinctrl-23 = <0x49>;
			pinctrl-24 = <0x4a>;
			pinctrl-25 = <0x4b>;
			pinctrl-26 = <0x4c>;
			pinctrl-27 = <0x4d>;
			pinctrl-28 = <0x4e>;
			pinctrl-3 = <0x35>;
			pinctrl-4 = <0x36>;
			pinctrl-5 = <0x37>;
			pinctrl-6 = <0x38>;
			pinctrl-7 = <0x39>;
			pinctrl-8 = <0x3a>;
			pinctrl-9 = <0x3b>;
			pinctrl-names = "default", "cam0_rst0", "cam0_rst1", "cam0_mclk_off", "cam0_mclk_2mA", "cam0_mclk_4mA", "cam0_mclk_6mA", "cam0_mclk_8mA", "cam1_rst0", "cam1_rst1", "cam1_mclk_2mA", "cam1_mclk_4mA", "cam1_mclk_6mA", "cam1_mclk_8mA", "cam1_mclk_off", "cam2_mclk_off", "cam2_mclk_2mA", "cam2_mclk_4mA", "cam2_mclk_6mA", "cam2_mclk_8mA", "cam2_rst0", "cam2_rst1", "cam3_rst0", "cam3_rst1", "cam3_mclk_off", "cam3_mclk_2mA", "cam3_mclk_4mA", "cam3_mclk_6mA", "cam3_mclk_8mA";
			status = "okay";
		};
	};

	fragment@38 {
		target = <0xffffffff>;

		__overlay__ {

			camera_eeprom1@55 {
				compatible = "mediatek,camera_eeprom";
				phandle = <0x75>;
				reg = <0x55>;
				status = "okay";
			};

			camera_eeprom2@51 {
				compatible = "mediatek,camera_eeprom";
				phandle = <0x74>;
				reg = <0x51>;
				status = "okay";
			};
		};
	};

	fragment@39 {
		target = <0xffffffff>;

		__overlay__ {

			camera_eeprom0@50 {
				compatible = "mediatek,camera_eeprom";
				phandle = <0x76>;
				reg = <0x50>;
				status = "okay";
			};
		};
	};

	fragment@4 {
		target = <0xffffffff>;

		__overlay__ {
			support_tuv_authentication;
		};
	};

	fragment@40 {
		target = <0xffffffff>;

		__overlay__ {
			status = "ok";

			ilitek@0 {
				compatible = "mediatek,cap_touch";
				reg = <0x0>;
				spi-max-frequency = <0x989680>;
				status = "ok";
			};

			novatek@0 {
				compatible = "novatek,NVT-ts-spi";
				novatek,irq-gpio = <0xffffffff 0xc 0x0>;
				novatek,reset-gpio = <0xffffffff 0x79 0x0>;
				novatek,spi-rd-fast-addr = <0x3f310>;
				novatek,swrst-n8-addr = <0x3f0fe>;
				reg = <0x1>;
				spi-max-frequency = <0x927c00>;
				status = "ok";

				novatek-mp-criteria-nvtpid@0 {
					#address-cells = <0x1>;
					#size-cells = <0x0>;
					AIN_KEY = <0x0 0x1 0x2 0xff>;
					AIN_X = <0x0 0x1 0x2 0x3 0x4 0x5 0x6 0x7 0x8 0x9 0xa 0xb 0xc 0xd 0xe 0xf 0x10 0x11>;
					AIN_Y = <0x0 0x1 0x2 0x3 0x4 0x5 0x6 0x7 0x8 0x9 0xa 0xb 0xc 0xd 0xe 0xf 0x10 0x11 0x12 0x13 0x14 0x15 0x16 0x17 0x18 0x19 0x1a 0x1b 0x1c 0x1d 0x1e 0x1f 0x20 0x21 0x22 0x23>;
					IC_KEY_CFG_SIZE = <0x4>;
					IC_X_CFG_SIZE = <0x12>;
					IC_Y_CFG_SIZE = <0x24>;
					PS_Config_Diff_Test_Frame = <0x32>;
					PS_Config_Lmt_FW_CC_N = <0x0 0x0 0x0 0x0 0x0 0x0 0x0 0x0 0x0 0x0 0x0 0x0 0x0 0x0 0x0 0x0 0x0 0x0 0x0 0x0 0x0 0x0 0x0 0x0 0x0 0x0 0x0 0x0 0x0 0x0 0x0 0x0 0x0 0x0 0x0 0x0 0x0 0x0 0x0 0x0 0x0 0x0 0x0 0x0 0x0 0x0 0x0 0x0 0x0 0x0 0x0 0x0 0x0 0x0 0x0 0x0 0x0 0x0 0x0 0x0 0x0 0x0 0x0 0x0 0x0 0x0 0x0 0x0 0x0 0x0 0x0 0x0 0x0 0x0 0x0 0x0 0x0 0x0 0x0 0x0 0x0 0x0 0x0 0x0 0x0 0x0 0x0 0x0 0x0 0x0 0x0 0x0 0x0 0x0 0x0 0x0 0x0 0x0 0x0 0x0 0x0 0x0 0x0 0x0 0x0 0x0 0x0 0x0 0x0 0x0 0x0 0x0 0x0 0x0 0x0 0x0 0x0 0x0 0x0 0x0 0x0 0x0 0x0 0x0 0x0 0x0 0x0 0x0 0x0 0x0 0x0 0x0 0x0 0x0 0x0 0x0 0x0 0x0 0x0 0x0 0x0 0x0 0x0 0x0 0x0 0x0 0x0 0x0 0x0 0x0 0x0 0x0 0x0 0x0 0x0 0x0 0x0 0x0 0x0 0x0 0x0 0x0 0x0 0x0 0x0 0x0 0x0 0x0 0x0 0x0 0x0 0x0 0x0 0x0 0x0 0x0 0x0 0x0 0x0 0x0 0x0 0x0 0x0 0x0 0x0 0x0 0x0 0x0 0x0 0x0 0x0 0x0 0x0 0x0 0x0 0x0 0x0 0x0 0x0 0x0 0x0 0x0 0x0 0x0 0x0 0x0 0x0 0x0 0x0 0x0 0x0 0x0 0x0 0x0 0x0 0x0 0x0 0x0 0x0 0x0 0x0 0x0 0x0 0x0 0x0 0x0 0x0 0x0 0x0 0x0 0x0 0x0 0x0 0x0 0x0 0x0 0x0 0x0 0x0 0x0 0x0 0x0 0x0 0x0 0x0 0x0 0x0 0x0 0x0 0x0 0x0 0x0 0x0 0x0 0x0 0x0 0x0 0x0 0x0 0x0 0x0 0x0 0x0 0x0 0x0 0x0 0x0 0x0 0x0 0x0 0x0 0x0 0x0 0x0 0x0 0x0 0x0 0x0 0x0 0x0 0x0 0x0 0x0 0x0 0x0 0x0 0x0 0x0 0x0 0x0 0x0 0x0 0x0 0x0 0x0 0x0 0x0 0x0 0x0 0x0 0x0 0x0 0x0 0x0 0x0 0x0 0x0 0x0 0x0 0x0 0x0 0x0 0x0 0x0 0x0 0x0 0x0 0x0 0x0 0x0 0x0 0x0 0x0 0x0 0x0 0x0 0x0 0x0 0x0 0x0 0x0 0x0 0x0 0x0 0x0 0x0 0x0 0x0 0x0 0x0 0x0 0x0 0x0 0x0 0x0 0x0 0x0 0x0 0x0 0x0 0x0 0x0 0x0 0x0 0x0 0x0 0x0 0x0 0x0 0x0 0x0 0x0 0x0 0x0 0x0 0x0 0x0 0x0 0x0 0x0 0x0 0x0 0x0 0x0 0x0 0x0 0x0 0x0 0x0 0x0 0x0 0x0 0x0 0x0 0x0 0x0 0x0 0x0 0x0 0x0 0x0 0x0 0x0 0x0 0x0 0x0 0x0 0x0 0x0 0x0 0x0 0x0 0x0 0x0 0x0 0x0 0x0 0x0 0x0 0x0 0x0 0x0 0x0 0x0 0x0 0x0 0x0 0x0 0x0 0x0 0x0 0x0 0x0 0x0 0x0 0x0 0x0 0x0 0x0 0x0 0x0 0x0 0x0 0x0 0x0 0x0 0x0 0x0 0x0 0x0 0x0 0x0 0x0 0x0 0x0 0x0 0x0 0x0 0x0 0x0 0x0 0x0 0x0 0x0 0x0 0x0 0x0 0x0 0x0 0x0 0x0 0x0 0x0 0x0 0x0 0x0 0x0 0x0 0x0 0x0 0x0 0x0 0x0 0x0 0x0 0x0 0x0 0x0 0x0 0x0 0x0 0x0 0x0 0x0 0x0 0x0 0x0 0x0 0x0 0x0 0x0 0x0 0x0 0x0 0x0 0x0 0x0 0x0 0x0 0x0 0x0 0x0 0x0 0x0 0x0 0x0 0x0 0x0 0x0 0x0 0x0 0x0 0x0 0x0 0x0 0x0 0x0 0x0 0x0 0x0 0x0 0x0 0x0 0x0 0x0 0x0 0x0 0x0 0x0 0x0 0x0 0x0 0x0 0x0 0x0 0x0 0x0 0x0 0x0 0x0 0x0 0x0 0x0 0x0 0x0 0x0 0x0 0x0 0x0 0x0 0x0 0x0 0x0 0x0 0x0 0x0 0x0 0x0 0x0 0x0 0x0 0x0 0x0 0x0 0x0 0x0 0x0 0x0 0x0 0x0 0x0 0x0 0x0 0x0 0x0 0x0 0x0 0x0 0x0 0x0 0x0 0x0 0x0 0x0 0x0 0x0 0x0 0x0 0x0 0x0 0x0 0x0 0x0 0x0 0x0 0x0 0x0 0x0 0x0 0x0 0x0 0x0 0x0 0x0 0x0 0x0 0x0 0x0 0x0 0x0 0x0 0x0 0x0 0x0 0x0 0x0 0x0 0x0 0x0 0x0 0x0 0x0 0x0 0x0 0x0 0x0 0x0 0x0 0x0 0x0 0x0 0x0 0x0 0x0 0x0 0x0 0x0 0x0 0x0 0x0 0x0 0x0 0x0 0x0 0x0 0x0 0x0 0x0 0x0 0x0 0x0>;
					PS_Config_Lmt_FW_CC_P = <0x13a 0x13a 0x13a 0x13a 0x13a 0x13a 0x13a 0x13a 0x13a 0x13a 0x13a 0x13a 0x13a 0x13a 0x13a 0x13a 0x13a 0x13a 0x13a 0x13a 0x13a 0x13a 0x13a 0x13a 0x13a 0x13a 0x13a 0x13a 0x13a 0x13a 0x13a 0x13a 0x13a 0x13a 0x13a 0x13a 0x13a 0x13a 0x13a 0x13a 0x13a 0x13a 0x13a 0x13a 0x13a 0x13a 0x13a 0x13a 0x13a 0x13a 0x13a 0x13a 0x13a 0x13a 0x13a 0x13a 0x13a 0x13a 0x13a 0x13a 0x13a 0x13a 0x13a 0x13a 0x13a 0x13a 0x13a 0x13a 0x13a 0x13a 0x13a 0x13a 0x13a 0x13a 0x13a 0x13a 0x13a 0x13a 0x13a 0x13a 0x13a 0x13a 0x13a 0x13a 0x13a 0x13a 0x13a 0x13a 0x13a 0x13a 0x13a 0x13a 0x13a 0x13a 0x13a 0x13a 0x13a 0x13a 0x13a 0x13a 0x13a 0x13a 0x13a 0x13a 0x13a 0x13a 0x13a 0x13a 0x13a 0x13a 0x13a 0x13a 0x13a 0x13a 0x13a 0x13a 0x13a 0x13a 0x13a 0x13a 0x13a 0x13a 0x13a 0x13a 0x13a 0x13a 0x13a 0x13a 0x13a 0x13a 0x13a 0x13a 0x13a 0x13a 0x13a 0x13a 0x13a 0x13a 0x13a 0x13a 0x13a 0x13a 0x13a 0x13a 0x13a 0x13a 0x13a 0x13a 0x13a 0x13a 0x13a 0x13a 0x13a 0x13a 0x13a 0x13a 0x13a 0x13a 0x13a 0x13a 0x13a 0x13a 0x13a 0x13a 0x13a 0x13a 0x13a 0x13a 0x13a 0x13a 0x13a 0x13a 0x13a 0x13a 0x13a 0x13a 0x13a 0x13a 0x13a 0x13a 0x13a 0x13a 0x13a 0x13a 0x13a 0x13a 0x13a 0x13a 0x13a 0x13a 0x13a 0x13a 0x13a 0x13a 0x13a 0x13a 0x13a 0x13a 0x13a 0x13a 0x13a 0x13a 0x13a 0x13a 0x13a 0x13a 0x13a 0x13a 0x13a 0x13a 0x13a 0x13a 0x13a 0x13a 0x13a 0x13a 0x13a 0x13a 0x13a 0x13a 0x13a 0x13a 0x13a 0x13a 0x13a 0x13a 0x13a 0x13a 0x13a 0x13a 0x13a 0x13a 0x13a 0x13a 0x13a 0x13a 0x13a 0x13a 0x13a 0x13a 0x13a 0x13a 0x13a 0x13a 0x13a 0x13a 0x13a 0x13a 0x13a 0x13a 0x13a 0x13a 0x13a 0x13a 0x13a 0x13a 0x13a 0x13a 0x13a 0x13a 0x13a 0x13a 0x13a 0x13a 0x13a 0x13a 0x13a 0x13a 0x13a 0x13a 0x13a 0x13a 0x13a 0x13a 0x13a 0x13a 0x13a 0x13a 0x13a 0x13a 0x13a 0x13a 0x13a 0x13a 0x13a 0x13a 0x13a 0x13a 0x13a 0x13a 0x13a 0x13a 0x13a 0x13a 0x13a 0x13a 0x13a 0x13a 0x13a 0x13a 0x13a 0x13a 0x13a 0x13a 0x13a 0x13a 0x13a 0x13a 0x13a 0x13a 0x13a 0x13a 0x13a 0x13a 0x13a 0x13a 0x13a 0x13a 0x13a 0x13a 0x13a 0x13a 0x13a 0x13a 0x13a 0x13a 0x13a 0x13a 0x13a 0x13a 0x13a 0x13a 0x13a 0x13a 0x13a 0x13a 0x13a 0x13a 0x13a 0x13a 0x13a 0x13a 0x13a 0x13a 0x13a 0x13a 0x13a 0x13a 0x13a 0x13a 0x13a 0x13a 0x13a 0x13a 0x13a 0x13a 0x13a 0x13a 0x13a 0x13a 0x13a 0x13a 0x13a 0x13a 0x13a 0x13a 0x13a 0x13a 0x13a 0x13a 0x13a 0x13a 0x13a 0x13a 0x13a 0x13a 0x13a 0x13a 0x13a 0x13a 0x13a 0x13a 0x13a 0x13a 0x13a 0x13a 0x13a 0x13a 0x13a 0x13a 0x13a 0x13a 0x13a 0x13a 0x13a 0x13a 0x13a 0x13a 0x13a 0x13a 0x13a 0x13a 0x13a 0x13a 0x13a 0x13a 0x13a 0x13a 0x13a 0x13a 0x13a 0x13a 0x13a 0x13a 0x13a 0x13a 0x13a 0x13a 0x13a 0x13a 0x13a 0x13a 0x13a 0x13a 0x13a 0x13a 0x13a 0x13a 0x13a 0x13a 0x13a 0x13a 0x13a 0x13a 0x13a 0x13a 0x13a 0x13a 0x13a 0x13a 0x13a 0x13a 0x13a 0x13a 0x13a 0x13a 0x13a 0x13a 0x13a 0x13a 0x13a 0x13a 0x13a 0x13a 0x13a 0x13a 0x13a 0x13a 0x13a 0x13a 0x13a 0x13a 0x13a 0x13a 0x13a 0x13a 0x13a 0x13a 0x13a 0x13a 0x13a 0x13a 0x13a 0x13a 0x13a 0x13a 0x13a 0x13a 0x13a 0x13a 0x13a 0x13a 0x13a 0x13a 0x13a 0x13a 0x13a 0x13a 0x13a 0x13a 0x13a 0x13a 0x13a 0x13a 0x13a 0x13a 0x13a 0x13a 0x13a 0x13a 0x13a 0x13a 0x13a 0x13a 0x13a 0x13a 0x13a 0x13a 0x13a 0x13a 0x13a 0x13a 0x13a 0x13a 0x13a 0x13a 0x13a 0x13a 0x13a 0x13a 0x13a 0x13a 0x13a 0x13a 0x13a 0x13a 0x13a 0x13a 0x13a 0x13a 0x13a 0x13a 0x13a 0x13a 0x13a 0x13a 0x13a 0x13a 0x13a 0x13a 0x13a 0x13a 0x13a 0x13a 0x13a 0x13a 0x13a 0x13a 0x13a 0x13a 0x13a 0x13a 0x13a 0x13a 0x13a 0x13a 0x13a 0x13a 0x13a 0x13a 0x13a 0x13a 0x13a 0x13a 0x13a 0x13a 0x13a 0x13a 0x13a 0x13a 0x13a 0x13a 0x13a 0x13a 0x13a 0x13a 0x13a 0x13a 0x13a 0x13a 0x13a 0x13a 0x13a 0x13a 0x13a 0x13a 0x13a 0x13a 0x13a 0x13a 0x13a 0x13a 0x13a 0x13a 0x13a 0x13a 0x13a 0x13a 0x13a 0x13a 0x13a 0x13a 0x13a 0x13a 0x13a 0x13a 0x13a 0x13a 0x13a 0x13a 0x13a 0x13a 0x13a 0x13a 0x13a 0x13a 0x13a 0x13a 0x13a 0x13a 0x13a 0x13a 0x13a 0x13a 0x13a 0x13a 0x13a 0x13a 0x13a 0x13a 0x13a 0x13a 0x13a 0x13a 0x13a 0x13a 0x13a 0x13a 0x13a 0x13a 0x13a 0x13a 0x13a 0x13a 0x13a 0x13a 0x13a 0x13a 0x13a 0x13a 0x13a>;
					PS_Config_Lmt_FW_Diff_N = <0xffffffb5 0xffffffb5 0xffffffb5 0xffffffb5 0xffffffb5 0xffffffb5 0xffffffb5 0xffffffb5 0xffffffb5 0xffffffb5 0xffffffb5 0xffffffb5 0xffffffb5 0xffffffb5 0xffffffb5 0xffffffb5 0xffffffb5 0xffffffb5 0xffffffb5 0xffffffb5 0xffffffb5 0xffffffb5 0xffffffb5 0xffffffb5 0xffffffb5 0xffffffb5 0xffffffb5 0xffffffb5 0xffffffb5 0xffffffb5 0xffffffb5 0xffffffb5 0xffffffb5 0xffffffb5 0xffffffb5 0xffffffb5 0xffffffb5 0xffffffb5 0xffffffb5 0xffffffb5 0xffffffb5 0xffffffb5 0xffffffb5 0xffffffb5 0xffffffb5 0xffffffb5 0xffffffb5 0xffffffb5 0xffffffb5 0xffffffb5 0xffffffb5 0xffffffb5 0xffffffb5 0xffffffb5 0xffffffb5 0xffffffb5 0xffffffb5 0xffffffb5 0xffffffb5 0xffffffb5 0xffffffb5 0xffffffb5 0xffffffb5 0xffffffb5 0xffffffb5 0xffffffb5 0xffffffb5 0xffffffb5 0xffffffb5 0xffffffb5 0xffffffb5 0xffffffb5 0xffffffb5 0xffffffb5 0xffffffb5 0xffffffb5 0xffffffb5 0xffffffb5 0xffffffb5 0xffffffb5 0xffffffb5 0xffffffb5 0xffffffb5 0xffffffb5 0xffffffb5 0xffffffb5 0xffffffb5 0xffffffb5 0xffffffb5 0xffffffb5 0xffffffb5 0xffffffb5 0xffffffb5 0xffffffb5 0xffffffb5 0xffffffb5 0xffffffb5 0xffffffb5 0xffffffb5 0xffffffb5 0xffffffb5 0xffffffb5 0xffffffb5 0xffffffb5 0xffffffb5 0xffffffb5 0xffffffb5 0xffffffb5 0xffffffb5 0xffffffb5 0xffffffb5 0xffffffb5 0xffffffb5 0xffffffb5 0xffffffb5 0xffffffb5 0xffffffb5 0xffffffb5 0xffffffb5 0xffffffb5 0xffffffb5 0xffffffb5 0xffffffb5 0xffffffb5 0xffffffb5 0xffffffb5 0xffffffb5 0xffffffb5 0xffffffb5 0xffffffb5 0xffffffb5 0xffffffb5 0xffffffb5 0xffffffb5 0xffffffb5 0xffffffb5 0xffffffb5 0xffffffb5 0xffffffb5 0xffffffb5 0xffffffb5 0xffffffb5 0xffffffb5 0xffffffb5 0xffffffb5 0xffffffb5 0xffffffb5 0xffffffb5 0xffffffb5 0xffffffb5 0xffffffb5 0xffffffb5 0xffffffb5 0xffffffb5 0xffffffb5 0xffffffb5 0xffffffb5 0xffffffb5 0xffffffb5 0xffffffb5 0xffffffb5 0xffffffb5 0xffffffb5 0xffffffb5 0xffffffb5 0xffffffb5 0xffffffb5 0xffffffb5 0xffffffb5 0xffffffb5 0xffffffb5 0xffffffb5 0xffffffb5 0xffffffb5 0xffffffb5 0xffffffb5 0xffffffb5 0xffffffb5 0xffffffb5 0xffffffb5 0xffffffb5 0xffffffb5 0xffffffb5 0xffffffb5 0xffffffb5 0xffffffb5 0xffffffb5 0xffffffb5 0xffffffb5 0xffffffb5 0xffffffb5 0xffffffb5 0xffffffb5 0xffffffb5 0xffffffb5 0xffffffb5 0xffffffb5 0xffffffb5 0xffffffb5 0xffffffb5 0xffffffb5 0xffffffb5 0xffffffb5 0xffffffb5 0xffffffb5 0xffffffb5 0xffffffb5 0xffffffb5 0xffffffb5 0xffffffb5 0xffffffb5 0xffffffb5 0xffffffb5 0xffffffb5 0xffffffb5 0xffffffb5 0xffffffb5 0xffffffb5 0xffffffb5 0xffffffb5 0xffffffb5 0xffffffb5 0xffffffb5 0xffffffb5 0xffffffb5 0xffffffb5 0xffffffb5 0xffffffb5 0xffffffb5 0xffffffb5 0xffffffb5 0xffffffb5 0xffffffb5 0xffffffb5 0xffffffb5 0xffffffb5 0xffffffb5 0xffffffb5 0xffffffb5 0xffffffb5 0xffffffb5 0xffffffb5 0xffffffb5 0xffffffb5 0xffffffb5 0xffffffb5 0xffffffb5 0xffffffb5 0xffffffb5 0xffffffb5 0xffffffb5 0xffffffb5 0xffffffb5 0xffffffb5 0xffffffb5 0xffffffb5 0xffffffb5 0xffffffb5 0xffffffb5 0xffffffb5 0xffffffb5 0xffffffb5 0xffffffb5 0xffffffb5 0xffffffb5 0xffffffb5 0xffffffb5 0xffffffb5 0xffffffb5 0xffffffb5 0xffffffb5 0xffffffb5 0xffffffb5 0xffffffb5 0xffffffb5 0xffffffb5 0xffffffb5 0xffffffb5 0xffffffb5 0xffffffb5 0xffffffb5 0xffffffb5 0xffffffb5 0xffffffb5 0xffffffb5 0xffffffb5 0xffffffb5 0xffffffb5 0xffffffb5 0xffffffb5 0xffffffb5 0xffffffb5 0xffffffb5 0xffffffb5 0xffffffb5 0xffffffb5 0xffffffb5 0xffffffb5 0xffffffb5 0xffffffb5 0xffffffb5 0xffffffb5 0xffffffb5 0xffffffb5 0xffffffb5 0xffffffb5 0xffffffb5 0xffffffb5 0xffffffb5 0xffffffb5 0xffffffb5 0xffffffb5 0xffffffb5 0xffffffb5 0xffffffb5 0xffffffb5 0xffffffb5 0xffffffb5 0xffffffb5 0xffffffb5 0xffffffb5 0xffffffb5 0xffffffb5 0xffffffb5 0xffffffb5 0xffffffb5 0xffffffb5 0xffffffb5 0xffffffb5 0xffffffb5 0xffffffb5 0xffffffb5 0xffffffb5 0xffffffb5 0xffffffb5 0xffffffb5 0xffffffb5 0xffffffb5 0xffffffb5 0xffffffb5 0xffffffb5 0xffffffb5 0xffffffb5 0xffffffb5 0xffffffb5 0xffffffb5 0xffffffb5 0xffffffb5 0xffffffb5 0xffffffb5 0xffffffb5 0xffffffb5 0xffffffb5 0xffffffb5 0xffffffb5 0xffffffb5 0xffffffb5 0xffffffb5 0xffffffb5 0xffffffb5 0xffffffb5 0xffffffb5 0xffffffb5 0xffffffb5 0xffffffb5 0xffffffb5 0xffffffb5 0xffffffb5 0xffffffb5 0xffffffb5 0xffffffb5 0xffffffb5 0xffffffb5 0xffffffb5 0xffffffb5 0xffffffb5 0xffffffb5 0xffffffb5 0xffffffb5 0xffffffb5 0xffffffb5 0xffffffb5 0xffffffb5 0xffffffb5 0xffffffb5 0xffffffb5 0xffffffb5 0xffffffb5 0xffffffb5 0xffffffb5 0xffffffb5 0xffffffb5 0xffffffb5 0xffffffb5 0xffffffb5 0xffffffb5 0xffffffb5 0xffffffb5 0xffffffb5 0xffffffb5 0xffffffb5 0xffffffb5 0xffffffb5 0xffffffb5 0xffffffb5 0xffffffb5 0xffffffb5 0xffffffb5 0xffffffb5 0xffffffb5 0xffffffb5 0xffffffb5 0xffffffb5 0xffffffb5 0xffffffb5 0xffffffb5 0xffffffb5 0xffffffb5 0xffffffb5 0xffffffb5 0xffffffb5 0xffffffb5 0xffffffb5 0xffffffb5 0xffffffb5 0xffffffb5 0xffffffb5 0xffffffb5 0xffffffb5 0xffffffb5 0xffffffb5 0xffffffb5 0xffffffb5 0xffffffb5 0xffffffb5 0xffffffb5 0xffffffb5 0xffffffb5 0xffffffb5 0xffffffb5 0xffffffb5 0xffffffb5 0xffffffb5 0xffffffb5 0xffffffb5 0xffffffb5 0xffffffb5 0xffffffb5 0xffffffb5 0xffffffb5 0xffffffb5 0xffffffb5 0xffffffb5 0xffffffb5 0xffffffb5 0xffffffb5 0xffffffb5 0xffffffb5 0xffffffb5 0xffffffb5 0xffffffb5 0xffffffb5 0xffffffb5 0xffffffb5 0xffffffb5 0xffffffb5 0xffffffb5 0xffffffb5 0xffffffb5 0xffffffb5 0xffffffb5 0xffffffb5 0xffffffb5 0xffffffb5 0xffffffb5 0xffffffb5 0xffffffb5 0xffffffb5 0xffffffb5 0xffffffb5 0xffffffb5 0xffffffb5 0xffffffb5 0xffffffb5 0xffffffb5 0xffffffb5 0xffffffb5 0xffffffb5 0xffffffb5 0xffffffb5 0xffffffb5 0xffffffb5 0xffffffb5 0xffffffb5 0xffffffb5 0xffffffb5 0xffffffb5 0xffffffb5 0xffffffb5 0xffffffb5 0xffffffb5 0xffffffb5 0xffffffb5 0xffffffb5 0xffffffb5 0xffffffb5 0xffffffb5 0xffffffb5 0xffffffb5 0xffffffb5 0xffffffb5 0xffffffb5 0xffffffb5 0xffffffb5 0xffffffb5 0xffffffb5 0xffffffb5 0xffffffb5 0xffffffb5 0xffffffb5 0xffffffb5 0xffffffb5 0xffffffb5 0xffffffb5 0xffffffb5 0xffffffb5 0xffffffb5 0xffffffb5 0xffffffb5 0xffffffb5 0xffffffb5 0xffffffb5 0xffffffb5 0xffffffb5 0xffffffb5 0xffffffb5 0xffffffb5 0xffffffb5 0xffffffb5 0xffffffb5 0xffffffb5 0xffffffb5 0xffffffb5 0xffffffb5 0xffffffb5 0xffffffb5 0xffffffb5 0xffffffb5 0xffffffb5 0xffffffb5 0xffffffb5 0xffffffb5 0xffffffb5 0xffffffb5 0xffffffb5 0xffffffb5 0xffffffb5 0xffffffb5 0xffffffb5 0xffffffb5 0xffffffb5 0xffffffb5 0xffffffb5 0xffffffb5 0xffffffb5 0xffffffb5 0xffffffb5 0xffffffb5 0xffffffb5 0xffffffb5 0xffffffb5 0xffffffb5 0xffffffb5 0xffffffb5 0xffffffb5 0xffffffb5 0xffffffb5 0xffffffb5 0xffffffb5 0xffffffb5 0xffffffb5 0xffffffb5 0xffffffb5 0xffffffb5 0xffffffb5 0xffffffb5 0xffffffb5 0xffffffb5 0xffffffb5 0xffffffb5 0xffffffb5 0xffffffb5 0xffffffb5 0xffffffb5 0xffffffb5 0xffffffb5 0xffffffb5 0xffffffb5 0xffffffb5 0xffffffb5 0xffffffb5 0xffffffb5 0xffffffb5 0xffffffb5 0xffffffb5 0xffffffb5 0xffffffb5 0xffffffb5 0xffffffb5 0xffffffb5 0xffffffb5 0xffffffb5 0xffffffb5 0xffffffb5 0xffffffb5 0xffffffb5 0xffffffb5 0xffffffb5 0xffffffb5 0xffffffb5 0xffffffb5 0xffffffb5 0xffffffb5 0xffffffb5 0xffffffb5 0xffffffb5 0xffffffb5 0xffffffb5 0xffffffb5 0xffffffb5 0xffffffb5 0xffffffb5 0xffffffb5 0xffffffb5 0xffffffb5 0xffffffb5 0xffffffb5 0xffffffb5 0xffffffb5 0xffffffb5 0xffffffb5 0xffffffb5 0xffffffb5 0xffffffb5 0xffffffb5 0xffffffb5 0xffffffb5 0xffffffb5 0xffffffb5 0xffffffb5 0xffffffb5>;
					PS_Config_Lmt_FW_Diff_P = <0x4b 0x4b 0x4b 0x4b 0x4b 0x4b 0x4b 0x4b 0x4b 0x4b 0x4b 0x4b 0x4b 0x4b 0x4b 0x4b 0x4b 0x4b 0x4b 0x4b 0x4b 0x4b 0x4b 0x4b 0x4b 0x4b 0x4b 0x4b 0x4b 0x4b 0x4b 0x4b 0x4b 0x4b 0x4b 0x4b 0x4b 0x4b 0x4b 0x4b 0x4b 0x4b 0x4b 0x4b 0x4b 0x4b 0x4b 0x4b 0x4b 0x4b 0x4b 0x4b 0x4b 0x4b 0x4b 0x4b 0x4b 0x4b 0x4b 0x4b 0x4b 0x4b 0x4b 0x4b 0x4b 0x4b 0x4b 0x4b 0x4b 0x4b 0x4b 0x4b 0x4b 0x4b 0x4b 0x4b 0x4b 0x4b 0x4b 0x4b 0x4b 0x4b 0x4b 0x4b 0x4b 0x4b 0x4b 0x4b 0x4b 0x4b 0x4b 0x4b 0x4b 0x4b 0x4b 0x4b 0x4b 0x4b 0x4b 0x4b 0x4b 0x4b 0x4b 0x4b 0x4b 0x4b 0x4b 0x4b 0x4b 0x4b 0x4b 0x4b 0x4b 0x4b 0x4b 0x4b 0x4b 0x4b 0x4b 0x4b 0x4b 0x4b 0x4b 0x4b 0x4b 0x4b 0x4b 0x4b 0x4b 0x4b 0x4b 0x4b 0x4b 0x4b 0x4b 0x4b 0x4b 0x4b 0x4b 0x4b 0x4b 0x4b 0x4b 0x4b 0x4b 0x4b 0x4b 0x4b 0x4b 0x4b 0x4b 0x4b 0x4b 0x4b 0x4b 0x4b 0x4b 0x4b 0x4b 0x4b 0x4b 0x4b 0x4b 0x4b 0x4b 0x4b 0x4b 0x4b 0x4b 0x4b 0x4b 0x4b 0x4b 0x4b 0x4b 0x4b 0x4b 0x4b 0x4b 0x4b 0x4b 0x4b 0x4b 0x4b 0x4b 0x4b 0x4b 0x4b 0x4b 0x4b 0x4b 0x4b 0x4b 0x4b 0x4b 0x4b 0x4b 0x4b 0x4b 0x4b 0x4b 0x4b 0x4b 0x4b 0x4b 0x4b 0x4b 0x4b 0x4b 0x4b 0x4b 0x4b 0x4b 0x4b 0x4b 0x4b 0x4b 0x4b 0x4b 0x4b 0x4b 0x4b 0x4b 0x4b 0x4b 0x4b 0x4b 0x4b 0x4b 0x4b 0x4b 0x4b 0x4b 0x4b 0x4b 0x4b 0x4b 0x4b 0x4b 0x4b 0x4b 0x4b 0x4b 0x4b 0x4b 0x4b 0x4b 0x4b 0x4b 0x4b 0x4b 0x4b 0x4b 0x4b 0x4b 0x4b 0x4b 0x4b 0x4b 0x4b 0x4b 0x4b 0x4b 0x4b 0x4b 0x4b 0x4b 0x4b 0x4b 0x4b 0x4b 0x4b 0x4b 0x4b 0x4b 0x4b 0x4b 0x4b 0x4b 0x4b 0x4b 0x4b 0x4b 0x4b 0x4b 0x4b 0x4b 0x4b 0x4b 0x4b 0x4b 0x4b 0x4b 0x4b 0x4b 0x4b 0x4b 0x4b 0x4b 0x4b 0x4b 0x4b 0x4b 0x4b 0x4b 0x4b 0x4b 0x4b 0x4b 0x4b 0x4b 0x4b 0x4b 0x4b 0x4b 0x4b 0x4b 0x4b 0x4b 0x4b 0x4b 0x4b 0x4b 0x4b 0x4b 0x4b 0x4b 0x4b 0x4b 0x4b 0x4b 0x4b 0x4b 0x4b 0x4b 0x4b 0x4b 0x4b 0x4b 0x4b 0x4b 0x4b 0x4b 0x4b 0x4b 0x4b 0x4b 0x4b 0x4b 0x4b 0x4b 0x4b 0x4b 0x4b 0x4b 0x4b 0x4b 0x4b 0x4b 0x4b 0x4b 0x4b 0x4b 0x4b 0x4b 0x4b 0x4b 0x4b 0x4b 0x4b 0x4b 0x4b 0x4b 0x4b 0x4b 0x4b 0x4b 0x4b 0x4b 0x4b 0x4b 0x4b 0x4b 0x4b 0x4b 0x4b 0x4b 0x4b 0x4b 0x4b 0x4b 0x4b 0x4b 0x4b 0x4b 0x4b 0x4b 0x4b 0x4b 0x4b 0x4b 0x4b 0x4b 0x4b 0x4b 0x4b 0x4b 0x4b 0x4b 0x4b 0x4b 0x4b 0x4b 0x4b 0x4b 0x4b 0x4b 0x4b 0x4b 0x4b 0x4b 0x4b 0x4b 0x4b 0x4b 0x4b 0x4b 0x4b 0x4b 0x4b 0x4b 0x4b 0x4b 0x4b 0x4b 0x4b 0x4b 0x4b 0x4b 0x4b 0x4b 0x4b 0x4b 0x4b 0x4b 0x4b 0x4b 0x4b 0x4b 0x4b 0x4b 0x4b 0x4b 0x4b 0x4b 0x4b 0x4b 0x4b 0x4b 0x4b 0x4b 0x4b 0x4b 0x4b 0x4b 0x4b 0x4b 0x4b 0x4b 0x4b 0x4b 0x4b 0x4b 0x4b 0x4b 0x4b 0x4b 0x4b 0x4b 0x4b 0x4b 0x4b 0x4b 0x4b 0x4b 0x4b 0x4b 0x4b 0x4b 0x4b 0x4b 0x4b 0x4b 0x4b 0x4b 0x4b 0x4b 0x4b 0x4b 0x4b 0x4b 0x4b 0x4b 0x4b 0x4b 0x4b 0x4b 0x4b 0x4b 0x4b 0x4b 0x4b 0x4b 0x4b 0x4b 0x4b 0x4b 0x4b 0x4b 0x4b 0x4b 0x4b 0x4b 0x4b 0x4b 0x4b 0x4b 0x4b 0x4b 0x4b 0x4b 0x4b 0x4b 0x4b 0x4b 0x4b 0x4b 0x4b 0x4b 0x4b 0x4b 0x4b 0x4b 0x4b 0x4b 0x4b 0x4b 0x4b 0x4b 0x4b 0x4b 0x4b 0x4b 0x4b 0x4b 0x4b 0x4b 0x4b 0x4b 0x4b 0x4b 0x4b 0x4b 0x4b 0x4b 0x4b 0x4b 0x4b 0x4b 0x4b 0x4b 0x4b 0x4b 0x4b 0x4b 0x4b 0x4b 0x4b 0x4b 0x4b 0x4b 0x4b 0x4b 0x4b 0x4b 0x4b 0x4b 0x4b 0x4b 0x4b 0x4b 0x4b 0x4b 0x4b 0x4b 0x4b 0x4b 0x4b 0x4b 0x4b 0x4b 0x4b 0x4b 0x4b 0x4b 0x4b 0x4b 0x4b 0x4b 0x4b 0x4b 0x4b 0x4b 0x4b 0x4b 0x4b 0x4b 0x4b 0x4b 0x4b 0x4b 0x4b 0x4b 0x4b 0x4b 0x4b 0x4b 0x4b 0x4b 0x4b 0x4b 0x4b 0x4b 0x4b 0x4b 0x4b 0x4b 0x4b 0x4b 0x4b 0x4b 0x4b 0x4b 0x4b 0x4b 0x4b 0x4b 0x4b 0x4b 0x4b 0x4b>;
					PS_Config_Lmt_FW_Rawdata_N = <0xf0 0xf0 0xf0 0xf0 0xf0 0xf0 0xf0 0xf0 0xf0 0xf0 0xf0 0xf0 0xf0 0xf0 0xf0 0xf0 0xf0 0xf0 0xf0 0xf0 0xf0 0xf0 0xf0 0xf0 0xf0 0xf0 0xf0 0xf0 0xf0 0xf0 0xf0 0xf0 0xf0 0xf0 0xf0 0xf0 0xf0 0xf0 0xf0 0xf0 0xf0 0xf0 0xf0 0xf0 0xf0 0xf0 0xf0 0xf0 0xf0 0xf0 0xf0 0xf0 0xf0 0xf0 0xf0 0xf0 0xf0 0xf0 0xf0 0xf0 0xf0 0xf0 0xf0 0xf0 0xf0 0xf0 0xf0 0xf0 0xf0 0xf0 0xf0 0xf0 0xf0 0xf0 0xf0 0xf0 0xf0 0xf0 0xf0 0xf0 0xf0 0xf0 0xf0 0xf0 0xf0 0xf0 0xf0 0xf0 0xf0 0xf0 0xf0 0xf0 0xf0 0xf0 0xf0 0xf0 0xf0 0xf0 0xf0 0xf0 0xf0 0xf0 0xf0 0xf0 0xf0 0xf0 0xf0 0xf0 0xf0 0xf0 0xf0 0xf0 0xf0 0xf0 0xf0 0xf0 0xf0 0xf0 0xf0 0xf0 0xf0 0xf0 0xf0 0xf0 0xf0 0xf0 0xf0 0xf0 0xf0 0xf0 0xf0 0xf0 0xf0 0xf0 0xf0 0xf0 0xf0 0xf0 0xf0 0xf0 0xf0 0xf0 0xf0 0xf0 0xf0 0xf0 0xf0 0xf0 0xf0 0xf0 0xf0 0xf0 0xf0 0xf0 0xf0 0xf0 0xf0 0xf0 0xf0 0xf0 0xf0 0xf0 0xf0 0xf0 0xf0 0xf0 0xf0 0xf0 0xf0 0xf0 0xf0 0xf0 0xf0 0xf0 0xf0 0xf0 0xf0 0xf0 0xf0 0xf0 0xf0 0xf0 0xf0 0xf0 0xf0 0xf0 0xf0 0xf0 0xf0 0xf0 0xf0 0xf0 0xf0 0xf0 0xf0 0xf0 0xf0 0xf0 0xf0 0xf0 0xf0 0xf0 0xf0 0xf0 0xf0 0xf0 0xf0 0xf0 0xf0 0xf0 0xf0 0xf0 0xf0 0xf0 0xf0 0xf0 0xf0 0xf0 0xf0 0xf0 0xf0 0xf0 0xf0 0xf0 0xf0 0xf0 0xf0 0xf0 0xf0 0xf0 0xf0 0xf0 0xf0 0xf0 0xf0 0xf0 0xf0 0xf0 0xf0 0xf0 0xf0 0xf0 0xf0 0xf0 0xf0 0xf0 0xf0 0xf0 0xf0 0xf0 0xf0 0xf0 0xf0 0xf0 0xf0 0xf0 0xf0 0xf0 0xf0 0xf0 0xf0 0xf0 0xf0 0xf0 0xf0 0xf0 0xf0 0xf0 0xf0 0xf0 0xf0 0xf0 0xf0 0xf0 0xf0 0xf0 0xf0 0xf0 0xf0 0xf0 0xf0 0xf0 0xf0 0xf0 0xf0 0xf0 0xf0 0xf0 0xf0 0xf0 0xf0 0xf0 0xf0 0xf0 0xf0 0xf0 0xf0 0xf0 0xf0 0xf0 0xf0 0xf0 0xf0 0xf0 0xf0 0xf0 0xf0 0xf0 0xf0 0xf0 0xf0 0xf0 0xf0 0xf0 0xf0 0xf0 0xf0 0xf0 0xf0 0xf0 0xf0 0xf0 0xf0 0xf0 0xf0 0xf0 0xf0 0xf0 0xf0 0xf0 0xf0 0xf0 0xf0 0xf0 0xf0 0xf0 0xf0 0xf0 0xf0 0xf0 0xf0 0xf0 0xf0 0xf0 0xf0 0xf0 0xf0 0xf0 0xf0 0xf0 0xf0 0xf0 0xf0 0xf0 0xf0 0xf0 0xf0 0xf0 0xf0 0xf0 0xf0 0xf0 0xf0 0xf0 0xf0 0xf0 0xf0 0xf0 0xf0 0xf0 0xf0 0xf0 0xf0 0xf0 0xf0 0xf0 0xf0 0xf0 0xf0 0xf0 0xf0 0xf0 0xf0 0xf0 0xf0 0xf0 0xf0 0xf0 0xf0 0xf0 0xf0 0xf0 0xf0 0xf0 0xf0 0xf0 0xf0 0xf0 0xf0 0xf0 0xf0 0xf0 0xf0 0xf0 0xf0 0xf0 0xf0 0xf0 0xf0 0xf0 0xf0 0xf0 0xf0 0xf0 0xf0 0xf0 0xf0 0xf0 0xf0 0xf0 0xf0 0xf0 0xf0 0xf0 0xf0 0xf0 0xf0 0xf0 0xf0 0xf0 0xf0 0xf0 0xf0 0xf0 0xf0 0xf0 0xf0 0xf0 0xf0 0xf0 0xf0 0xf0 0xf0 0xf0 0xf0 0xf0 0xf0 0xf0 0xf0 0xf0 0xf0 0xf0 0xf0 0xf0 0xf0 0xf0 0xf0 0xf0 0xf0 0xf0 0xf0 0xf0 0xf0 0xf0 0xf0 0xf0 0xf0 0xf0 0xf0 0xf0 0xf0 0xf0 0xf0 0xf0 0xf0 0xf0 0xf0 0xf0 0xf0 0xf0 0xf0 0xf0 0xf0 0xf0 0xf0 0xf0 0xf0 0xf0 0xf0 0xf0 0xf0 0xf0 0xf0 0xf0 0xf0 0xf0 0xf0 0xf0 0xf0 0xf0 0xf0 0xf0 0xf0 0xf0 0xf0 0xf0 0xf0 0xf0 0xf0 0xf0 0xf0 0xf0 0xf0 0xf0 0xf0 0xf0 0xf0 0xf0 0xf0 0xf0 0xf0 0xf0 0xf0 0xf0 0xf0 0xf0 0xf0 0xf0 0xf0 0xf0 0xf0 0xf0 0xf0 0xf0 0xf0 0xf0 0xf0 0xf0 0xf0 0xf0 0xf0 0xf0 0xf0 0xf0 0xf0 0xf0 0xf0 0xf0 0xf0 0xf0 0xf0 0xf0 0xf0 0xf0 0xf0 0xf0 0xf0 0xf0 0xf0 0xf0 0xf0 0xf0 0xf0 0xf0 0xf0 0xf0 0xf0 0xf0 0xf0 0xf0 0xf0 0xf0 0xf0 0xf0 0xf0 0xf0 0xf0 0xf0 0xf0 0xf0 0xf0 0xf0 0xf0 0xf0 0xf0 0xf0 0xf0 0xf0 0xf0 0xf0 0xf0 0xf0 0xf0 0xf0 0xf0 0xf0 0xf0 0xf0 0xf0 0xf0 0xf0 0xf0 0xf0 0xf0 0xf0 0xf0 0xf0 0xf0 0xf0 0xf0 0xf0 0xf0 0xf0 0xf0 0xf0 0xf0 0xf0 0xf0 0xf0 0xf0 0xf0 0xf0 0xf0 0xf0 0xf0 0xf0 0xf0 0xf0 0xf0 0xf0 0xf0 0xf0 0xf0 0xf0 0xf0 0xf0 0xf0 0xf0 0xf0 0xf0 0xf0 0xf0 0xf0 0xf0 0xf0 0xf0 0xf0 0xf0 0xf0 0xf0 0xf0>;
					PS_Config_Lmt_FW_Rawdata_P = <0xf00 0xf00 0xf00 0xf00 0xf00 0xf00 0xf00 0xf00 0xf00 0xf00 0xf00 0xf00 0xf00 0xf00 0xf00 0xf00 0xf00 0xf00 0xf00 0xf00 0xf00 0xf00 0xf00 0xf00 0xf00 0xf00 0xf00 0xf00 0xf00 0xf00 0xf00 0xf00 0xf00 0xf00 0xf00 0xf00 0xf00 0xf00 0xf00 0xf00 0xf00 0xf00 0xf00 0xf00 0xf00 0xf00 0xf00 0xf00 0xf00 0xf00 0xf00 0xf00 0xf00 0xf00 0xf00 0xf00 0xf00 0xf00 0xf00 0xf00 0xf00 0xf00 0xf00 0xf00 0xf00 0xf00 0xf00 0xf00 0xf00 0xf00 0xf00 0xf00 0xf00 0xf00 0xf00 0xf00 0xf00 0xf00 0xf00 0xf00 0xf00 0xf00 0xf00 0xf00 0xf00 0xf00 0xf00 0xf00 0xf00 0xf00 0xf00 0xf00 0xf00 0xf00 0xf00 0xf00 0xf00 0xf00 0xf00 0xf00 0xf00 0xf00 0xf00 0xf00 0xf00 0xf00 0xf00 0xf00 0xf00 0xf00 0xf00 0xf00 0xf00 0xf00 0xf00 0xf00 0xf00 0xf00 0xf00 0xf00 0xf00 0xf00 0xf00 0xf00 0xf00 0xf00 0xf00 0xf00 0xf00 0xf00 0xf00 0xf00 0xf00 0xf00 0xf00 0xf00 0xf00 0xf00 0xf00 0xf00 0xf00 0xf00 0xf00 0xf00 0xf00 0xf00 0xf00 0xf00 0xf00 0xf00 0xf00 0xf00 0xf00 0xf00 0xf00 0xf00 0xf00 0xf00 0xf00 0xf00 0xf00 0xf00 0xf00 0xf00 0xf00 0xf00 0xf00 0xf00 0xf00 0xf00 0xf00 0xf00 0xf00 0xf00 0xf00 0xf00 0xf00 0xf00 0xf00 0xf00 0xf00 0xf00 0xf00 0xf00 0xf00 0xf00 0xf00 0xf00 0xf00 0xf00 0xf00 0xf00 0xf00 0xf00 0xf00 0xf00 0xf00 0xf00 0xf00 0xf00 0xf00 0xf00 0xf00 0xf00 0xf00 0xf00 0xf00 0xf00 0xf00 0xf00 0xf00 0xf00 0xf00 0xf00 0xf00 0xf00 0xf00 0xf00 0xf00 0xf00 0xf00 0xf00 0xf00 0xf00 0xf00 0xf00 0xf00 0xf00 0xf00 0xf00 0xf00 0xf00 0xf00 0xf00 0xf00 0xf00 0xf00 0xf00 0xf00 0xf00 0xf00 0xf00 0xf00 0xf00 0xf00 0xf00 0xf00 0xf00 0xf00 0xf00 0xf00 0xf00 0xf00 0xf00 0xf00 0xf00 0xf00 0xf00 0xf00 0xf00 0xf00 0xf00 0xf00 0xf00 0xf00 0xf00 0xf00 0xf00 0xf00 0xf00 0xf00 0xf00 0xf00 0xf00 0xf00 0xf00 0xf00 0xf00 0xf00 0xf00 0xf00 0xf00 0xf00 0xf00 0xf00 0xf00 0xf00 0xf00 0xf00 0xf00 0xf00 0xf00 0xf00 0xf00 0xf00 0xf00 0xf00 0xf00 0xf00 0xf00 0xf00 0xf00 0xf00 0xf00 0xf00 0xf00 0xf00 0xf00 0xf00 0xf00 0xf00 0xf00 0xf00 0xf00 0xf00 0xf00 0xf00 0xf00 0xf00 0xf00 0xf00 0xf00 0xf00 0xf00 0xf00 0xf00 0xf00 0xf00 0xf00 0xf00 0xf00 0xf00 0xf00 0xf00 0xf00 0xf00 0xf00 0xf00 0xf00 0xf00 0xf00 0xf00 0xf00 0xf00 0xf00 0xf00 0xf00 0xf00 0xf00 0xf00 0xf00 0xf00 0xf00 0xf00 0xf00 0xf00 0xf00 0xf00 0xf00 0xf00 0xf00 0xf00 0xf00 0xf00 0xf00 0xf00 0xf00 0xf00 0xf00 0xf00 0xf00 0xf00 0xf00 0xf00 0xf00 0xf00 0xf00 0xf00 0xf00 0xf00 0xf00 0xf00 0xf00 0xf00 0xf00 0xf00 0xf00 0xf00 0xf00 0xf00 0xf00 0xf00 0xf00 0xf00 0xf00 0xf00 0xf00 0xf00 0xf00 0xf00 0xf00 0xf00 0xf00 0xf00 0xf00 0xf00 0xf00 0xf00 0xf00 0xf00 0xf00 0xf00 0xf00 0xf00 0xf00 0xf00 0xf00 0xf00 0xf00 0xf00 0xf00 0xf00 0xf00 0xf00 0xf00 0xf00 0xf00 0xf00 0xf00 0xf00 0xf00 0xf00 0xf00 0xf00 0xf00 0xf00 0xf00 0xf00 0xf00 0xf00 0xf00 0xf00 0xf00 0xf00 0xf00 0xf00 0xf00 0xf00 0xf00 0xf00 0xf00 0xf00 0xf00 0xf00 0xf00 0xf00 0xf00 0xf00 0xf00 0xf00 0xf00 0xf00 0xf00 0xf00 0xf00 0xf00 0xf00 0xf00 0xf00 0xf00 0xf00 0xf00 0xf00 0xf00 0xf00 0xf00 0xf00 0xf00 0xf00 0xf00 0xf00 0xf00 0xf00 0xf00 0xf00 0xf00 0xf00 0xf00 0xf00 0xf00 0xf00 0xf00 0xf00 0xf00 0xf00 0xf00 0xf00 0xf00 0xf00 0xf00 0xf00 0xf00 0xf00 0xf00 0xf00 0xf00 0xf00 0xf00 0xf00 0xf00 0xf00 0xf00 0xf00 0xf00 0xf00 0xf00 0xf00 0xf00 0xf00 0xf00 0xf00 0xf00 0xf00 0xf00 0xf00 0xf00 0xf00 0xf00 0xf00 0xf00 0xf00 0xf00 0xf00 0xf00 0xf00 0xf00 0xf00 0xf00 0xf00 0xf00 0xf00 0xf00 0xf00 0xf00 0xf00 0xf00 0xf00 0xf00 0xf00 0xf00 0xf00 0xf00 0xf00 0xf00 0xf00 0xf00 0xf00 0xf00 0xf00 0xf00 0xf00 0xf00 0xf00 0xf00 0xf00 0xf00 0xf00 0xf00 0xf00 0xf00 0xf00 0xf00 0xf00 0xf00 0xf00 0xf00 0xf00 0xf00 0xf00 0xf00 0xf00 0xf00 0xf00 0xf00 0xf00 0xf00 0xf00 0xf00 0xf00 0xf00 0xf00 0xf00 0xf00 0xf00 0xf00 0xf00 0xf00 0xf00 0xf00 0xf00 0xf00 0xf00 0xf00 0xf00 0xf00 0xf00 0xf00 0xf00 0xf00 0xf00 0xf00 0xf00 0xf00 0xf00 0xf00 0xf00 0xf00 0xf00 0xf00 0xf00 0xf00 0xf00 0xf00 0xf00 0xf00 0xf00 0xf00 0xf00 0xf00 0xf00 0xf00 0xf00 0xf00 0xf00 0xf00 0xf00 0xf00 0xf00 0xf00 0xf00 0xf00 0xf00 0xf00 0xf00 0xf00 0xf00 0xf00 0xf00 0xf00 0xf00 0xf00>;
					PS_Config_Lmt_Open_Rawdata_N = <0xfffffe01 0xfffffe01 0xfffffe01 0xfffffe01 0xfffffe01 0xfffffe01 0xfffffe01 0xfffffe01 0xfffffe01 0xfffffe01 0xfffffe01 0xfffffe01 0xfffffe01 0xfffffe01 0xfffffe01 0xfffffe01 0xfffffe01 0xfffffe01 0xfffffe01 0xfffffe01 0xfffffe01 0xfffffe01 0xfffffe01 0xfffffe01 0xfffffe01 0xfffffe01 0xfffffe01 0xfffffe01 0xfffffe01 0xfffffe01 0xfffffe01 0xfffffe01 0xfffffe01 0xfffffe01 0xfffffe01 0xfffffe01 0xfffffe01 0xfffffe01 0xfffffe01 0xfffffe01 0xfffffe01 0xfffffe01 0xfffffe01 0xfffffe01 0xfffffe01 0xfffffe01 0xfffffe01 0xfffffe01 0xfffffe01 0xfffffe01 0xfffffe01 0xfffffe01 0xfffffe01 0xfffffe01 0xfffffe01 0xfffffe01 0xfffffe01 0xfffffe01 0xfffffe01 0xfffffe01 0xfffffe01 0xfffffe01 0xfffffe01 0xfffffe01 0xfffffe01 0xfffffe01 0xfffffe01 0xfffffe01 0xfffffe01 0xfffffe01 0xfffffe01 0xfffffe01 0xfffffe01 0xfffffe01 0xfffffe01 0xfffffe01 0xfffffe01 0xfffffe01 0xfffffe01 0xfffffe01 0xfffffe01 0xfffffe01 0xfffffe01 0xfffffe01 0xfffffe01 0xfffffe01 0xfffffe01 0xfffffe01 0xfffffe01 0xfffffe01 0xfffffe01 0xfffffe01 0xfffffe01 0xfffffe01 0xfffffe01 0xfffffe01 0xfffffe01 0xfffffe01 0xfffffe01 0xfffffe01 0xfffffe01 0xfffffe01 0xfffffe01 0xfffffe01 0xfffffe01 0xfffffe01 0xfffffe01 0xfffffe01 0xfffffe01 0xfffffe01 0xfffffe01 0xfffffe01 0xfffffe01 0xfffffe01 0xfffffe01 0xfffffe01 0xfffffe01 0xfffffe01 0xfffffe01 0xfffffe01 0xfffffe01 0xfffffe01 0xfffffe01 0xfffffe01 0xfffffe01 0xfffffe01 0xfffffe01 0xfffffe01 0xfffffe01 0xfffffe01 0xfffffe01 0xfffffe01 0xfffffe01 0xfffffe01 0xfffffe01 0xfffffe01 0xfffffe01 0xfffffe01 0xfffffe01 0xfffffe01 0xfffffe01 0xfffffe01 0xfffffe01 0xfffffe01 0xfffffe01 0xfffffe01 0xfffffe01 0xfffffe01 0xfffffe01 0xfffffe01 0xfffffe01 0xfffffe01 0xfffffe01 0xfffffe01 0xfffffe01 0xfffffe01 0xfffffe01 0xfffffe01 0xfffffe01 0xfffffe01 0xfffffe01 0xfffffe01 0xfffffe01 0xfffffe01 0xfffffe01 0xfffffe01 0xfffffe01 0xfffffe01 0xfffffe01 0xfffffe01 0xfffffe01 0xfffffe01 0xfffffe01 0xfffffe01 0xfffffe01 0xfffffe01 0xfffffe01 0xfffffe01 0xfffffe01 0xfffffe01 0xfffffe01 0xfffffe01 0xfffffe01 0xfffffe01 0xfffffe01 0xfffffe01 0xfffffe01 0xfffffe01 0xfffffe01 0xfffffe01 0xfffffe01 0xfffffe01 0xfffffe01 0xfffffe01 0xfffffe01 0xfffffe01 0xfffffe01 0xfffffe01 0xfffffe01 0xfffffe01 0xfffffe01 0xfffffe01 0xfffffe01 0xfffffe01 0xfffffe01 0xfffffe01 0xfffffe01 0xfffffe01 0xfffffe01 0xfffffe01 0xfffffe01 0xfffffe01 0xfffffe01 0xfffffe01 0xfffffe01 0xfffffe01 0xfffffe01 0xfffffe01 0xfffffe01 0xfffffe01 0xfffffe01 0xfffffe01 0xfffffe01 0xfffffe01 0xfffffe01 0xfffffe01 0xfffffe01 0xfffffe01 0xfffffe01 0xfffffe01 0xfffffe01 0xfffffe01 0xfffffe01 0xfffffe01 0xfffffe01 0xfffffe01 0xfffffe01 0xfffffe01 0xfffffe01 0xfffffe01 0xfffffe01 0xfffffe01 0xfffffe01 0xfffffe01 0xfffffe01 0xfffffe01 0xfffffe01 0xfffffe01 0xfffffe01 0xfffffe01 0xfffffe01 0xfffffe01 0xfffffe01 0xfffffe01 0xfffffe01 0xfffffe01 0xfffffe01 0xfffffe01 0xfffffe01 0xfffffe01 0xfffffe01 0xfffffe01 0xfffffe01 0xfffffe01 0xfffffe01 0xfffffe01 0xfffffe01 0xfffffe01 0xfffffe01 0xfffffe01 0xfffffe01 0xfffffe01 0xfffffe01 0xfffffe01 0xfffffe01 0xfffffe01 0xfffffe01 0xfffffe01 0xfffffe01 0xfffffe01 0xfffffe01 0xfffffe01 0xfffffe01 0xfffffe01 0xfffffe01 0xfffffe01 0xfffffe01 0xfffffe01 0xfffffe01 0xfffffe01 0xfffffe01 0xfffffe01 0xfffffe01 0xfffffe01 0xfffffe01 0xfffffe01 0xfffffe01 0xfffffe01 0xfffffe01 0xfffffe01 0xfffffe01 0xfffffe01 0xfffffe01 0xfffffe01 0xfffffe01 0xfffffe01 0xfffffe01 0xfffffe01 0xfffffe01 0xfffffe01 0xfffffe01 0xfffffe01 0xfffffe01 0xfffffe01 0xfffffe01 0xfffffe01 0xfffffe01 0xfffffe01 0xfffffe01 0xfffffe01 0xfffffe01 0xfffffe01 0xfffffe01 0xfffffe01 0xfffffe01 0xfffffe01 0xfffffe01 0xfffffe01 0xfffffe01 0xfffffe01 0xfffffe01 0xfffffe01 0xfffffe01 0xfffffe01 0xfffffe01 0xfffffe01 0xfffffe01 0xfffffe01 0xfffffe01 0xfffffe01 0xfffffe01 0xfffffe01 0xfffffe01 0xfffffe01 0xfffffe01 0xfffffe01 0xfffffe01 0xfffffe01 0xfffffe01 0xfffffe01 0xfffffe01 0xfffffe01 0xfffffe01 0xfffffe01 0xfffffe01 0xfffffe01 0xfffffe01 0xfffffe01 0xfffffe01 0xfffffe01 0xfffffe01 0xfffffe01 0xfffffe01 0xfffffe01 0xfffffe01 0xfffffe01 0xfffffe01 0xfffffe01 0xfffffe01 0xfffffe01 0xfffffe01 0xfffffe01 0xfffffe01 0xfffffe01 0xfffffe01 0xfffffe01 0xfffffe01 0xfffffe01 0xfffffe01 0xfffffe01 0xfffffe01 0xfffffe01 0xfffffe01 0xfffffe01 0xfffffe01 0xfffffe01 0xfffffe01 0xfffffe01 0xfffffe01 0xfffffe01 0xfffffe01 0xfffffe01 0xfffffe01 0xfffffe01 0xfffffe01 0xfffffe01 0xfffffe01 0xfffffe01 0xfffffe01 0xfffffe01 0xfffffe01 0xfffffe01 0xfffffe01 0xfffffe01 0xfffffe01 0xfffffe01 0xfffffe01 0xfffffe01 0xfffffe01 0xfffffe01 0xfffffe01 0xfffffe01 0xfffffe01 0xfffffe01 0xfffffe01 0xfffffe01 0xfffffe01 0xfffffe01 0xfffffe01 0xfffffe01 0xfffffe01 0xfffffe01 0xfffffe01 0xfffffe01 0xfffffe01 0xfffffe01 0xfffffe01 0xfffffe01 0xfffffe01 0xfffffe01 0xfffffe01 0xfffffe01 0xfffffe01 0xfffffe01 0xfffffe01 0xfffffe01 0xfffffe01 0xfffffe01 0xfffffe01 0xfffffe01 0xfffffe01 0xfffffe01 0xfffffe01 0xfffffe01 0xfffffe01 0xfffffe01 0xfffffe01 0xfffffe01 0xfffffe01 0xfffffe01 0xfffffe01 0xfffffe01 0xfffffe01 0xfffffe01 0xfffffe01 0xfffffe01 0xfffffe01 0xfffffe01 0xfffffe01 0xfffffe01 0xfffffe01 0xfffffe01 0xfffffe01 0xfffffe01 0xfffffe01 0xfffffe01 0xfffffe01 0xfffffe01 0xfffffe01 0xfffffe01 0xfffffe01 0xfffffe01 0xfffffe01 0xfffffe01 0xfffffe01 0xfffffe01 0xfffffe01 0xfffffe01 0xfffffe01 0xfffffe01 0xfffffe01 0xfffffe01 0xfffffe01 0xfffffe01 0xfffffe01 0xfffffe01 0xfffffe01 0xfffffe01 0xfffffe01 0xfffffe01 0xfffffe01 0xfffffe01 0xfffffe01 0xfffffe01 0xfffffe01 0xfffffe01 0xfffffe01 0xfffffe01 0xfffffe01 0xfffffe01 0xfffffe01 0xfffffe01 0xfffffe01 0xfffffe01 0xfffffe01 0xfffffe01 0xfffffe01 0xfffffe01 0xfffffe01 0xfffffe01 0xfffffe01 0xfffffe01 0xfffffe01 0xfffffe01 0xfffffe01 0xfffffe01 0xfffffe01 0xfffffe01 0xfffffe01 0xfffffe01 0xfffffe01 0xfffffe01 0xfffffe01 0xfffffe01 0xfffffe01 0xfffffe01 0xfffffe01 0xfffffe01 0xfffffe01 0xfffffe01 0xfffffe01 0xfffffe01 0xfffffe01 0xfffffe01 0xfffffe01 0xfffffe01 0xfffffe01 0xfffffe01 0xfffffe01 0xfffffe01 0xfffffe01 0xfffffe01 0xfffffe01 0xfffffe01 0xfffffe01 0xfffffe01 0xfffffe01 0xfffffe01 0xfffffe01 0xfffffe01 0xfffffe01 0xfffffe01 0xfffffe01 0xfffffe01 0xfffffe01 0xfffffe01 0xfffffe01 0xfffffe01 0xfffffe01 0xfffffe01 0xfffffe01 0xfffffe01 0xfffffe01 0xfffffe01 0xfffffe01 0xfffffe01 0xfffffe01 0xfffffe01 0xfffffe01 0xfffffe01 0xfffffe01 0xfffffe01 0xfffffe01 0xfffffe01 0xfffffe01 0xfffffe01 0xfffffe01 0xfffffe01 0xfffffe01 0xfffffe01 0xfffffe01 0xfffffe01 0xfffffe01 0xfffffe01 0xfffffe01 0xfffffe01 0xfffffe01 0xfffffe01 0xfffffe01 0xfffffe01 0xfffffe01 0xfffffe01 0xfffffe01 0xfffffe01 0xfffffe01 0xfffffe01 0xfffffe01 0xfffffe01 0xfffffe01 0xfffffe01 0xfffffe01 0xfffffe01 0xfffffe01 0xfffffe01 0xfffffe01 0xfffffe01 0xfffffe01 0xfffffe01 0xfffffe01 0xfffffe01 0xfffffe01 0xfffffe01 0xfffffe01 0xfffffe01 0xfffffe01 0xfffffe01 0xfffffe01 0xfffffe01 0xfffffe01 0xfffffe01 0xfffffe01 0xfffffe01 0xfffffe01 0xfffffe01 0xfffffe01 0xfffffe01 0xfffffe01 0xfffffe01 0xfffffe01 0xfffffe01 0xfffffe01 0xfffffe01 0xfffffe01 0xfffffe01 0xfffffe01 0xfffffe01 0xfffffe01 0xfffffe01 0xfffffe01 0xfffffe01 0xfffffe01 0xfffffe01 0xfffffe01 0xfffffe01 0xfffffe01 0xfffffe01 0xfffffe01 0xfffffe01 0xfffffe01 0xfffffe01 0xfffffe01>;
					PS_Config_Lmt_Open_Rawdata_P = <0x1400 0x1400 0x1400 0x1400 0x1400 0x1400 0x1400 0x1400 0x1400 0x1400 0x1400 0x1400 0x1400 0x1400 0x1400 0x1400 0x1400 0x1400 0x1400 0x1400 0x1400 0x1400 0x1400 0x1400 0x1400 0x1400 0x1400 0x1400 0x1400 0x1400 0x1400 0x1400 0x1400 0x1400 0x1400 0x1400 0x1400 0x1400 0x1400 0x1400 0x1400 0x1400 0x1400 0x1400 0x1400 0x1400 0x1400 0x1400 0x1400 0x1400 0x1400 0x1400 0x1400 0x1400 0x1400 0x1400 0x1400 0x1400 0x1400 0x1400 0x1400 0x1400 0x1400 0x1400 0x1400 0x1400 0x1400 0x1400 0x1400 0x1400 0x1400 0x1400 0x1400 0x1400 0x1400 0x1400 0x1400 0x1400 0x1400 0x1400 0x1400 0x1400 0x1400 0x1400 0x1400 0x1400 0x1400 0x1400 0x1400 0x1400 0x1400 0x1400 0x1400 0x1400 0x1400 0x1400 0x1400 0x1400 0x1400 0x1400 0x1400 0x1400 0x1400 0x1400 0x1400 0x1400 0x1400 0x1400 0x1400 0x1400 0x1400 0x1400 0x1400 0x1400 0x1400 0x1400 0x1400 0x1400 0x1400 0x1400 0x1400 0x1400 0x1400 0x1400 0x1400 0x1400 0x1400 0x1400 0x1400 0x1400 0x1400 0x1400 0x1400 0x1400 0x1400 0x1400 0x1400 0x1400 0x1400 0x1400 0x1400 0x1400 0x1400 0x1400 0x1400 0x1400 0x1400 0x1400 0x1400 0x1400 0x1400 0x1400 0x1400 0x1400 0x1400 0x1400 0x1400 0x1400 0x1400 0x1400 0x1400 0x1400 0x1400 0x1400 0x1400 0x1400 0x1400 0x1400 0x1400 0x1400 0x1400 0x1400 0x1400 0x1400 0x1400 0x1400 0x1400 0x1400 0x1400 0x1400 0x1400 0x1400 0x1400 0x1400 0x1400 0x1400 0x1400 0x1400 0x1400 0x1400 0x1400 0x1400 0x1400 0x1400 0x1400 0x1400 0x1400 0x1400 0x1400 0x1400 0x1400 0x1400 0x1400 0x1400 0x1400 0x1400 0x1400 0x1400 0x1400 0x1400 0x1400 0x1400 0x1400 0x1400 0x1400 0x1400 0x1400 0x1400 0x1400 0x1400 0x1400 0x1400 0x1400 0x1400 0x1400 0x1400 0x1400 0x1400 0x1400 0x1400 0x1400 0x1400 0x1400 0x1400 0x1400 0x1400 0x1400 0x1400 0x1400 0x1400 0x1400 0x1400 0x1400 0x1400 0x1400 0x1400 0x1400 0x1400 0x1400 0x1400 0x1400 0x1400 0x1400 0x1400 0x1400 0x1400 0x1400 0x1400 0x1400 0x1400 0x1400 0x1400 0x1400 0x1400 0x1400 0x1400 0x1400 0x1400 0x1400 0x1400 0x1400 0x1400 0x1400 0x1400 0x1400 0x1400 0x1400 0x1400 0x1400 0x1400 0x1400 0x1400 0x1400 0x1400 0x1400 0x1400 0x1400 0x1400 0x1400 0x1400 0x1400 0x1400 0x1400 0x1400 0x1400 0x1400 0x1400 0x1400 0x1400 0x1400 0x1400 0x1400 0x1400 0x1400 0x1400 0x1400 0x1400 0x1400 0x1400 0x1400 0x1400 0x1400 0x1400 0x1400 0x1400 0x1400 0x1400 0x1400 0x1400 0x1400 0x1400 0x1400 0x1400 0x1400 0x1400 0x1400 0x1400 0x1400 0x1400 0x1400 0x1400 0x1400 0x1400 0x1400 0x1400 0x1400 0x1400 0x1400 0x1400 0x1400 0x1400 0x1400 0x1400 0x1400 0x1400 0x1400 0x1400 0x1400 0x1400 0x1400 0x1400 0x1400 0x1400 0x1400 0x1400 0x1400 0x1400 0x1400 0x1400 0x1400 0x1400 0x1400 0x1400 0x1400 0x1400 0x1400 0x1400 0x1400 0x1400 0x1400 0x1400 0x1400 0x1400 0x1400 0x1400 0x1400 0x1400 0x1400 0x1400 0x1400 0x1400 0x1400 0x1400 0x1400 0x1400 0x1400 0x1400 0x1400 0x1400 0x1400 0x1400 0x1400 0x1400 0x1400 0x1400 0x1400 0x1400 0x1400 0x1400 0x1400 0x1400 0x1400 0x1400 0x1400 0x1400 0x1400 0x1400 0x1400 0x1400 0x1400 0x1400 0x1400 0x1400 0x1400 0x1400 0x1400 0x1400 0x1400 0x1400 0x1400 0x1400 0x1400 0x1400 0x1400 0x1400 0x1400 0x1400 0x1400 0x1400 0x1400 0x1400 0x1400 0x1400 0x1400 0x1400 0x1400 0x1400 0x1400 0x1400 0x1400 0x1400 0x1400 0x1400 0x1400 0x1400 0x1400 0x1400 0x1400 0x1400 0x1400 0x1400 0x1400 0x1400 0x1400 0x1400 0x1400 0x1400 0x1400 0x1400 0x1400 0x1400 0x1400 0x1400 0x1400 0x1400 0x1400 0x1400 0x1400 0x1400 0x1400 0x1400 0x1400 0x1400 0x1400 0x1400 0x1400 0x1400 0x1400 0x1400 0x1400 0x1400 0x1400 0x1400 0x1400 0x1400 0x1400 0x1400 0x1400 0x1400 0x1400 0x1400 0x1400 0x1400 0x1400 0x1400 0x1400 0x1400 0x1400 0x1400 0x1400 0x1400 0x1400 0x1400 0x1400 0x1400 0x1400 0x1400 0x1400 0x1400 0x1400 0x1400 0x1400 0x1400 0x1400 0x1400 0x1400 0x1400 0x1400 0x1400 0x1400 0x1400 0x1400 0x1400 0x1400 0x1400 0x1400 0x1400 0x1400 0x1400 0x1400 0x1400 0x1400 0x1400 0x1400 0x1400 0x1400 0x1400 0x1400 0x1400 0x1400 0x1400 0x1400 0x1400 0x1400 0x1400 0x1400 0x1400 0x1400 0x1400 0x1400 0x1400 0x1400 0x1400 0x1400 0x1400 0x1400 0x1400 0x1400 0x1400 0x1400 0x1400 0x1400 0x1400 0x1400 0x1400 0x1400 0x1400 0x1400 0x1400 0x1400 0x1400 0x1400 0x1400 0x1400 0x1400 0x1400 0x1400 0x1400 0x1400 0x1400 0x1400 0x1400 0x1400 0x1400 0x1400 0x1400 0x1400 0x1400 0x1400 0x1400 0x1400 0x1400 0x1400 0x1400 0x1400 0x1400 0x1400 0x1400 0x1400 0x1400 0x1400 0x1400 0x1400 0x1400 0x1400 0x1400 0x1400 0x1400 0x1400 0x1400 0x1400 0x1400 0x1400 0x1400 0x1400 0x1400 0x1400 0x1400 0x1400 0x1400 0x1400 0x1400 0x1400 0x1400 0x1400 0x1400 0x1400 0x1400 0x1400 0x1400 0x1400 0x1400 0x1400 0x1400 0x1400 0x1400 0x1400 0x1400 0x1400 0x1400 0x1400 0x1400 0x1400 0x1400 0x1400 0x1400 0x1400 0x1400 0x1400 0x1400 0x1400>;
					PS_Config_Lmt_Short_Rawdata_N = <0x2710 0x2710 0x2710 0x2710 0x2710 0x2710 0x2710 0x2710 0x2710 0x2710 0x2710 0x2710 0x2710 0x2710 0x2710 0x2710 0x2710 0x2710 0x2710 0x2710 0x2710 0x2710 0x2710 0x2710 0x2710 0x2710 0x2710 0x2710 0x2710 0x2710 0x2710 0x2710 0x2710 0x2710 0x2710 0x2710 0x2710 0x2710 0x2710 0x2710 0x2710 0x2710 0x2710 0x2710 0x2710 0x2710 0x2710 0x2710 0x2710 0x2710 0x2710 0x2710 0x2710 0x2710 0x2710 0x2710 0x2710 0x2710 0x2710 0x2710 0x2710 0x2710 0x2710 0x2710 0x2710 0x2710 0x2710 0x2710 0x2710 0x2710 0x2710 0x2710 0x2710 0x2710 0x2710 0x2710 0x2710 0x2710 0x2710 0x2710 0x2710 0x2710 0x2710 0x2710 0x2710 0x2710 0x2710 0x2710 0x2710 0x2710 0x2710 0x2710 0x2710 0x2710 0x2710 0x2710 0x2710 0x2710 0x2710 0x2710 0x2710 0x2710 0x2710 0x2710 0x2710 0x2710 0x2710 0x2710 0x2710 0x2710 0x2710 0x2710 0x2710 0x2710 0x2710 0x2710 0x2710 0x2710 0x2710 0x2710 0x2710 0x2710 0x2710 0x2710 0x2710 0x2710 0x2710 0x2710 0x2710 0x2710 0x2710 0x2710 0x2710 0x2710 0x2710 0x2710 0x2710 0x2710 0x2710 0x2710 0x2710 0x2710 0x2710 0x2710 0x2710 0x2710 0x2710 0x2710 0x2710 0x2710 0x2710 0x2710 0x2710 0x2710 0x2710 0x2710 0x2710 0x2710 0x2710 0x2710 0x2710 0x2710 0x2710 0x2710 0x2710 0x2710 0x2710 0x2710 0x2710 0x2710 0x2710 0x2710 0x2710 0x2710 0x2710 0x2710 0x2710 0x2710 0x2710 0x2710 0x2710 0x2710 0x2710 0x2710 0x2710 0x2710 0x2710 0x2710 0x2710 0x2710 0x2710 0x2710 0x2710 0x2710 0x2710 0x2710 0x2710 0x2710 0x2710 0x2710 0x2710 0x2710 0x2710 0x2710 0x2710 0x2710 0x2710 0x2710 0x2710 0x2710 0x2710 0x2710 0x2710 0x2710 0x2710 0x2710 0x2710 0x2710 0x2710 0x2710 0x2710 0x2710 0x2710 0x2710 0x2710 0x2710 0x2710 0x2710 0x2710 0x2710 0x2710 0x2710 0x2710 0x2710 0x2710 0x2710 0x2710 0x2710 0x2710 0x2710 0x2710 0x2710 0x2710 0x2710 0x2710 0x2710 0x2710 0x2710 0x2710 0x2710 0x2710 0x2710 0x2710 0x2710 0x2710 0x2710 0x2710 0x2710 0x2710 0x2710 0x2710 0x2710 0x2710 0x2710 0x2710 0x2710 0x2710 0x2710 0x2710 0x2710 0x2710 0x2710 0x2710 0x2710 0x2710 0x2710 0x2710 0x2710 0x2710 0x2710 0x2710 0x2710 0x2710 0x2710 0x2710 0x2710 0x2710 0x2710 0x2710 0x2710 0x2710 0x2710 0x2710 0x2710 0x2710 0x2710 0x2710 0x2710 0x2710 0x2710 0x2710 0x2710 0x2710 0x2710 0x2710 0x2710 0x2710 0x2710 0x2710 0x2710 0x2710 0x2710 0x2710 0x2710 0x2710 0x2710 0x2710 0x2710 0x2710 0x2710 0x2710 0x2710 0x2710 0x2710 0x2710 0x2710 0x2710 0x2710 0x2710 0x2710 0x2710 0x2710 0x2710 0x2710 0x2710 0x2710 0x2710 0x2710 0x2710 0x2710 0x2710 0x2710 0x2710 0x2710 0x2710 0x2710 0x2710 0x2710 0x2710 0x2710 0x2710 0x2710 0x2710 0x2710 0x2710 0x2710 0x2710 0x2710 0x2710 0x2710 0x2710 0x2710 0x2710 0x2710 0x2710 0x2710 0x2710 0x2710 0x2710 0x2710 0x2710 0x2710 0x2710 0x2710 0x2710 0x2710 0x2710 0x2710 0x2710 0x2710 0x2710 0x2710 0x2710 0x2710 0x2710 0x2710 0x2710 0x2710 0x2710 0x2710 0x2710 0x2710 0x2710 0x2710 0x2710 0x2710 0x2710 0x2710 0x2710 0x2710 0x2710 0x2710 0x2710 0x2710 0x2710 0x2710 0x2710 0x2710 0x2710 0x2710 0x2710 0x2710 0x2710 0x2710 0x2710 0x2710 0x2710 0x2710 0x2710 0x2710 0x2710 0x2710 0x2710 0x2710 0x2710 0x2710 0x2710 0x2710 0x2710 0x2710 0x2710 0x2710 0x2710 0x2710 0x2710 0x2710 0x2710 0x2710 0x2710 0x2710 0x2710 0x2710 0x2710 0x2710 0x2710 0x2710 0x2710 0x2710 0x2710 0x2710 0x2710 0x2710 0x2710 0x2710 0x2710 0x2710 0x2710 0x2710 0x2710 0x2710 0x2710 0x2710 0x2710 0x2710 0x2710 0x2710 0x2710 0x2710 0x2710 0x2710 0x2710 0x2710 0x2710 0x2710 0x2710 0x2710 0x2710 0x2710 0x2710 0x2710 0x2710 0x2710 0x2710 0x2710 0x2710 0x2710 0x2710 0x2710 0x2710 0x2710 0x2710 0x2710 0x2710 0x2710 0x2710 0x2710 0x2710 0x2710 0x2710 0x2710 0x2710 0x2710 0x2710 0x2710 0x2710 0x2710 0x2710 0x2710 0x2710 0x2710 0x2710 0x2710 0x2710 0x2710 0x2710 0x2710 0x2710 0x2710 0x2710 0x2710 0x2710 0x2710 0x2710 0x2710 0x2710 0x2710 0x2710 0x2710 0x2710 0x2710 0x2710 0x2710 0x2710 0x2710 0x2710 0x2710 0x2710 0x2710 0x2710 0x2710 0x2710 0x2710 0x2710 0x2710 0x2710 0x2710 0x2710 0x2710 0x2710 0x2710 0x2710 0x2710 0x2710 0x2710 0x2710 0x2710 0x2710 0x2710 0x2710 0x2710 0x2710 0x2710 0x2710 0x2710 0x2710 0x2710 0x2710 0x2710 0x2710 0x2710 0x2710 0x2710 0x2710 0x2710 0x2710 0x2710 0x2710 0x2710 0x2710 0x2710 0x2710 0x2710 0x2710 0x2710 0x2710 0x2710 0x2710 0x2710 0x2710 0x2710 0x2710 0x2710 0x2710 0x2710 0x2710 0x2710 0x2710 0x2710 0x2710 0x2710 0x2710 0x2710 0x2710 0x2710 0x2710 0x2710 0x2710 0x2710 0x2710 0x2710 0x2710 0x2710 0x2710 0x2710 0x2710 0x2710 0x2710 0x2710 0x2710 0x2710 0x2710 0x2710 0x2710 0x2710 0x2710 0x2710 0x2710 0x2710 0x2710 0x2710 0x2710 0x2710 0x2710 0x2710 0x2710 0x2710 0x2710 0x2710 0x2710 0x2710 0x2710 0x2710 0x2710 0x2710 0x2710 0x2710 0x2710 0x2710 0x2710 0x2710 0x2710>;
					PS_Config_Lmt_Short_Rawdata_P = <0x36b8 0x36b8 0x36b8 0x36b8 0x36b8 0x36b8 0x36b8 0x36b8 0x36b8 0x36b8 0x36b8 0x36b8 0x36b8 0x36b8 0x36b8 0x36b8 0x36b8 0x36b8 0x36b8 0x36b8 0x36b8 0x36b8 0x36b8 0x36b8 0x36b8 0x36b8 0x36b8 0x36b8 0x36b8 0x36b8 0x36b8 0x36b8 0x36b8 0x36b8 0x36b8 0x36b8 0x36b8 0x36b8 0x36b8 0x36b8 0x36b8 0x36b8 0x36b8 0x36b8 0x36b8 0x36b8 0x36b8 0x36b8 0x36b8 0x36b8 0x36b8 0x36b8 0x36b8 0x36b8 0x36b8 0x36b8 0x36b8 0x36b8 0x36b8 0x36b8 0x36b8 0x36b8 0x36b8 0x36b8 0x36b8 0x36b8 0x36b8 0x36b8 0x36b8 0x36b8 0x36b8 0x36b8 0x36b8 0x36b8 0x36b8 0x36b8 0x36b8 0x36b8 0x36b8 0x36b8 0x36b8 0x36b8 0x36b8 0x36b8 0x36b8 0x36b8 0x36b8 0x36b8 0x36b8 0x36b8 0x36b8 0x36b8 0x36b8 0x36b8 0x36b8 0x36b8 0x36b8 0x36b8 0x36b8 0x36b8 0x36b8 0x36b8 0x36b8 0x36b8 0x36b8 0x36b8 0x36b8 0x36b8 0x36b8 0x36b8 0x36b8 0x36b8 0x36b8 0x36b8 0x36b8 0x36b8 0x36b8 0x36b8 0x36b8 0x36b8 0x36b8 0x36b8 0x36b8 0x36b8 0x36b8 0x36b8 0x36b8 0x36b8 0x36b8 0x36b8 0x36b8 0x36b8 0x36b8 0x36b8 0x36b8 0x36b8 0x36b8 0x36b8 0x36b8 0x36b8 0x36b8 0x36b8 0x36b8 0x36b8 0x36b8 0x36b8 0x36b8 0x36b8 0x36b8 0x36b8 0x36b8 0x36b8 0x36b8 0x36b8 0x36b8 0x36b8 0x36b8 0x36b8 0x36b8 0x36b8 0x36b8 0x36b8 0x36b8 0x36b8 0x36b8 0x36b8 0x36b8 0x36b8 0x36b8 0x36b8 0x36b8 0x36b8 0x36b8 0x36b8 0x36b8 0x36b8 0x36b8 0x36b8 0x36b8 0x36b8 0x36b8 0x36b8 0x36b8 0x36b8 0x36b8 0x36b8 0x36b8 0x36b8 0x36b8 0x36b8 0x36b8 0x36b8 0x36b8 0x36b8 0x36b8 0x36b8 0x36b8 0x36b8 0x36b8 0x36b8 0x36b8 0x36b8 0x36b8 0x36b8 0x36b8 0x36b8 0x36b8 0x36b8 0x36b8 0x36b8 0x36b8 0x36b8 0x36b8 0x36b8 0x36b8 0x36b8 0x36b8 0x36b8 0x36b8 0x36b8 0x36b8 0x36b8 0x36b8 0x36b8 0x36b8 0x36b8 0x36b8 0x36b8 0x36b8 0x36b8 0x36b8 0x36b8 0x36b8 0x36b8 0x36b8 0x36b8 0x36b8 0x36b8 0x36b8 0x36b8 0x36b8 0x36b8 0x36b8 0x36b8 0x36b8 0x36b8 0x36b8 0x36b8 0x36b8 0x36b8 0x36b8 0x36b8 0x36b8 0x36b8 0x36b8 0x36b8 0x36b8 0x36b8 0x36b8 0x36b8 0x36b8 0x36b8 0x36b8 0x36b8 0x36b8 0x36b8 0x36b8 0x36b8 0x36b8 0x36b8 0x36b8 0x36b8 0x36b8 0x36b8 0x36b8 0x36b8 0x36b8 0x36b8 0x36b8 0x36b8 0x36b8 0x36b8 0x36b8 0x36b8 0x36b8 0x36b8 0x36b8 0x36b8 0x36b8 0x36b8 0x36b8 0x36b8 0x36b8 0x36b8 0x36b8 0x36b8 0x36b8 0x36b8 0x36b8 0x36b8 0x36b8 0x36b8 0x36b8 0x36b8 0x36b8 0x36b8 0x36b8 0x36b8 0x36b8 0x36b8 0x36b8 0x36b8 0x36b8 0x36b8 0x36b8 0x36b8 0x36b8 0x36b8 0x36b8 0x36b8 0x36b8 0x36b8 0x36b8 0x36b8 0x36b8 0x36b8 0x36b8 0x36b8 0x36b8 0x36b8 0x36b8 0x36b8 0x36b8 0x36b8 0x36b8 0x36b8 0x36b8 0x36b8 0x36b8 0x36b8 0x36b8 0x36b8 0x36b8 0x36b8 0x36b8 0x36b8 0x36b8 0x36b8 0x36b8 0x36b8 0x36b8 0x36b8 0x36b8 0x36b8 0x36b8 0x36b8 0x36b8 0x36b8 0x36b8 0x36b8 0x36b8 0x36b8 0x36b8 0x36b8 0x36b8 0x36b8 0x36b8 0x36b8 0x36b8 0x36b8 0x36b8 0x36b8 0x36b8 0x36b8 0x36b8 0x36b8 0x36b8 0x36b8 0x36b8 0x36b8 0x36b8 0x36b8 0x36b8 0x36b8 0x36b8 0x36b8 0x36b8 0x36b8 0x36b8 0x36b8 0x36b8 0x36b8 0x36b8 0x36b8 0x36b8 0x36b8 0x36b8 0x36b8 0x36b8 0x36b8 0x36b8 0x36b8 0x36b8 0x36b8 0x36b8 0x36b8 0x36b8 0x36b8 0x36b8 0x36b8 0x36b8 0x36b8 0x36b8 0x36b8 0x36b8 0x36b8 0x36b8 0x36b8 0x36b8 0x36b8 0x36b8 0x36b8 0x36b8 0x36b8 0x36b8 0x36b8 0x36b8 0x36b8 0x36b8 0x36b8 0x36b8 0x36b8 0x36b8 0x36b8 0x36b8 0x36b8 0x36b8 0x36b8 0x36b8 0x36b8 0x36b8 0x36b8 0x36b8 0x36b8 0x36b8 0x36b8 0x36b8 0x36b8 0x36b8 0x36b8 0x36b8 0x36b8 0x36b8 0x36b8 0x36b8 0x36b8 0x36b8 0x36b8 0x36b8 0x36b8 0x36b8 0x36b8 0x36b8 0x36b8 0x36b8 0x36b8 0x36b8 0x36b8 0x36b8 0x36b8 0x36b8 0x36b8 0x36b8 0x36b8 0x36b8 0x36b8 0x36b8 0x36b8 0x36b8 0x36b8 0x36b8 0x36b8 0x36b8 0x36b8 0x36b8 0x36b8 0x36b8 0x36b8 0x36b8 0x36b8 0x36b8 0x36b8 0x36b8 0x36b8 0x36b8 0x36b8 0x36b8 0x36b8 0x36b8 0x36b8 0x36b8 0x36b8 0x36b8 0x36b8 0x36b8 0x36b8 0x36b8 0x36b8 0x36b8 0x36b8 0x36b8 0x36b8 0x36b8 0x36b8 0x36b8 0x36b8 0x36b8 0x36b8 0x36b8 0x36b8 0x36b8 0x36b8 0x36b8 0x36b8 0x36b8 0x36b8 0x36b8 0x36b8 0x36b8 0x36b8 0x36b8 0x36b8 0x36b8 0x36b8 0x36b8 0x36b8 0x36b8 0x36b8 0x36b8 0x36b8 0x36b8 0x36b8 0x36b8 0x36b8 0x36b8 0x36b8 0x36b8 0x36b8 0x36b8 0x36b8 0x36b8 0x36b8 0x36b8 0x36b8 0x36b8 0x36b8 0x36b8 0x36b8 0x36b8 0x36b8 0x36b8 0x36b8 0x36b8 0x36b8 0x36b8 0x36b8 0x36b8 0x36b8 0x36b8 0x36b8 0x36b8 0x36b8 0x36b8 0x36b8 0x36b8 0x36b8 0x36b8 0x36b8 0x36b8 0x36b8 0x36b8 0x36b8 0x36b8 0x36b8 0x36b8 0x36b8 0x36b8 0x36b8 0x36b8 0x36b8 0x36b8 0x36b8 0x36b8 0x36b8 0x36b8 0x36b8 0x36b8 0x36b8 0x36b8 0x36b8 0x36b8 0x36b8 0x36b8 0x36b8 0x36b8 0x36b8 0x36b8 0x36b8 0x36b8 0x36b8 0x36b8 0x36b8 0x36b8 0x36b8 0x36b8 0x36b8 0x36b8 0x36b8 0x36b8 0x36b8 0x36b8 0x36b8 0x36b8 0x36b8 0x36b8 0x36b8 0x36b8 0x36b8 0x36b8 0x36b8 0x36b8 0x36b8 0x36b8 0x36b8 0x36b8 0x36b8 0x36b8 0x36b8 0x36b8 0x36b8 0x36b8 0x36b8 0x36b8 0x36b8 0x36b8 0x36b8 0x36b8 0x36b8 0x36b8 0x36b8 0x36b8>;
					X_Channel = <0x12>;
					Y_Channel = <0x24>;
					compatible = "novatek-mp-criteria-nvtpid";
				};
			};
		};
	};

	fragment@41 {
		target = <0xffffffff>;

		__overlay__ {
			interrupt-parent = <0xffffffff>;
			pinctrl-0 = <0x4f>;
			pinctrl-1 = <0x50>;
			pinctrl-2 = <0x51>;
			pinctrl-3 = <0x52>;
			pinctrl-4 = <0x53>;
			pinctrl-5 = <0x54>;
			pinctrl-6 = <0x55>;
			pinctrl-names = "default", "state_eint_as_int", "state_eint_output0", "state_eint_output1", "state_rst_output0", "state_rst_output1", "state_spi_mode";
			status = "okay";
			tpd-resolution = <0x438 0x960>;
		};
	};

	fragment@42 {
		target = <0xffffffff>;

		__overlay__ {

			eint@0 {
				phandle = <0x50>;

				pins_cmd_dat {
					input-enable;
					pinmux = <0xc00>;
				};
			};

			eintoutput0 {
				phandle = <0x51>;

				pins_cmd_dat {
					output-low;
					pinmux = <0xc00>;
				};
			};

			eintoutput1 {
				phandle = <0x52>;

				pins_cmd_dat {
					output-high;
					pinmux = <0xc00>;
				};
			};

			pins_default {
				phandle = <0x4f>;
			};

			rstoutput0 {
				phandle = <0x53>;

				pins_cmd_dat {
					output-low;
					pinmux = <0x7900>;
				};
			};

			rstoutput1 {
				phandle = <0x54>;

				pins_cmd_dat {
					output-high;
					pinmux = <0x7900>;
				};
			};

			spimode_default {
				phandle = <0x55>;

				pins_cmd_dat {
					drive-strength = <0x2>;
					pinmux = <0xe02 0xd02 0x9002 0x9102>;
				};
			};
		};
	};

	fragment@43 {
		target = <0xffffffff>;

		__overlay__ {

			adc_channel@ {
				compatible = "mediatek,adc_channel";
				mediatek,adc_fdd_rf_params_dynamic_custom_ch = <0x2>;
				status = "okay";
			};
		};
	};

	fragment@44 {
		target = <0xffffffff>;

		__overlay__ {
			io-channels = <0xffffffff 0x2>;
		};
	};

	fragment@45 {
		target = <0xffffffff>;

		__overlay__ {
			mediatek,clkbuf-config = <0x2 0x1 0x1 0x2 0x0 0x0 0x1>;
			mediatek,clkbuf-driving-current = <0x1 0x0 0x1 0x1 0x1 0x1 0x1>;
			mediatek,clkbuf-quantity = <0x7>;
			status = "okay";
		};
	};

	fragment@46 {
		target = <0xffffffff>;

		__overlay__ {
			#address-cells = <0x1>;
			#size-cells = <0x0>;
			clock-frequency = <0x61a80>;
			mediatek,use-open-drain;
		};
	};

	fragment@47 {
		target = <0xffffffff>;

		__overlay__ {
			#address-cells = <0x1>;
			#size-cells = <0x0>;
			clock-frequency = <0x61a80>;
			mediatek,use-open-drain;
		};
	};

	fragment@48 {
		target = <0xffffffff>;

		__overlay__ {
			#address-cells = <0x1>;
			#size-cells = <0x0>;
			clock-frequency = <0x61a80>;
			mediatek,use-open-drain;

			camera_main_three@10 {
				compatible = "mediatek,camera_main_three";
				phandle = <0x77>;
				reg = <0x10>;
				status = "okay";
			};

			camera_main_three_af@0c {
				compatible = "mediatek,camera_main_three_af";
				phandle = <0x79>;
				reg = <0xc>;
				status = "okay";
			};

			camera_main_three_eeprom@51 {
				compatible = "mediatek,camera_main_three_eeprom";
				phandle = <0x78>;
				reg = <0x51>;
				status = "okay";
			};
		};
	};

	fragment@49 {
		target = <0xffffffff>;

		__overlay__ {
			#address-cells = <0x1>;
			#size-cells = <0x0>;
			clock-frequency = <0x61a80>;
			mediatek,use-open-drain;

			nfc@08 {
				compatible = "mediatek,nfc";
				phandle = <0x7a>;
				reg = <0x8>;
				status = "okay";
			};
		};
	};

	fragment@5 {
		target = <0xffffffff>;

		__overlay__ {

			kpd_volume_down {
				compatible = "mediatek, VOLUME_DOWN-eint";
				debounce = <0x7d00>;
				interrupt-parent = <0xffffffff>;
				interrupts = <0x51 0x2 0x51 0x0>;
				phandle = <0x62>;
				status = "okay";
			};

			kpd_volume_up {
				compatible = "mediatek, VOLUME_UP-eint";
				debounce = <0x7d00>;
				interrupt-parent = <0xffffffff>;
				interrupts = <0x50 0x2 0x50 0x0>;
				phandle = <0x61>;
				status = "okay";
			};

			led@0 {
				compatible = "mediatek,red";
				data = <0x1>;
				led_mode = <0x0>;
				phandle = <0x56>;
				pwm_config = <0x0 0x0 0x0 0x0 0x0>;
			};

			led@1 {
				compatible = "mediatek,green";
				data = <0x1>;
				led_mode = <0x0>;
				phandle = <0x57>;
				pwm_config = <0x0 0x0 0x0 0x0 0x0>;
			};

			led@2 {
				compatible = "mediatek,blue";
				data = <0x1>;
				led_mode = <0x0>;
				phandle = <0x58>;
				pwm_config = <0x0 0x0 0x0 0x0 0x0>;
			};

			led@3 {
				compatible = "mediatek,jogball-backlight";
				data = <0x1>;
				led_mode = <0x0>;
				phandle = <0x59>;
				pwm_config = <0x0 0x0 0x0 0x0 0x0>;
			};

			led@4 {
				compatible = "mediatek,keyboard-backlight";
				data = <0x1>;
				led_mode = <0x0>;
				phandle = <0x5a>;
				pwm_config = <0x0 0x0 0x0 0x0 0x0>;
			};

			led@5 {
				compatible = "mediatek,button-backlight";
				data = <0x1>;
				led_mode = <0x0>;
				phandle = <0x5b>;
				pwm_config = <0x0 0x0 0x0 0x0 0x0>;
			};

			led@6 {
				compatible = "mediatek,lcd-backlight";
				data = <0x1>;
				led_mode = <0x6>;
				phandle = <0x5c>;
				pwm_config = <0x0 0x1 0x0 0x0 0x0>;
			};

			nfc_chipset {
				chipset-21686 = "PN557";
				chipset-21692 = "PN557";
				compatible = "oppo-nfc-chipset";
				phandle = <0x63>;
			};

			oplus_devinfo {
				compatible = "oplus-devinfo";
				phandle = <0x60>;

				main-sub {
					aboard-gpio0 = <0xffffffff 0xa5 0x0>;
					aboard-patterns = <0x1 0x1 0x1 0x1 0x1 0x1 0x1>;
					aboard-patterns-evt2 = <0x1 0x1 0x1 0x1 0x1 0x2 0x2>;
					compatible = "hw-match, main-sub";
					match-projects = <0x54b4 0x54b5 0x54b6 0x54b7 0x54ba 0x54bb 0x54bc>;
					pinctrl-0 = <0x1>;
					pinctrl-1 = <0x2>;
					pinctrl-2 = <0x3>;
					pinctrl-names = "aboard_gpio0d_active", "aboard_gpio0d_sleep", "aboard_gpio0d_idle";
					use_tristate_gpio;
				};
			};

			oplus_project {
				compatible = "oppo,oplus_project";
				phandle = <0x5f>;
			};

			oplus_sim_detect {
				Hw,sim_det = <0xffffffff 0x1b 0x0>;
				compatible = "oplus, sim_detect";
			};

			usb_c_pinctrl {
				compatible = "mediatek,usb_c_pinctrl";
				phandle = <0x5e>;
			};

			vibrator@0 {
				compatible = "mediatek,vibrator";
				phandle = <0x5d>;
				vib_limit = <0x0>;
				vib_timer = <0x1e>;
				vib_vol = <0xb>;
			};
		};
	};

	fragment@50 {
		target = <0xffffffff>;

		__overlay__ {
			#address-cells = <0x1>;
			#size-cells = <0x0>;
			clock-frequency = <0x61a80>;
			mediatek,use-open-drain;

			camera_main@36 {
				compatible = "mediatek,camera_main";
				phandle = <0x7b>;
				reg = <0x36>;
				status = "okay";
			};

			camera_main_af@0c {
				compatible = "mediatek,camera_main_af";
				phandle = <0x7c>;
				reg = <0xc>;
				status = "okay";
			};
		};
	};

	fragment@51 {
		target = <0xffffffff>;

		__overlay__ {
			#address-cells = <0x1>;
			#size-cells = <0x0>;
			clock-frequency = <0x61a80>;
			mediatek,use-open-drain;

			subpmic_pmu@34 {
				compatible = "mediatek,subpmic_pmu";
				phandle = <0x7d>;
				reg = <0x34>;
				status = "okay";
			};

			usb_type_c@4e {
				compatible = "mediatek,usb_type_c";
				phandle = <0x7e>;
				reg = <0x4e>;
				status = "okay";
			};
		};
	};

	fragment@52 {
		target = <0xffffffff>;

		__overlay__ {
			#address-cells = <0x1>;
			#size-cells = <0x0>;
			clock-frequency = <0x61a80>;
			mediatek,use-open-drain;
		};
	};

	fragment@53 {
		target = <0xffffffff>;

		__overlay__ {
			#address-cells = <0x1>;
			#size-cells = <0x0>;
			clock-frequency = <0x61a80>;
			mediatek,use-open-drain;
		};
	};

	fragment@54 {
		target = <0xffffffff>;

		__overlay__ {
			#address-cells = <0x1>;
			#size-cells = <0x0>;
			clock-frequency = <0x61a80>;
			mediatek,use-open-drain;

			camera_main_two@6e {
				compatible = "mediatek,camera_main_two";
				phandle = <0x7f>;
				reg = <0x6e>;
				status = "okay";
			};

			camera_main_two_af@0c {
				compatible = "mediatek,camera_main_two_af";
				phandle = <0x80>;
				reg = <0xc>;
				status = "okay";
			};

			camera_sub@1a {
				compatible = "mediatek,camera_sub";
				phandle = <0x81>;
				reg = <0x1a>;
				status = "okay";
			};
		};
	};

	fragment@55 {
		target = <0xffffffff>;

		__overlay__ {
			#address-cells = <0x1>;
			#size-cells = <0x0>;
			clock-frequency = <0x61a80>;
			mediatek,use-open-drain;

			camera_sub_two@1a {
				compatible = "mediatek,camera_sub_two";
				phandle = <0x82>;
				reg = <0x1a>;
				status = "okay";
			};
		};
	};

	fragment@56 {
		target = <0xffffffff>;

		__overlay__ {
			GPIO_FDD_BAND_SUPPORT_DETECT_1ST_PIN = <0xffffffff 0x73 0x0>;
			GPIO_FDD_BAND_SUPPORT_DETECT_2ND_PIN = <0xffffffff 0x74 0x0>;
			GPIO_FDD_BAND_SUPPORT_DETECT_3RD_PIN = <0xffffffff 0x77 0x0>;
			GPIO_SIM1_HOT_PLUG = <0xffffffff 0x1b 0x0>;
			GPIO_SIM1_SCLK = <0xffffffff 0x5b 0x0>;
			GPIO_SIM1_SIO = <0xffffffff 0x5d 0x0>;
			GPIO_SIM1_SRST = <0xffffffff 0x5c 0x0>;
			GPIO_SIM2_SCLK = <0xffffffff 0x5e 0x0>;
			GPIO_SIM2_SIO = <0xffffffff 0x60 0x0>;
			GPIO_SIM2_SRST = <0xffffffff 0x5f 0x0>;
		};
	};

	fragment@57 {
		target = <0xffffffff>;

		__overlay__ {
			gpio_init_default = <0x0 0x0 0x0 0x0 0x1 0x1 0x1 0x1 0x0 0x0 0x0 0x1 0x0 0x1 0x2 0x0 0x0 0x0 0x1 0x0 0x1 0x3 0x0 0x0 0x0 0x1 0x0 0x1 0x4 0x0 0x0 0x0 0x1 0x1 0x1 0x5 0x0 0x0 0x0 0x0 0x0 0x0 0x6 0x0 0x1 0x0 0x1 0x0 0x1 0x7 0x0 0x1 0x0 0x1 0x0 0x1 0x8 0x0 0x0 0x0 0x1 0x1 0x1 0x9 0x0 0x0 0x0 0x1 0x0 0x1 0xa 0x0 0x0 0x0 0x1 0x0 0x1 0xb 0x0 0x0 0x0 0x1 0x1 0x1 0xc 0x0 0x0 0x0 0x0 0x0 0x1 0xd 0x2 0x0 0x0 0x0 0x0 0x0 0xe 0x2 0x0 0x0 0x0 0x0 0x0 0xf 0x0 0x0 0x0 0x1 0x0 0x1 0x10 0x0 0x0 0x0 0x1 0x1 0x1 0x11 0x0 0x0 0x0 0x1 0x0 0x0 0x12 0x0 0x1 0x0 0x1 0x0 0x0 0x13 0x0 0x1 0x0 0x1 0x0 0x0 0x14 0x0 0x0 0x0 0x1 0x0 0x0 0x15 0x0 0x0 0x0 0x1 0x0 0x0 0x16 0x0 0x1 0x0 0x1 0x0 0x0 0x17 0x0 0x0 0x0 0x1 0x0 0x0 0x18 0x0 0x1 0x0 0x1 0x0 0x0 0x19 0x0 0x0 0x0 0x1 0x0 0x0 0x1a 0x0 0x1 0x0 0x1 0x0 0x0 0x1b 0x1 0x0 0x0 0x1 0x1 0x0 0x1c 0x0 0x0 0x0 0x1 0x0 0x0 0x1d 0x0 0x0 0x0 0x1 0x0 0x0 0x1e 0x0 0x0 0x0 0x1 0x0 0x0 0x1f 0x0 0x0 0x0 0x1 0x0 0x0 0x20 0x1 0x0 0x0 0x1 0x1 0x0 0x21 0x1 0x0 0x0 0x0 0x0 0x0 0x22 0x1 0x0 0x0 0x1 0x1 0x1 0x23 0x1 0x0 0x0 0x0 0x0 0x1 0x24 0x1 0x0 0x0 0x0 0x0 0x0 0x25 0x1 0x0 0x0 0x0 0x0 0x0 0x26 0x0 0x0 0x0 0x0 0x0 0x0 0x27 0x0 0x0 0x0 0x0 0x0 0x0 0x28 0x1 0x0 0x0 0x0 0x0 0x0 0x29 0x0 0x1 0x0 0x1 0x0 0x0 0x2a 0x0 0x0 0x0 0x1 0x1 0x0 0x2b 0x0 0x0 0x0 0x1 0x0 0x0 0x2c 0x2 0x0 0x0 0x0 0x0 0x0 0x2d 0x2 0x0 0x0 0x0 0x0 0x1 0x2e 0x2 0x0 0x0 0x0 0x0 0x0 0x2f 0x2 0x0 0x0 0x1 0x0 0x0 0x30 0x4 0x0 0x0 0x1 0x1 0x0 0x31 0x0 0x1 0x0 0x1 0x0 0x0 0x32 0x4 0x0 0x0 0x1 0x1 0x0 0x33 0x0 0x1 0x1 0x1 0x0 0x0 0x34 0x1 0x0 0x0 0x0 0x0 0x0 0x35 0x1 0x0 0x0 0x0 0x0 0x0 0x36 0x1 0x0 0x0 0x0 0x0 0x0 0x37 0x1 0x0 0x0 0x0 0x0 0x0 0x38 0x0 0x0 0x0 0x0 0x0 0x0 0x39 0x0 0x0 0x0 0x1 0x0 0x0 0x3a 0x0 0x0 0x0 0x0 0x0 0x1 0x3b 0x0 0x0 0x0 0x0 0x0 0x1 0x3c 0x3 0x0 0x0 0x1 0x0 0x0 0x3d 0x6 0x0 0x0 0x1 0x0 0x0 0x3e 0x6 0x0 0x0 0x1 0x1 0x0 0x3f 0x6 0x0 0x0 0x1 0x0 0x0 0x40 0x6 0x0 0x0 0x1 0x0 0x0 0x41 0x6 0x0 0x0 0x1 0x0 0x0 0x42 0x0 0x0 0x0 0x1 0x0 0x0 0x43 0x0 0x0 0x0 0x1 0x0 0x0 0x44 0x0 0x0 0x0 0x1 0x0 0x1 0x45 0x0 0x0 0x0 0x1 0x0 0x1 0x46 0x0 0x0 0x0 0x1 0x0 0x1 0x47 0x0 0x0 0x0 0x1 0x0 0x1 0x48 0x0 0x0 0x0 0x1 0x0 0x1 0x49 0x0 0x0 0x0 0x1 0x0 0x1 0x4a 0x0 0x0 0x0 0x1 0x0 0x1 0x4b 0x0 0x0 0x0 0x1 0x0 0x1 0x4c 0x0 0x0 0x0 0x1 0x0 0x1 0x4d 0x0 0x0 0x0 0x1 0x0 0x1 0x4e 0x0 0x0 0x0 0x1 0x0 0x1 0x4f 0x0 0x0 0x0 0x1 0x0 0x1 0x50 0x1 0x0 0x0 0x1 0x1 0x1 0x51 0x1 0x0 0x0 0x1 0x1 0x1 0x52 0x0 0x0 0x0 0x1 0x0 0x1 0x53 0x0 0x0 0x0 0x1 0x1 0x1 0x55 0x1 0x0 0x0 0x1 0x0 0x1 0x56 0x1 0x0 0x0 0x1 0x0 0x1 0x57 0x1 0x0 0x0 0x1 0x0 0x1 0x58 0x1 0x0 0x0 0x1 0x0 0x1 0x59 0x1 0x0 0x0 0x1 0x0 0x1 0x5a 0x1 0x0 0x0 0x1 0x0 0x1 0x5b 0x1 0x0 0x0 0x0 0x0 0x1 0x5c 0x1 0x0 0x0 0x0 0x0 0x1 0x5d 0x1 0x0 0x0 0x1 0x1 0x1 0x5e 0x1 0x0 0x0 0x0 0x0 0x1 0x5f 0x1 0x0 0x0 0x0 0x0 0x1 0x60 0x1 0x0 0x0 0x1 0x1 0x1 0x61 0x1 0x0 0x0 0x1 0x0 0x0 0x62 0x1 0x0 0x0 0x0 0x0 0x1 0x63 0x0 0x1 0x0 0x1 0x0 0x0 0x64 0x0 0x0 0x0 0x1 0x0 0x0 0x65 0x1 0x0 0x0 0x1 0x0 0x0 0x66 0x1 0x0 0x0 0x1 0x0 0x0 0x67 0x1 0x0 0x0 0x1 0x0 0x0 0x68 0x1 0x0 0x0 0x1 0x0 0x0 0x69 0x1 0x0 0x0 0x1 0x0 0x0 0x6a 0x1 0x0 0x0 0x1 0x0 0x0 0x6b 0x1 0x0 0x0 0x1 0x0 0x0 0x6c 0x1 0x0 0x0 0x1 0x0 0x1 0x6d 0x1 0x0 0x0 0x1 0x0 0x1 0x6e 0x1 0x0 0x0 0x1 0x0 0x1 0x6f 0x1 0x0 0x0 0x1 0x0 0x1 0x70 0x1 0x0 0x0 0x1 0x0 0x1 0x71 0x1 0x0 0x0 0x1 0x0 0x1 0x72 0x1 0x0 0x0 0x1 0x0 0x1 0x73 0x0 0x0 0x0 0x1 0x0 0x1 0x74 0x0 0x0 0x0 0x1 0x0 0x1 0x75 0x0 0x0 0x0 0x1 0x0 0x0 0x76 0x0 0x0 0x0 0x1 0x0 0x0 0x77 0x0 0x0 0x0 0x1 0x0 0x0 0x78 0x0 0x0 0x0 0x1 0x0 0x0 0x79 0x0 0x1 0x0 0x1 0x0 0x1 0x7a 0x0 0x0 0x0 0x1 0x0 0x1 0x7b 0x0 0x0 0x0 0x1 0x0 0x1 0x7c 0x1 0x0 0x0 0x1 0x0 0x0 0x7d 0x0 0x0 0x0 0x1 0x0 0x1 0x7e 0x1 0x0 0x0 0x1 0x0 0x0 0x7f 0x1 0x0 0x0 0x1 0x0 0x0 0x80 0x1 0x0 0x0 0x1 0x0 0x0 0x81 0x1 0x0 0x0 0x1 0x0 0x0 0x82 0x0 0x0 0x0 0x1 0x0 0x0 0x83 0x0 0x0 0x0 0x1 0x0 0x0 0x84 0x0 0x0 0x0 0x1 0x0 0x0 0x85 0x0 0x0 0x0 0x1 0x0 0x0 0x86 0x0 0x0 0x0 0x1 0x0 0x0 0x87 0x0 0x0 0x0 0x1 0x0 0x0 0x88 0x1 0x0 0x0 0x1 0x0 0x0 0x89 0x1 0x0 0x0 0x1 0x0 0x0 0x8a 0x1 0x0 0x0 0x1 0x0 0x0 0x8b 0x1 0x0 0x0 0x1 0x0 0x0 0x8c 0x1 0x0 0x0 0x1 0x0 0x0 0x8d 0x1 0x0 0x0 0x1 0x0 0x0 0x8e 0x1 0x0 0x0 0x1 0x0 0x0 0x8f 0x1 0x0 0x0 0x1 0x1 0x0 0x90 0x2 0x0 0x0 0x0 0x0 0x1 0x91 0x2 0x0 0x0 0x0 0x0 0x1 0x92 0x2 0x0 0x0 0x1 0x1 0x1 0x93 0x2 0x0 0x0 0x1 0x1 0x1 0x94 0x1 0x0 0x0 0x1 0x1 0x1 0x95 0x1 0x0 0x0 0x1 0x1 0x1 0x96 0x1 0x0 0x0 0x1 0x1 0x1 0x97 0x1 0x0 0x0 0x1 0x1 0x1 0x98 0x1 0x0 0x0 0x1 0x1 0x1 0x99 0x1 0x0 0x0 0x1 0x1 0x1 0x9a 0x1 0x0 0x0 0x1 0x1 0x1 0x9b 0x1 0x0 0x0 0x1 0x1 0x1 0x9c 0x1 0x0 0x0 0x1 0x1 0x1 0x9d 0x1 0x0 0x0 0x1 0x1 0x1 0x9e 0x0 0x0 0x0 0x1 0x0 0x1 0x9f 0x0 0x0 0x0 0x1 0x0 0x0 0xa0 0x1 0x0 0x0 0x1 0x1 0x1 0xa1 0x1 0x0 0x0 0x1 0x1 0x1 0xa2 0x1 0x0 0x0 0x1 0x1 0x1 0xa3 0x1 0x0 0x0 0x1 0x1 0x1 0xa4 0x0 0x1 0x0 0x1 0x0 0x1 0xa5 0x0 0x0 0x0 0x1 0x0 0x1 0xa6 0x0 0x0 0x0 0x1 0x0 0x1 0xa7 0x0 0x1 0x0 0x1 0x0 0x0 0xa8 0x0 0x1 0x0 0x1 0x0 0x1 0xa9 0x0 0x1 0x0 0x1 0x0 0x1 0xaa 0x0 0x0 0x0 0x0 0x0 0x1 0xab 0x0 0x0 0x0 0x0 0x0 0x1 0xac 0x2 0x0 0x0 0x1 0x0 0x1 0xad 0x0 0x1 0x0 0x1 0x0 0x1 0xae 0x1 0x0 0x0 0x0 0x0 0x1 0xaf 0x1 0x0 0x0 0x0 0x0 0x1 0xb0 0x1 0x0 0x0 0x1 0x0 0x1 0xb1 0x1 0x0 0x0 0x1 0x0 0x1 0xb2 0x1 0x0 0x0 0x0 0x0 0x0 0xb3 0x1 0x0 0x0 0x0 0x0 0x0 0xb4 0x1 0x0 0x0 0x0 0x0 0x1 0xb5 0x1 0x0 0x0 0x1 0x0 0x1 0xb6 0x1 0x0 0x0 0x0 0x0 0x0 0xb7 0x1 0x0 0x0 0x0 0x0 0x1 0xb8 0x1 0x0 0x0 0x0 0x0 0x1 0xb9 0x1 0x0 0x0 0x0 0x0 0x1 0xba 0x1 0x0 0x0 0x0 0x0 0x1 0xbb 0x1 0x0 0x0 0x1 0x0 0x1 0xbc 0x1 0x0 0x0 0x1 0x0 0x1 0xbd 0x1 0x0 0x0 0x1 0x0 0x1 0xbe 0x1 0x0 0x0 0x1 0x0 0x1 0xbf 0x0 0x0 0x0 0x1 0x0 0x0 0xc0 0x0 0x0 0x0 0x1 0x0 0x0 0xc1 0x0 0x0 0x0 0x1 0x0 0x0 0xc2 0x0 0x0 0x0 0x1 0x0 0x0 0xc3 0x0 0x0 0x0 0x1 0x0 0x0 0xc4 0x0 0x0 0x0 0x1 0x0 0x0 0xc5 0x0 0x0 0x0 0x1 0x0 0x0 0xc6 0x0 0x0 0x0 0x1 0x0 0x0 0xc7 0x0 0x0 0x0 0x1 0x0 0x0 0xc8 0x0 0x0 0x0 0x1 0x0 0x0 0xc9 0x0 0x0 0x0 0x1 0x0 0x0 0xca 0x0 0x0 0x0 0x1 0x0 0x0 0xcb 0x0 0x0 0x0 0x1 0x0 0x0 0xcc 0x0 0x0 0x0 0x1 0x0 0x0 0xcd 0x0 0x0 0x0 0x1 0x0 0x0 0xce 0x0 0x0 0x0 0x1 0x0 0x0 0xcf 0x0 0x0 0x0 0x1 0x0 0x0 0xd0 0x0 0x0 0x0 0x1 0x0 0x0 0xd1 0x0 0x0 0x0 0x1 0x0 0x0 0xd2 0x0 0x0 0x0 0x1 0x0 0x0 0xd3 0x0 0x0 0x0 0x1 0x0 0x0 0xd4 0x0 0x0 0x0 0x1 0x0 0x0 0xd5 0x0 0x0 0x0 0x1 0x0 0x0 0xd6 0x0 0x0 0x0 0x1 0x0 0x0 0xd7 0x0 0x0 0x0 0x1 0x0 0x0 0xd8 0x0 0x0 0x0 0x1 0x0 0x0 0xd9 0x0 0x0 0x0 0x1 0x0 0x0 0xda 0x0 0x0 0x0 0x1 0x0 0x0 0xdb 0x0 0x0 0x0 0x1 0x0 0x0 0xdc 0x0 0x0 0x0 0x1 0x0 0x0 0xdd 0x0 0x0 0x0 0x1 0x0 0x0>;
		};
	};

	fragment@58 {
		target = <0xffffffff>;

		__overlay__ {
			interrupt-parent = <0xffffffff>;
			interrupts = <0x0 0x8>;
			status = "okay";
		};
	};

	fragment@59 {
		target = <0xffffffff>;

		__overlay__ {
			interrupt-parent = <0xffffffff>;
			interrupts = <0x1 0x2>;
			status = "okay";
		};
	};

	fragment@6 {
		target = <0xffffffff>;

		__overlay__ {

			aboard_gpio0d_active {
				phandle = <0x1>;

				pins_cmd_dat {
					bias-pull-up = <0x1>;
					input-enable;
					pinmux = <0xa500>;
					slew-rate = <0x0>;
				};
			};

			aboard_gpio0d_idle {
				phandle = <0x3>;

				pins_cmd_dat {
					bias-disable;
					pinmux = <0xa500>;
					slew-rate = <0x0>;
				};
			};

			aboard_gpio0d_sleep {
				phandle = <0x2>;

				pins_cmd_dat {
					bias-pull-up = <0x0>;
					input-enable;
					pinmux = <0xa500>;
					slew-rate = <0x0>;
				};
			};
		};
	};

	fragment@60 {
		target = <0xffffffff>;

		__overlay__ {
			interrupt-parent = <0xffffffff>;
			interrupts = <0x4 0x2>;
			status = "okay";
		};
	};

	fragment@61 {
		target = <0xffffffff>;

		__overlay__ {
			interrupt-parent = <0xffffffff>;
			interrupts = <0x5 0x4>;
			status = "okay";
		};
	};

	fragment@62 {
		target = <0xffffffff>;

		__overlay__ {
			interrupt-parent = <0xffffffff>;
			interrupts = <0xc 0x2>;
			status = "okay";
		};
	};

	fragment@63 {
		target = <0xffffffff>;

		__overlay__ {
			deb-gpios = <0xffffffff 0x10 0x0>;
			debounce = <0x7d000>;
			interrupt-parent = <0xffffffff>;
			interrupts = <0x10 0x4>;
			status = "okay";
		};
	};

	fragment@64 {
		target = <0xffffffff>;

		__overlay__ {
			interrupt-parent = <0xffffffff>;
			interrupts = <0x61 0x1>;
			status = "okay";
		};
	};

	fragment@65 {
		target = <0xffffffff>;

		__overlay__ {
			compatible = "mediatek,md1_sim1_hot_plug_eint-eint";
			debounce = <0x0 0x2710>;
			dedicated = <0x0 0x0>;
			interrupts = <0x0 0x8>;
			sockettype = <0x0 0x0>;
			src_pin = <0x0 0x1>;
			status = "okay";
		};
	};

	fragment@66 {
		target = <0xffffffff>;

		__overlay__ {
			mediatek,kpd-hw-dl-key0 = <0x11>;
			mediatek,kpd-hw-dl-key1 = <0x1>;
			mediatek,kpd-hw-dl-key2 = <0x8>;
			mediatek,kpd-hw-init-map = <0x0 0x72 0x0 0x0 0x0 0x0 0x0 0x0 0x0 0x0 0x0 0x0 0x0 0x0 0x0 0x0 0x0 0x0 0x0 0x0 0x0 0x0 0x0 0x0 0x0 0x0 0x0 0x0 0x0 0x0 0x0 0x0 0x0 0x0 0x0 0x0 0x0 0x0 0x0 0x0 0x0 0x0 0x0 0x0 0x0 0x0 0x0 0x0 0x0 0x0 0x0 0x0 0x0 0x0 0x0 0x0 0x0 0x0 0x0 0x0 0x0 0x0 0x0 0x0 0x0 0x0 0x0 0x0 0x0 0x0 0x0 0x0>;
			mediatek,kpd-hw-map-num = <0x48>;
			mediatek,kpd-hw-pwrkey = <0x8>;
			mediatek,kpd-hw-recovery-key = <0x1>;
			mediatek,kpd-hw-rstkey = <0x11>;
			mediatek,kpd-key-debounce = <0x400>;
			mediatek,kpd-pwkey-gpio-din = <0x0>;
			mediatek,kpd-pwrkey-eint-gpio = <0x0>;
			mediatek,kpd-sw-pwrkey = <0x74>;
			mediatek,kpd-sw-rstkey = <0x73>;
			mediatek,kpd-use-extend-type = <0x0>;
			status = "okay";
		};
	};

	fragment@7 {
		target = <0xffffffff>;

		__overlay__ {

			nfc_default {
				phandle = <0x69>;
			};

			nfc_dwn_high {
				phandle = <0x66>;

				pins_cmd_dat {
					output-high;
					pinmux = <0x3800>;
					slew-rate = <0x1>;
				};
			};

			nfc_dwn_low {
				phandle = <0x67>;

				pins_cmd_dat {
					output-low;
					pinmux = <0x3800>;
					slew-rate = <0x1>;
				};
			};

			nfc_eint_as_int {
				phandle = <0x68>;

				pins_cmd_dat {
					bias-disable;
					pinmux = <0x500>;
					slew-rate = <0x0>;
				};
			};

			nfc_ven_high {
				phandle = <0x64>;

				pins_cmd_dat {
					output-high;
					pinmux = <0xa700>;
					slew-rate = <0x1>;
				};
			};

			nfc_ven_low {
				phandle = <0x65>;

				pins_cmd_dat {
					output-low;
					pinmux = <0xa700>;
					slew-rate = <0x1>;
				};
			};
		};
	};

	fragment@8 {
		target = <0xffffffff>;

		__overlay__ {
			status = "okay";

			nfc_nxp@2a {
				compatible = "nxp,pn544";
				interrupt-parent = <0xffffffff>;
				nxp,pn544-fw-dwnld = <0xffffffff 0x38 0x0>;
				nxp,pn544-irq = <0xffffffff 0x5 0x0>;
				nxp,pn544-ven = <0xffffffff 0xa7 0x0>;
				reg = <0x2a>;
			};
		};
	};

	fragment@9 {
		target = <0xffffffff>;

		__overlay__ {
			#address-cells = <0x1>;
			#size-cells = <0x0>;
			status = "okay";

			finger_spi@0 {
				compatible = "mediatek,fingerspi-fp";
				irtx_ldo-config = <0x2dc6c0 0x2dc6c0 0x249f0>;
				netlink-event = <0x1e>;
				reg = <0x0>;
				spi-id = <0x1>;
				spi-irq = <0x1>;
				spi-max-frequency = <0x7a1200>;
				spi-reg = <0x11015000>;
				status = "okay";

				power_source_1 {
					delay-time = <0x0>;
					power-config = "irtx_ldo-config";
					power-mode = <0x1>;
					power-name = "irtx_ldo";
				};
			};
		};
	};
};
